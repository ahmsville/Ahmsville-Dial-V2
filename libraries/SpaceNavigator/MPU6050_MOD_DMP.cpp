// I2Cdev_mod library collection - MPU6050_MOD I2C device class
// Based on InvenSense MPU-6050 register map document rev. 2.0, 5/19/2011 (RM-MPU-6000A-00)
// 8/24/2011 by Jeff Rowberg <jeff@rowberg.net>
// Updates should (hopefully) always be available at https://github.com/jrowberg/I2Cdev_modlib
//
// Changelog:
//  2019-07-08 - Added Auto Calibration routine
//     ... - ongoing debug release

// NOTE: THIS IS ONLY A PARIAL RELEASE. THIS DEVICE CLASS IS CURRENTLY UNDERGOING ACTIVE
// DEVELOPMENT AND IS STILL MISSING SOME IMPORTANT FEATURES. PLEASE KEEP THIS IN MIND IF
// YOU DECIDE TO USE THIS PARTICULAR CODE FOR ANYTHING.

/* ============================================
I2Cdev_mod device library code is placed under the MIT license
Copyright (c) 2012 Jeff Rowberg

Permission is hereby granted, free of charge, to any person obtaining a copy
of this software and associated documentation files (the "Software"), to deal
in the Software without restriction, including without limitation the rights
to use, copy, modify, merge, publish, distribute, sublicense, and/or sell
copies of the Software, and to permit persons to whom the Software is
furnished to do so, subject to the following conditions:

The above copyright notice and this permission notice shall be included in
all copies or substantial portions of the Software.

THE SOFTWARE IS PROVIDED "AS IS", WITHOUT WARRANTY OF ANY KIND, EXPRESS OR
IMPLIED, INCLUDING BUT NOT LIMITED TO THE WARRANTIES OF MERCHANTABILITY,
FITNESS FOR A PARTICULAR PURPOSE AND NONINFRINGEMENT. IN NO EVENT SHALL THE
AUTHORS OR COPYRIGHT HOLDERS BE LIABLE FOR ANY CLAIM, DAMAGES OR OTHER
LIABILITY, WHETHER IN AN ACTION OF CONTRACT, TORT OR OTHERWISE, ARISING FROM,
OUT OF OR IN CONNECTION WITH THE SOFTWARE OR THE USE OR OTHER DEALINGS IN
THE SOFTWARE.
===============================================
*/

#include "MPU6050_MOD_DMP.h"

/** Specific address constructor.
 * @param address I2C address, uses default I2C address if none is specified
 * @see MPU6050_MOD_DEFAULT_ADDRESS
 * @see MPU6050_MOD_ADDRESS_AD0_LOW
 * @see MPU6050_MOD_ADDRESS_AD0_HIGH
 */
MPU6050_MOD::MPU6050_MOD(uint8_t address):devAddr(address) {
}

/** Power on and prepare for general usage.
 * This will activate the device and take it out of sleep mode (which must be done
 * after start-up). This function also sets both the accelerometer and the gyroscope
 * to their most sensitive settings, namely +/- 2g and +/- 250 degrees/sec, and sets
 * the clock source to use the X Gyro for reference, which is slightly better than
 * the default internal clock source.
 */
void MPU6050_MOD::initialize() {
    setClockSource(MPU6050_MOD_CLOCK_PLL_XGYRO);
    setFullScaleGyroRange(MPU6050_MOD_GYRO_FS_250);
    setFullScaleAccelRange(MPU6050_MOD_ACCEL_FS_2);
    setSleepEnabled(false); // thanks to Jack Elston for pointing this one out!
}

/** Verify the I2C connection.
 * Make sure the device is connected and responds as expected.
 * @return True if connection is valid, false otherwise
 */
bool MPU6050_MOD::testConnection() {
    return getDeviceID() == 0x34;
}

// AUX_VDDIO register (InvenSense demo code calls this RA_*G_OFFS_TC)

/** Get the auxiliary I2C supply voltage level.
 * When set to 1, the auxiliary I2C bus high logic level is VDD. When cleared to
 * 0, the auxiliary I2C bus high logic level is VLOGIC. This does not apply to
 * the MPU-6000, which does not have a VLOGIC pin.
 * @return I2C supply voltage level (0=VLOGIC, 1=VDD)
 */
uint8_t MPU6050_MOD::getAuxVDDIOLevel() {
    I2Cdev_mod::readBit(devAddr, MPU6050_MOD_RA_YG_OFFS_TC, MPU6050_MOD_TC_PWR_MODE_BIT, buffer);
    return buffer[0];
}
/** Set the auxiliary I2C supply voltage level.
 * When set to 1, the auxiliary I2C bus high logic level is VDD. When cleared to
 * 0, the auxiliary I2C bus high logic level is VLOGIC. This does not apply to
 * the MPU-6000, which does not have a VLOGIC pin.
 * @param level I2C supply voltage level (0=VLOGIC, 1=VDD)
 */
void MPU6050_MOD::setAuxVDDIOLevel(uint8_t level) {
    I2Cdev_mod::writeBit(devAddr, MPU6050_MOD_RA_YG_OFFS_TC, MPU6050_MOD_TC_PWR_MODE_BIT, level);
}

// SMPLRT_DIV register

/** Get gyroscope output rate divider.
 * The sensor register output, FIFO output, DMP sampling, Motion detection, Zero
 * Motion detection, and Free Fall detection are all based on the Sample Rate.
 * The Sample Rate is generated by dividing the gyroscope output rate by
 * SMPLRT_DIV:
 *
 * Sample Rate = Gyroscope Output Rate / (1 + SMPLRT_DIV)
 *
 * where Gyroscope Output Rate = 8kHz when the DLPF is disabled (DLPF_CFG = 0 or
 * 7), and 1kHz when the DLPF is enabled (see Register 26).
 *
 * Note: The accelerometer output rate is 1kHz. This means that for a Sample
 * Rate greater than 1kHz, the same accelerometer sample may be output to the
 * FIFO, DMP, and sensor registers more than once.
 *
 * For a diagram of the gyroscope and accelerometer signal paths, see Section 8
 * of the MPU-6000/MPU-6050 Product Specification document.
 *
 * @return Current sample rate
 * @see MPU6050_MOD_RA_SMPLRT_DIV
 */
uint8_t MPU6050_MOD::getRate() {
    I2Cdev_mod::readByte(devAddr, MPU6050_MOD_RA_SMPLRT_DIV, buffer);
    return buffer[0];
}
/** Set gyroscope sample rate divider.
 * @param rate New sample rate divider
 * @see getRate()
 * @see MPU6050_MOD_RA_SMPLRT_DIV
 */
void MPU6050_MOD::setRate(uint8_t rate) {
    I2Cdev_mod::writeByte(devAddr, MPU6050_MOD_RA_SMPLRT_DIV, rate);
}

// CONFIG register

/** Get external FSYNC configuration.
 * Configures the external Frame Synchronization (FSYNC) pin sampling. An
 * external signal connected to the FSYNC pin can be sampled by configuring
 * EXT_SYNC_SET. Signal changes to the FSYNC pin are latched so that short
 * strobes may be captured. The latched FSYNC signal will be sampled at the
 * Sampling Rate, as defined in register 25. After sampling, the latch will
 * reset to the current FSYNC signal state.
 *
 * The sampled value will be reported in place of the least significant bit in
 * a sensor data register determined by the value of EXT_SYNC_SET according to
 * the following table.
 *
 * <pre>
 * EXT_SYNC_SET | FSYNC Bit Location
 * -------------+-------------------
 * 0            | Input disabled
 * 1            | TEMP_OUT_L[0]
 * 2            | GYRO_XOUT_L[0]
 * 3            | GYRO_YOUT_L[0]
 * 4            | GYRO_ZOUT_L[0]
 * 5            | ACCEL_XOUT_L[0]
 * 6            | ACCEL_YOUT_L[0]
 * 7            | ACCEL_ZOUT_L[0]
 * </pre>
 *
 * @return FSYNC configuration value
 */
uint8_t MPU6050_MOD::getExternalFrameSync() {
    I2Cdev_mod::readBits(devAddr, MPU6050_MOD_RA_CONFIG, MPU6050_MOD_CFG_EXT_SYNC_SET_BIT, MPU6050_MOD_CFG_EXT_SYNC_SET_LENGTH, buffer);
    return buffer[0];
}
/** Set external FSYNC configuration.
 * @see getExternalFrameSync()
 * @see MPU6050_MOD_RA_CONFIG
 * @param sync New FSYNC configuration value
 */
void MPU6050_MOD::setExternalFrameSync(uint8_t sync) {
    I2Cdev_mod::writeBits(devAddr, MPU6050_MOD_RA_CONFIG, MPU6050_MOD_CFG_EXT_SYNC_SET_BIT, MPU6050_MOD_CFG_EXT_SYNC_SET_LENGTH, sync);
}
/** Get digital low-pass filter configuration.
 * The DLPF_CFG parameter sets the digital low pass filter configuration. It
 * also determines the internal sampling rate used by the device as shown in
 * the table below.
 *
 * Note: The accelerometer output rate is 1kHz. This means that for a Sample
 * Rate greater than 1kHz, the same accelerometer sample may be output to the
 * FIFO, DMP, and sensor registers more than once.
 *
 * <pre>
 *          |   ACCELEROMETER    |           GYROSCOPE
 * DLPF_CFG | Bandwidth | Delay  | Bandwidth | Delay  | Sample Rate
 * ---------+-----------+--------+-----------+--------+-------------
 * 0        | 260Hz     | 0ms    | 256Hz     | 0.98ms | 8kHz
 * 1        | 184Hz     | 2.0ms  | 188Hz     | 1.9ms  | 1kHz
 * 2        | 94Hz      | 3.0ms  | 98Hz      | 2.8ms  | 1kHz
 * 3        | 44Hz      | 4.9ms  | 42Hz      | 4.8ms  | 1kHz
 * 4        | 21Hz      | 8.5ms  | 20Hz      | 8.3ms  | 1kHz
 * 5        | 10Hz      | 13.8ms | 10Hz      | 13.4ms | 1kHz
 * 6        | 5Hz       | 19.0ms | 5Hz       | 18.6ms | 1kHz
 * 7        |   -- Reserved --   |   -- Reserved --   | Reserved
 * </pre>
 *
 * @return DLFP configuration
 * @see MPU6050_MOD_RA_CONFIG
 * @see MPU6050_MOD_CFG_DLPF_CFG_BIT
 * @see MPU6050_MOD_CFG_DLPF_CFG_LENGTH
 */
uint8_t MPU6050_MOD::getDLPFMode() {
    I2Cdev_mod::readBits(devAddr, MPU6050_MOD_RA_CONFIG, MPU6050_MOD_CFG_DLPF_CFG_BIT, MPU6050_MOD_CFG_DLPF_CFG_LENGTH, buffer);
    return buffer[0];
}
/** Set digital low-pass filter configuration.
 * @param mode New DLFP configuration setting
 * @see getDLPFBandwidth()
 * @see MPU6050_MOD_DLPF_BW_256
 * @see MPU6050_MOD_RA_CONFIG
 * @see MPU6050_MOD_CFG_DLPF_CFG_BIT
 * @see MPU6050_MOD_CFG_DLPF_CFG_LENGTH
 */
void MPU6050_MOD::setDLPFMode(uint8_t mode) {
    I2Cdev_mod::writeBits(devAddr, MPU6050_MOD_RA_CONFIG, MPU6050_MOD_CFG_DLPF_CFG_BIT, MPU6050_MOD_CFG_DLPF_CFG_LENGTH, mode);
}

// GYRO_CONFIG register

/** Get full-scale gyroscope range.
 * The FS_SEL parameter allows setting the full-scale range of the gyro sensors,
 * as described in the table below.
 *
 * <pre>
 * 0 = +/- 250 degrees/sec
 * 1 = +/- 500 degrees/sec
 * 2 = +/- 1000 degrees/sec
 * 3 = +/- 2000 degrees/sec
 * </pre>
 *
 * @return Current full-scale gyroscope range setting
 * @see MPU6050_MOD_GYRO_FS_250
 * @see MPU6050_MOD_RA_GYRO_CONFIG
 * @see MPU6050_MOD_GCONFIG_FS_SEL_BIT
 * @see MPU6050_MOD_GCONFIG_FS_SEL_LENGTH
 */
uint8_t MPU6050_MOD::getFullScaleGyroRange() {
    I2Cdev_mod::readBits(devAddr, MPU6050_MOD_RA_GYRO_CONFIG, MPU6050_MOD_GCONFIG_FS_SEL_BIT, MPU6050_MOD_GCONFIG_FS_SEL_LENGTH, buffer);
    return buffer[0];
}
/** Set full-scale gyroscope range.
 * @param range New full-scale gyroscope range value
 * @see getFullScaleRange()
 * @see MPU6050_MOD_GYRO_FS_250
 * @see MPU6050_MOD_RA_GYRO_CONFIG
 * @see MPU6050_MOD_GCONFIG_FS_SEL_BIT
 * @see MPU6050_MOD_GCONFIG_FS_SEL_LENGTH
 */
void MPU6050_MOD::setFullScaleGyroRange(uint8_t range) {
    I2Cdev_mod::writeBits(devAddr, MPU6050_MOD_RA_GYRO_CONFIG, MPU6050_MOD_GCONFIG_FS_SEL_BIT, MPU6050_MOD_GCONFIG_FS_SEL_LENGTH, range);
}

// SELF TEST FACTORY TRIM VALUES

/** Get self-test factory trim value for accelerometer X axis.
 * @return factory trim value
 * @see MPU6050_MOD_RA_SELF_TEST_X
 */
uint8_t MPU6050_MOD::getAccelXSelfTestFactoryTrim() {
    I2Cdev_mod::readByte(devAddr, MPU6050_MOD_RA_SELF_TEST_X, &buffer[0]);
	I2Cdev_mod::readByte(devAddr, MPU6050_MOD_RA_SELF_TEST_A, &buffer[1]);	
    return (buffer[0]>>3) | ((buffer[1]>>4) & 0x03);
}

/** Get self-test factory trim value for accelerometer Y axis.
 * @return factory trim value
 * @see MPU6050_MOD_RA_SELF_TEST_Y
 */
uint8_t MPU6050_MOD::getAccelYSelfTestFactoryTrim() {
    I2Cdev_mod::readByte(devAddr, MPU6050_MOD_RA_SELF_TEST_Y, &buffer[0]);
	I2Cdev_mod::readByte(devAddr, MPU6050_MOD_RA_SELF_TEST_A, &buffer[1]);	
    return (buffer[0]>>3) | ((buffer[1]>>2) & 0x03);
}

/** Get self-test factory trim value for accelerometer Z axis.
 * @return factory trim value
 * @see MPU6050_MOD_RA_SELF_TEST_Z
 */
uint8_t MPU6050_MOD::getAccelZSelfTestFactoryTrim() {
    I2Cdev_mod::readBytes(devAddr, MPU6050_MOD_RA_SELF_TEST_Z, 2, buffer);	
    return (buffer[0]>>3) | (buffer[1] & 0x03);
}

/** Get self-test factory trim value for gyro X axis.
 * @return factory trim value
 * @see MPU6050_MOD_RA_SELF_TEST_X
 */
uint8_t MPU6050_MOD::getGyroXSelfTestFactoryTrim() {
    I2Cdev_mod::readByte(devAddr, MPU6050_MOD_RA_SELF_TEST_X, buffer);	
    return (buffer[0] & 0x1F);
}

/** Get self-test factory trim value for gyro Y axis.
 * @return factory trim value
 * @see MPU6050_MOD_RA_SELF_TEST_Y
 */
uint8_t MPU6050_MOD::getGyroYSelfTestFactoryTrim() {
    I2Cdev_mod::readByte(devAddr, MPU6050_MOD_RA_SELF_TEST_Y, buffer);	
    return (buffer[0] & 0x1F);
}

/** Get self-test factory trim value for gyro Z axis.
 * @return factory trim value
 * @see MPU6050_MOD_RA_SELF_TEST_Z
 */
uint8_t MPU6050_MOD::getGyroZSelfTestFactoryTrim() {
    I2Cdev_mod::readByte(devAddr, MPU6050_MOD_RA_SELF_TEST_Z, buffer);	
    return (buffer[0] & 0x1F);
}

// ACCEL_CONFIG register

/** Get self-test enabled setting for accelerometer X axis.
 * @return Self-test enabled value
 * @see MPU6050_MOD_RA_ACCEL_CONFIG
 */
bool MPU6050_MOD::getAccelXSelfTest() {
    I2Cdev_mod::readBit(devAddr, MPU6050_MOD_RA_ACCEL_CONFIG, MPU6050_MOD_ACONFIG_XA_ST_BIT, buffer);
    return buffer[0];
}
/** Get self-test enabled setting for accelerometer X axis.
 * @param enabled Self-test enabled value
 * @see MPU6050_MOD_RA_ACCEL_CONFIG
 */
void MPU6050_MOD::setAccelXSelfTest(bool enabled) {
    I2Cdev_mod::writeBit(devAddr, MPU6050_MOD_RA_ACCEL_CONFIG, MPU6050_MOD_ACONFIG_XA_ST_BIT, enabled);
}
/** Get self-test enabled value for accelerometer Y axis.
 * @return Self-test enabled value
 * @see MPU6050_MOD_RA_ACCEL_CONFIG
 */
bool MPU6050_MOD::getAccelYSelfTest() {
    I2Cdev_mod::readBit(devAddr, MPU6050_MOD_RA_ACCEL_CONFIG, MPU6050_MOD_ACONFIG_YA_ST_BIT, buffer);
    return buffer[0];
}
/** Get self-test enabled value for accelerometer Y axis.
 * @param enabled Self-test enabled value
 * @see MPU6050_MOD_RA_ACCEL_CONFIG
 */
void MPU6050_MOD::setAccelYSelfTest(bool enabled) {
    I2Cdev_mod::writeBit(devAddr, MPU6050_MOD_RA_ACCEL_CONFIG, MPU6050_MOD_ACONFIG_YA_ST_BIT, enabled);
}
/** Get self-test enabled value for accelerometer Z axis.
 * @return Self-test enabled value
 * @see MPU6050_MOD_RA_ACCEL_CONFIG
 */
bool MPU6050_MOD::getAccelZSelfTest() {
    I2Cdev_mod::readBit(devAddr, MPU6050_MOD_RA_ACCEL_CONFIG, MPU6050_MOD_ACONFIG_ZA_ST_BIT, buffer);
    return buffer[0];
}
/** Set self-test enabled value for accelerometer Z axis.
 * @param enabled Self-test enabled value
 * @see MPU6050_MOD_RA_ACCEL_CONFIG
 */
void MPU6050_MOD::setAccelZSelfTest(bool enabled) {
    I2Cdev_mod::writeBit(devAddr, MPU6050_MOD_RA_ACCEL_CONFIG, MPU6050_MOD_ACONFIG_ZA_ST_BIT, enabled);
}
/** Get full-scale accelerometer range.
 * The FS_SEL parameter allows setting the full-scale range of the accelerometer
 * sensors, as described in the table below.
 *
 * <pre>
 * 0 = +/- 2g
 * 1 = +/- 4g
 * 2 = +/- 8g
 * 3 = +/- 16g
 * </pre>
 *
 * @return Current full-scale accelerometer range setting
 * @see MPU6050_MOD_ACCEL_FS_2
 * @see MPU6050_MOD_RA_ACCEL_CONFIG
 * @see MPU6050_MOD_ACONFIG_AFS_SEL_BIT
 * @see MPU6050_MOD_ACONFIG_AFS_SEL_LENGTH
 */
uint8_t MPU6050_MOD::getFullScaleAccelRange() {
    I2Cdev_mod::readBits(devAddr, MPU6050_MOD_RA_ACCEL_CONFIG, MPU6050_MOD_ACONFIG_AFS_SEL_BIT, MPU6050_MOD_ACONFIG_AFS_SEL_LENGTH, buffer);
    return buffer[0];
}
/** Set full-scale accelerometer range.
 * @param range New full-scale accelerometer range setting
 * @see getFullScaleAccelRange()
 */
void MPU6050_MOD::setFullScaleAccelRange(uint8_t range) {
    I2Cdev_mod::writeBits(devAddr, MPU6050_MOD_RA_ACCEL_CONFIG, MPU6050_MOD_ACONFIG_AFS_SEL_BIT, MPU6050_MOD_ACONFIG_AFS_SEL_LENGTH, range);
}
/** Get the high-pass filter configuration.
 * The DHPF is a filter module in the path leading to motion detectors (Free
 * Fall, Motion threshold, and Zero Motion). The high pass filter output is not
 * available to the data registers (see Figure in Section 8 of the MPU-6000/
 * MPU-6050 Product Specification document).
 *
 * The high pass filter has three modes:
 *
 * <pre>
 *    Reset: The filter output settles to zero within one sample. This
 *           effectively disables the high pass filter. This mode may be toggled
 *           to quickly settle the filter.
 *
 *    On:    The high pass filter will pass signals above the cut off frequency.
 *
 *    Hold:  When triggered, the filter holds the present sample. The filter
 *           output will be the difference between the input sample and the held
 *           sample.
 * </pre>
 *
 * <pre>
 * ACCEL_HPF | Filter Mode | Cut-off Frequency
 * ----------+-------------+------------------
 * 0         | Reset       | None
 * 1         | On          | 5Hz
 * 2         | On          | 2.5Hz
 * 3         | On          | 1.25Hz
 * 4         | On          | 0.63Hz
 * 7         | Hold        | None
 * </pre>
 *
 * @return Current high-pass filter configuration
 * @see MPU6050_MOD_DHPF_RESET
 * @see MPU6050_MOD_RA_ACCEL_CONFIG
 */
uint8_t MPU6050_MOD::getDHPFMode() {
    I2Cdev_mod::readBits(devAddr, MPU6050_MOD_RA_ACCEL_CONFIG, MPU6050_MOD_ACONFIG_ACCEL_HPF_BIT, MPU6050_MOD_ACONFIG_ACCEL_HPF_LENGTH, buffer);
    return buffer[0];
}
/** Set the high-pass filter configuration.
 * @param bandwidth New high-pass filter configuration
 * @see setDHPFMode()
 * @see MPU6050_MOD_DHPF_RESET
 * @see MPU6050_MOD_RA_ACCEL_CONFIG
 */
void MPU6050_MOD::setDHPFMode(uint8_t bandwidth) {
    I2Cdev_mod::writeBits(devAddr, MPU6050_MOD_RA_ACCEL_CONFIG, MPU6050_MOD_ACONFIG_ACCEL_HPF_BIT, MPU6050_MOD_ACONFIG_ACCEL_HPF_LENGTH, bandwidth);
}

// FF_THR register

/** Get free-fall event acceleration threshold.
 * This register configures the detection threshold for Free Fall event
 * detection. The unit of FF_THR is 1LSB = 2mg. Free Fall is detected when the
 * absolute value of the accelerometer measurements for the three axes are each
 * less than the detection threshold. This condition increments the Free Fall
 * duration counter (Register 30). The Free Fall interrupt is triggered when the
 * Free Fall duration counter reaches the time specified in FF_DUR.
 *
 * For more details on the Free Fall detection interrupt, see Section 8.2 of the
 * MPU-6000/MPU-6050 Product Specification document as well as Registers 56 and
 * 58 of this document.
 *
 * @return Current free-fall acceleration threshold value (LSB = 2mg)
 * @see MPU6050_MOD_RA_FF_THR
 */
uint8_t MPU6050_MOD::getFreefallDetectionThreshold() {
    I2Cdev_mod::readByte(devAddr, MPU6050_MOD_RA_FF_THR, buffer);
    return buffer[0];
}
/** Get free-fall event acceleration threshold.
 * @param threshold New free-fall acceleration threshold value (LSB = 2mg)
 * @see getFreefallDetectionThreshold()
 * @see MPU6050_MOD_RA_FF_THR
 */
void MPU6050_MOD::setFreefallDetectionThreshold(uint8_t threshold) {
    I2Cdev_mod::writeByte(devAddr, MPU6050_MOD_RA_FF_THR, threshold);
}

// FF_DUR register

/** Get free-fall event duration threshold.
 * This register configures the duration counter threshold for Free Fall event
 * detection. The duration counter ticks at 1kHz, therefore FF_DUR has a unit
 * of 1 LSB = 1 ms.
 *
 * The Free Fall duration counter increments while the absolute value of the
 * accelerometer measurements are each less than the detection threshold
 * (Register 29). The Free Fall interrupt is triggered when the Free Fall
 * duration counter reaches the time specified in this register.
 *
 * For more details on the Free Fall detection interrupt, see Section 8.2 of
 * the MPU-6000/MPU-6050 Product Specification document as well as Registers 56
 * and 58 of this document.
 *
 * @return Current free-fall duration threshold value (LSB = 1ms)
 * @see MPU6050_MOD_RA_FF_DUR
 */
uint8_t MPU6050_MOD::getFreefallDetectionDuration() {
    I2Cdev_mod::readByte(devAddr, MPU6050_MOD_RA_FF_DUR, buffer);
    return buffer[0];
}
/** Get free-fall event duration threshold.
 * @param duration New free-fall duration threshold value (LSB = 1ms)
 * @see getFreefallDetectionDuration()
 * @see MPU6050_MOD_RA_FF_DUR
 */
void MPU6050_MOD::setFreefallDetectionDuration(uint8_t duration) {
    I2Cdev_mod::writeByte(devAddr, MPU6050_MOD_RA_FF_DUR, duration);
}

// MOT_THR register

/** Get motion detection event acceleration threshold.
 * This register configures the detection threshold for Motion interrupt
 * generation. The unit of MOT_THR is 1LSB = 2mg. Motion is detected when the
 * absolute value of any of the accelerometer measurements exceeds this Motion
 * detection threshold. This condition increments the Motion detection duration
 * counter (Register 32). The Motion detection interrupt is triggered when the
 * Motion Detection counter reaches the time count specified in MOT_DUR
 * (Register 32).
 *
 * The Motion interrupt will indicate the axis and polarity of detected motion
 * in MOT_DETECT_STATUS (Register 97).
 *
 * For more details on the Motion detection interrupt, see Section 8.3 of the
 * MPU-6000/MPU-6050 Product Specification document as well as Registers 56 and
 * 58 of this document.
 *
 * @return Current motion detection acceleration threshold value (LSB = 2mg)
 * @see MPU6050_MOD_RA_MOT_THR
 */
uint8_t MPU6050_MOD::getMotionDetectionThreshold() {
    I2Cdev_mod::readByte(devAddr, MPU6050_MOD_RA_MOT_THR, buffer);
    return buffer[0];
}
/** Set motion detection event acceleration threshold.
 * @param threshold New motion detection acceleration threshold value (LSB = 2mg)
 * @see getMotionDetectionThreshold()
 * @see MPU6050_MOD_RA_MOT_THR
 */
void MPU6050_MOD::setMotionDetectionThreshold(uint8_t threshold) {
    I2Cdev_mod::writeByte(devAddr, MPU6050_MOD_RA_MOT_THR, threshold);
}

// MOT_DUR register

/** Get motion detection event duration threshold.
 * This register configures the duration counter threshold for Motion interrupt
 * generation. The duration counter ticks at 1 kHz, therefore MOT_DUR has a unit
 * of 1LSB = 1ms. The Motion detection duration counter increments when the
 * absolute value of any of the accelerometer measurements exceeds the Motion
 * detection threshold (Register 31). The Motion detection interrupt is
 * triggered when the Motion detection counter reaches the time count specified
 * in this register.
 *
 * For more details on the Motion detection interrupt, see Section 8.3 of the
 * MPU-6000/MPU-6050 Product Specification document.
 *
 * @return Current motion detection duration threshold value (LSB = 1ms)
 * @see MPU6050_MOD_RA_MOT_DUR
 */
uint8_t MPU6050_MOD::getMotionDetectionDuration() {
    I2Cdev_mod::readByte(devAddr, MPU6050_MOD_RA_MOT_DUR, buffer);
    return buffer[0];
}
/** Set motion detection event duration threshold.
 * @param duration New motion detection duration threshold value (LSB = 1ms)
 * @see getMotionDetectionDuration()
 * @see MPU6050_MOD_RA_MOT_DUR
 */
void MPU6050_MOD::setMotionDetectionDuration(uint8_t duration) {
    I2Cdev_mod::writeByte(devAddr, MPU6050_MOD_RA_MOT_DUR, duration);
}

// ZRMOT_THR register

/** Get zero motion detection event acceleration threshold.
 * This register configures the detection threshold for Zero Motion interrupt
 * generation. The unit of ZRMOT_THR is 1LSB = 2mg. Zero Motion is detected when
 * the absolute value of the accelerometer measurements for the 3 axes are each
 * less than the detection threshold. This condition increments the Zero Motion
 * duration counter (Register 34). The Zero Motion interrupt is triggered when
 * the Zero Motion duration counter reaches the time count specified in
 * ZRMOT_DUR (Register 34).
 *
 * Unlike Free Fall or Motion detection, Zero Motion detection triggers an
 * interrupt both when Zero Motion is first detected and when Zero Motion is no
 * longer detected.
 *
 * When a zero motion event is detected, a Zero Motion Status will be indicated
 * in the MOT_DETECT_STATUS register (Register 97). When a motion-to-zero-motion
 * condition is detected, the status bit is set to 1. When a zero-motion-to-
 * motion condition is detected, the status bit is set to 0.
 *
 * For more details on the Zero Motion detection interrupt, see Section 8.4 of
 * the MPU-6000/MPU-6050 Product Specification document as well as Registers 56
 * and 58 of this document.
 *
 * @return Current zero motion detection acceleration threshold value (LSB = 2mg)
 * @see MPU6050_MOD_RA_ZRMOT_THR
 */
uint8_t MPU6050_MOD::getZeroMotionDetectionThreshold() {
    I2Cdev_mod::readByte(devAddr, MPU6050_MOD_RA_ZRMOT_THR, buffer);
    return buffer[0];
}
/** Set zero motion detection event acceleration threshold.
 * @param threshold New zero motion detection acceleration threshold value (LSB = 2mg)
 * @see getZeroMotionDetectionThreshold()
 * @see MPU6050_MOD_RA_ZRMOT_THR
 */
void MPU6050_MOD::setZeroMotionDetectionThreshold(uint8_t threshold) {
    I2Cdev_mod::writeByte(devAddr, MPU6050_MOD_RA_ZRMOT_THR, threshold);
}

// ZRMOT_DUR register

/** Get zero motion detection event duration threshold.
 * This register configures the duration counter threshold for Zero Motion
 * interrupt generation. The duration counter ticks at 16 Hz, therefore
 * ZRMOT_DUR has a unit of 1 LSB = 64 ms. The Zero Motion duration counter
 * increments while the absolute value of the accelerometer measurements are
 * each less than the detection threshold (Register 33). The Zero Motion
 * interrupt is triggered when the Zero Motion duration counter reaches the time
 * count specified in this register.
 *
 * For more details on the Zero Motion detection interrupt, see Section 8.4 of
 * the MPU-6000/MPU-6050 Product Specification document, as well as Registers 56
 * and 58 of this document.
 *
 * @return Current zero motion detection duration threshold value (LSB = 64ms)
 * @see MPU6050_MOD_RA_ZRMOT_DUR
 */
uint8_t MPU6050_MOD::getZeroMotionDetectionDuration() {
    I2Cdev_mod::readByte(devAddr, MPU6050_MOD_RA_ZRMOT_DUR, buffer);
    return buffer[0];
}
/** Set zero motion detection event duration threshold.
 * @param duration New zero motion detection duration threshold value (LSB = 1ms)
 * @see getZeroMotionDetectionDuration()
 * @see MPU6050_MOD_RA_ZRMOT_DUR
 */
void MPU6050_MOD::setZeroMotionDetectionDuration(uint8_t duration) {
    I2Cdev_mod::writeByte(devAddr, MPU6050_MOD_RA_ZRMOT_DUR, duration);
}

// FIFO_EN register

/** Get temperature FIFO enabled value.
 * When set to 1, this bit enables TEMP_OUT_H and TEMP_OUT_L (Registers 65 and
 * 66) to be written into the FIFO buffer.
 * @return Current temperature FIFO enabled value
 * @see MPU6050_MOD_RA_FIFO_EN
 */
bool MPU6050_MOD::getTempFIFOEnabled() {
    I2Cdev_mod::readBit(devAddr, MPU6050_MOD_RA_FIFO_EN, MPU6050_MOD_TEMP_FIFO_EN_BIT, buffer);
    return buffer[0];
}
/** Set temperature FIFO enabled value.
 * @param enabled New temperature FIFO enabled value
 * @see getTempFIFOEnabled()
 * @see MPU6050_MOD_RA_FIFO_EN
 */
void MPU6050_MOD::setTempFIFOEnabled(bool enabled) {
    I2Cdev_mod::writeBit(devAddr, MPU6050_MOD_RA_FIFO_EN, MPU6050_MOD_TEMP_FIFO_EN_BIT, enabled);
}
/** Get gyroscope X-axis FIFO enabled value.
 * When set to 1, this bit enables GYRO_XOUT_H and GYRO_XOUT_L (Registers 67 and
 * 68) to be written into the FIFO buffer.
 * @return Current gyroscope X-axis FIFO enabled value
 * @see MPU6050_MOD_RA_FIFO_EN
 */
bool MPU6050_MOD::getXGyroFIFOEnabled() {
    I2Cdev_mod::readBit(devAddr, MPU6050_MOD_RA_FIFO_EN, MPU6050_MOD_XG_FIFO_EN_BIT, buffer);
    return buffer[0];
}
/** Set gyroscope X-axis FIFO enabled value.
 * @param enabled New gyroscope X-axis FIFO enabled value
 * @see getXGyroFIFOEnabled()
 * @see MPU6050_MOD_RA_FIFO_EN
 */
void MPU6050_MOD::setXGyroFIFOEnabled(bool enabled) {
    I2Cdev_mod::writeBit(devAddr, MPU6050_MOD_RA_FIFO_EN, MPU6050_MOD_XG_FIFO_EN_BIT, enabled);
}
/** Get gyroscope Y-axis FIFO enabled value.
 * When set to 1, this bit enables GYRO_YOUT_H and GYRO_YOUT_L (Registers 69 and
 * 70) to be written into the FIFO buffer.
 * @return Current gyroscope Y-axis FIFO enabled value
 * @see MPU6050_MOD_RA_FIFO_EN
 */
bool MPU6050_MOD::getYGyroFIFOEnabled() {
    I2Cdev_mod::readBit(devAddr, MPU6050_MOD_RA_FIFO_EN, MPU6050_MOD_YG_FIFO_EN_BIT, buffer);
    return buffer[0];
}
/** Set gyroscope Y-axis FIFO enabled value.
 * @param enabled New gyroscope Y-axis FIFO enabled value
 * @see getYGyroFIFOEnabled()
 * @see MPU6050_MOD_RA_FIFO_EN
 */
void MPU6050_MOD::setYGyroFIFOEnabled(bool enabled) {
    I2Cdev_mod::writeBit(devAddr, MPU6050_MOD_RA_FIFO_EN, MPU6050_MOD_YG_FIFO_EN_BIT, enabled);
}
/** Get gyroscope Z-axis FIFO enabled value.
 * When set to 1, this bit enables GYRO_ZOUT_H and GYRO_ZOUT_L (Registers 71 and
 * 72) to be written into the FIFO buffer.
 * @return Current gyroscope Z-axis FIFO enabled value
 * @see MPU6050_MOD_RA_FIFO_EN
 */
bool MPU6050_MOD::getZGyroFIFOEnabled() {
    I2Cdev_mod::readBit(devAddr, MPU6050_MOD_RA_FIFO_EN, MPU6050_MOD_ZG_FIFO_EN_BIT, buffer);
    return buffer[0];
}
/** Set gyroscope Z-axis FIFO enabled value.
 * @param enabled New gyroscope Z-axis FIFO enabled value
 * @see getZGyroFIFOEnabled()
 * @see MPU6050_MOD_RA_FIFO_EN
 */
void MPU6050_MOD::setZGyroFIFOEnabled(bool enabled) {
    I2Cdev_mod::writeBit(devAddr, MPU6050_MOD_RA_FIFO_EN, MPU6050_MOD_ZG_FIFO_EN_BIT, enabled);
}
/** Get accelerometer FIFO enabled value.
 * When set to 1, this bit enables ACCEL_XOUT_H, ACCEL_XOUT_L, ACCEL_YOUT_H,
 * ACCEL_YOUT_L, ACCEL_ZOUT_H, and ACCEL_ZOUT_L (Registers 59 to 64) to be
 * written into the FIFO buffer.
 * @return Current accelerometer FIFO enabled value
 * @see MPU6050_MOD_RA_FIFO_EN
 */
bool MPU6050_MOD::getAccelFIFOEnabled() {
    I2Cdev_mod::readBit(devAddr, MPU6050_MOD_RA_FIFO_EN, MPU6050_MOD_ACCEL_FIFO_EN_BIT, buffer);
    return buffer[0];
}
/** Set accelerometer FIFO enabled value.
 * @param enabled New accelerometer FIFO enabled value
 * @see getAccelFIFOEnabled()
 * @see MPU6050_MOD_RA_FIFO_EN
 */
void MPU6050_MOD::setAccelFIFOEnabled(bool enabled) {
    I2Cdev_mod::writeBit(devAddr, MPU6050_MOD_RA_FIFO_EN, MPU6050_MOD_ACCEL_FIFO_EN_BIT, enabled);
}
/** Get Slave 2 FIFO enabled value.
 * When set to 1, this bit enables EXT_SENS_DATA registers (Registers 73 to 96)
 * associated with Slave 2 to be written into the FIFO buffer.
 * @return Current Slave 2 FIFO enabled value
 * @see MPU6050_MOD_RA_FIFO_EN
 */
bool MPU6050_MOD::getSlave2FIFOEnabled() {
    I2Cdev_mod::readBit(devAddr, MPU6050_MOD_RA_FIFO_EN, MPU6050_MOD_SLV2_FIFO_EN_BIT, buffer);
    return buffer[0];
}
/** Set Slave 2 FIFO enabled value.
 * @param enabled New Slave 2 FIFO enabled value
 * @see getSlave2FIFOEnabled()
 * @see MPU6050_MOD_RA_FIFO_EN
 */
void MPU6050_MOD::setSlave2FIFOEnabled(bool enabled) {
    I2Cdev_mod::writeBit(devAddr, MPU6050_MOD_RA_FIFO_EN, MPU6050_MOD_SLV2_FIFO_EN_BIT, enabled);
}
/** Get Slave 1 FIFO enabled value.
 * When set to 1, this bit enables EXT_SENS_DATA registers (Registers 73 to 96)
 * associated with Slave 1 to be written into the FIFO buffer.
 * @return Current Slave 1 FIFO enabled value
 * @see MPU6050_MOD_RA_FIFO_EN
 */
bool MPU6050_MOD::getSlave1FIFOEnabled() {
    I2Cdev_mod::readBit(devAddr, MPU6050_MOD_RA_FIFO_EN, MPU6050_MOD_SLV1_FIFO_EN_BIT, buffer);
    return buffer[0];
}
/** Set Slave 1 FIFO enabled value.
 * @param enabled New Slave 1 FIFO enabled value
 * @see getSlave1FIFOEnabled()
 * @see MPU6050_MOD_RA_FIFO_EN
 */
void MPU6050_MOD::setSlave1FIFOEnabled(bool enabled) {
    I2Cdev_mod::writeBit(devAddr, MPU6050_MOD_RA_FIFO_EN, MPU6050_MOD_SLV1_FIFO_EN_BIT, enabled);
}
/** Get Slave 0 FIFO enabled value.
 * When set to 1, this bit enables EXT_SENS_DATA registers (Registers 73 to 96)
 * associated with Slave 0 to be written into the FIFO buffer.
 * @return Current Slave 0 FIFO enabled value
 * @see MPU6050_MOD_RA_FIFO_EN
 */
bool MPU6050_MOD::getSlave0FIFOEnabled() {
    I2Cdev_mod::readBit(devAddr, MPU6050_MOD_RA_FIFO_EN, MPU6050_MOD_SLV0_FIFO_EN_BIT, buffer);
    return buffer[0];
}
/** Set Slave 0 FIFO enabled value.
 * @param enabled New Slave 0 FIFO enabled value
 * @see getSlave0FIFOEnabled()
 * @see MPU6050_MOD_RA_FIFO_EN
 */
void MPU6050_MOD::setSlave0FIFOEnabled(bool enabled) {
    I2Cdev_mod::writeBit(devAddr, MPU6050_MOD_RA_FIFO_EN, MPU6050_MOD_SLV0_FIFO_EN_BIT, enabled);
}

// I2C_MST_CTRL register

/** Get multi-master enabled value.
 * Multi-master capability allows multiple I2C masters to operate on the same
 * bus. In circuits where multi-master capability is required, set MULT_MST_EN
 * to 1. This will increase current drawn by approximately 30uA.
 *
 * In circuits where multi-master capability is required, the state of the I2C
 * bus must always be monitored by each separate I2C Master. Before an I2C
 * Master can assume arbitration of the bus, it must first confirm that no other
 * I2C Master has arbitration of the bus. When MULT_MST_EN is set to 1, the
 * MPU-60X0's bus arbitration detection logic is turned on, enabling it to
 * detect when the bus is available.
 *
 * @return Current multi-master enabled value
 * @see MPU6050_MOD_RA_I2C_MST_CTRL
 */
bool MPU6050_MOD::getMultiMasterEnabled() {
    I2Cdev_mod::readBit(devAddr, MPU6050_MOD_RA_I2C_MST_CTRL, MPU6050_MOD_MULT_MST_EN_BIT, buffer);
    return buffer[0];
}
/** Set multi-master enabled value.
 * @param enabled New multi-master enabled value
 * @see getMultiMasterEnabled()
 * @see MPU6050_MOD_RA_I2C_MST_CTRL
 */
void MPU6050_MOD::setMultiMasterEnabled(bool enabled) {
    I2Cdev_mod::writeBit(devAddr, MPU6050_MOD_RA_I2C_MST_CTRL, MPU6050_MOD_MULT_MST_EN_BIT, enabled);
}
/** Get wait-for-external-sensor-data enabled value.
 * When the WAIT_FOR_ES bit is set to 1, the Data Ready interrupt will be
 * delayed until External Sensor data from the Slave Devices are loaded into the
 * EXT_SENS_DATA registers. This is used to ensure that both the internal sensor
 * data (i.e. from gyro and accel) and external sensor data have been loaded to
 * their respective data registers (i.e. the data is synced) when the Data Ready
 * interrupt is triggered.
 *
 * @return Current wait-for-external-sensor-data enabled value
 * @see MPU6050_MOD_RA_I2C_MST_CTRL
 */
bool MPU6050_MOD::getWaitForExternalSensorEnabled() {
    I2Cdev_mod::readBit(devAddr, MPU6050_MOD_RA_I2C_MST_CTRL, MPU6050_MOD_WAIT_FOR_ES_BIT, buffer);
    return buffer[0];
}
/** Set wait-for-external-sensor-data enabled value.
 * @param enabled New wait-for-external-sensor-data enabled value
 * @see getWaitForExternalSensorEnabled()
 * @see MPU6050_MOD_RA_I2C_MST_CTRL
 */
void MPU6050_MOD::setWaitForExternalSensorEnabled(bool enabled) {
    I2Cdev_mod::writeBit(devAddr, MPU6050_MOD_RA_I2C_MST_CTRL, MPU6050_MOD_WAIT_FOR_ES_BIT, enabled);
}
/** Get Slave 3 FIFO enabled value.
 * When set to 1, this bit enables EXT_SENS_DATA registers (Registers 73 to 96)
 * associated with Slave 3 to be written into the FIFO buffer.
 * @return Current Slave 3 FIFO enabled value
 * @see MPU6050_MOD_RA_MST_CTRL
 */
bool MPU6050_MOD::getSlave3FIFOEnabled() {
    I2Cdev_mod::readBit(devAddr, MPU6050_MOD_RA_I2C_MST_CTRL, MPU6050_MOD_SLV_3_FIFO_EN_BIT, buffer);
    return buffer[0];
}
/** Set Slave 3 FIFO enabled value.
 * @param enabled New Slave 3 FIFO enabled value
 * @see getSlave3FIFOEnabled()
 * @see MPU6050_MOD_RA_MST_CTRL
 */
void MPU6050_MOD::setSlave3FIFOEnabled(bool enabled) {
    I2Cdev_mod::writeBit(devAddr, MPU6050_MOD_RA_I2C_MST_CTRL, MPU6050_MOD_SLV_3_FIFO_EN_BIT, enabled);
}
/** Get slave read/write transition enabled value.
 * The I2C_MST_P_NSR bit configures the I2C Master's transition from one slave
 * read to the next slave read. If the bit equals 0, there will be a restart
 * between reads. If the bit equals 1, there will be a stop followed by a start
 * of the following read. When a write transaction follows a read transaction,
 * the stop followed by a start of the successive write will be always used.
 *
 * @return Current slave read/write transition enabled value
 * @see MPU6050_MOD_RA_I2C_MST_CTRL
 */
bool MPU6050_MOD::getSlaveReadWriteTransitionEnabled() {
    I2Cdev_mod::readBit(devAddr, MPU6050_MOD_RA_I2C_MST_CTRL, MPU6050_MOD_I2C_MST_P_NSR_BIT, buffer);
    return buffer[0];
}
/** Set slave read/write transition enabled value.
 * @param enabled New slave read/write transition enabled value
 * @see getSlaveReadWriteTransitionEnabled()
 * @see MPU6050_MOD_RA_I2C_MST_CTRL
 */
void MPU6050_MOD::setSlaveReadWriteTransitionEnabled(bool enabled) {
    I2Cdev_mod::writeBit(devAddr, MPU6050_MOD_RA_I2C_MST_CTRL, MPU6050_MOD_I2C_MST_P_NSR_BIT, enabled);
}
/** Get I2C master clock speed.
 * I2C_MST_CLK is a 4 bit unsigned value which configures a divider on the
 * MPU-60X0 internal 8MHz clock. It sets the I2C master clock speed according to
 * the following table:
 *
 * <pre>
 * I2C_MST_CLK | I2C Master Clock Speed | 8MHz Clock Divider
 * ------------+------------------------+-------------------
 * 0           | 348kHz                 | 23
 * 1           | 333kHz                 | 24
 * 2           | 320kHz                 | 25
 * 3           | 308kHz                 | 26
 * 4           | 296kHz                 | 27
 * 5           | 286kHz                 | 28
 * 6           | 276kHz                 | 29
 * 7           | 267kHz                 | 30
 * 8           | 258kHz                 | 31
 * 9           | 500kHz                 | 16
 * 10          | 471kHz                 | 17
 * 11          | 444kHz                 | 18
 * 12          | 421kHz                 | 19
 * 13          | 400kHz                 | 20
 * 14          | 381kHz                 | 21
 * 15          | 364kHz                 | 22
 * </pre>
 *
 * @return Current I2C master clock speed
 * @see MPU6050_MOD_RA_I2C_MST_CTRL
 */
uint8_t MPU6050_MOD::getMasterClockSpeed() {
    I2Cdev_mod::readBits(devAddr, MPU6050_MOD_RA_I2C_MST_CTRL, MPU6050_MOD_I2C_MST_CLK_BIT, MPU6050_MOD_I2C_MST_CLK_LENGTH, buffer);
    return buffer[0];
}
/** Set I2C master clock speed.
 * @reparam speed Current I2C master clock speed
 * @see MPU6050_MOD_RA_I2C_MST_CTRL
 */
void MPU6050_MOD::setMasterClockSpeed(uint8_t speed) {
    I2Cdev_mod::writeBits(devAddr, MPU6050_MOD_RA_I2C_MST_CTRL, MPU6050_MOD_I2C_MST_CLK_BIT, MPU6050_MOD_I2C_MST_CLK_LENGTH, speed);
}

// I2C_SLV* registers (Slave 0-3)

/** Get the I2C address of the specified slave (0-3).
 * Note that Bit 7 (MSB) controls read/write mode. If Bit 7 is set, it's a read
 * operation, and if it is cleared, then it's a write operation. The remaining
 * bits (6-0) are the 7-bit device address of the slave device.
 *
 * In read mode, the result of the read is placed in the lowest available 
 * EXT_SENS_DATA register. For further information regarding the allocation of
 * read results, please refer to the EXT_SENS_DATA register description
 * (Registers 73 - 96).
 *
 * The MPU-6050 supports a total of five slaves, but Slave 4 has unique
 * characteristics, and so it has its own functions (getSlave4* and setSlave4*).
 *
 * I2C data transactions are performed at the Sample Rate, as defined in
 * Register 25. The user is responsible for ensuring that I2C data transactions
 * to and from each enabled Slave can be completed within a single period of the
 * Sample Rate.
 *
 * The I2C slave access rate can be reduced relative to the Sample Rate. This
 * reduced access rate is determined by I2C_MST_DLY (Register 52). Whether a
 * slave's access rate is reduced relative to the Sample Rate is determined by
 * I2C_MST_DELAY_CTRL (Register 103).
 *
 * The processing order for the slaves is fixed. The sequence followed for
 * processing the slaves is Slave 0, Slave 1, Slave 2, Slave 3 and Slave 4. If a
 * particular Slave is disabled it will be skipped.
 *
 * Each slave can either be accessed at the sample rate or at a reduced sample
 * rate. In a case where some slaves are accessed at the Sample Rate and some
 * slaves are accessed at the reduced rate, the sequence of accessing the slaves
 * (Slave 0 to Slave 4) is still followed. However, the reduced rate slaves will
 * be skipped if their access rate dictates that they should not be accessed
 * during that particular cycle. For further information regarding the reduced
 * access rate, please refer to Register 52. Whether a slave is accessed at the
 * Sample Rate or at the reduced rate is determined by the Delay Enable bits in
 * Register 103.
 *
 * @param num Slave number (0-3)
 * @return Current address for specified slave
 * @see MPU6050_MOD_RA_I2C_SLV0_ADDR
 */
uint8_t MPU6050_MOD::getSlaveAddress(uint8_t num) {
    if (num > 3) return 0;
    I2Cdev_mod::readByte(devAddr, MPU6050_MOD_RA_I2C_SLV0_ADDR + num*3, buffer);
    return buffer[0];
}
/** Set the I2C address of the specified slave (0-3).
 * @param num Slave number (0-3)
 * @param address New address for specified slave
 * @see getSlaveAddress()
 * @see MPU6050_MOD_RA_I2C_SLV0_ADDR
 */
void MPU6050_MOD::setSlaveAddress(uint8_t num, uint8_t address) {
    if (num > 3) return;
    I2Cdev_mod::writeByte(devAddr, MPU6050_MOD_RA_I2C_SLV0_ADDR + num*3, address);
}
/** Get the active internal register for the specified slave (0-3).
 * Read/write operations for this slave will be done to whatever internal
 * register address is stored in this MPU register.
 *
 * The MPU-6050 supports a total of five slaves, but Slave 4 has unique
 * characteristics, and so it has its own functions.
 *
 * @param num Slave number (0-3)
 * @return Current active register for specified slave
 * @see MPU6050_MOD_RA_I2C_SLV0_REG
 */
uint8_t MPU6050_MOD::getSlaveRegister(uint8_t num) {
    if (num > 3) return 0;
    I2Cdev_mod::readByte(devAddr, MPU6050_MOD_RA_I2C_SLV0_REG + num*3, buffer);
    return buffer[0];
}
/** Set the active internal register for the specified slave (0-3).
 * @param num Slave number (0-3)
 * @param reg New active register for specified slave
 * @see getSlaveRegister()
 * @see MPU6050_MOD_RA_I2C_SLV0_REG
 */
void MPU6050_MOD::setSlaveRegister(uint8_t num, uint8_t reg) {
    if (num > 3) return;
    I2Cdev_mod::writeByte(devAddr, MPU6050_MOD_RA_I2C_SLV0_REG + num*3, reg);
}
/** Get the enabled value for the specified slave (0-3).
 * When set to 1, this bit enables Slave 0 for data transfer operations. When
 * cleared to 0, this bit disables Slave 0 from data transfer operations.
 * @param num Slave number (0-3)
 * @return Current enabled value for specified slave
 * @see MPU6050_MOD_RA_I2C_SLV0_CTRL
 */
bool MPU6050_MOD::getSlaveEnabled(uint8_t num) {
    if (num > 3) return 0;
    I2Cdev_mod::readBit(devAddr, MPU6050_MOD_RA_I2C_SLV0_CTRL + num*3, MPU6050_MOD_I2C_SLV_EN_BIT, buffer);
    return buffer[0];
}
/** Set the enabled value for the specified slave (0-3).
 * @param num Slave number (0-3)
 * @param enabled New enabled value for specified slave
 * @see getSlaveEnabled()
 * @see MPU6050_MOD_RA_I2C_SLV0_CTRL
 */
void MPU6050_MOD::setSlaveEnabled(uint8_t num, bool enabled) {
    if (num > 3) return;
    I2Cdev_mod::writeBit(devAddr, MPU6050_MOD_RA_I2C_SLV0_CTRL + num*3, MPU6050_MOD_I2C_SLV_EN_BIT, enabled);
}
/** Get word pair byte-swapping enabled for the specified slave (0-3).
 * When set to 1, this bit enables byte swapping. When byte swapping is enabled,
 * the high and low bytes of a word pair are swapped. Please refer to
 * I2C_SLV0_GRP for the pairing convention of the word pairs. When cleared to 0,
 * bytes transferred to and from Slave 0 will be written to EXT_SENS_DATA
 * registers in the order they were transferred.
 *
 * @param num Slave number (0-3)
 * @return Current word pair byte-swapping enabled value for specified slave
 * @see MPU6050_MOD_RA_I2C_SLV0_CTRL
 */
bool MPU6050_MOD::getSlaveWordByteSwap(uint8_t num) {
    if (num > 3) return 0;
    I2Cdev_mod::readBit(devAddr, MPU6050_MOD_RA_I2C_SLV0_CTRL + num*3, MPU6050_MOD_I2C_SLV_BYTE_SW_BIT, buffer);
    return buffer[0];
}
/** Set word pair byte-swapping enabled for the specified slave (0-3).
 * @param num Slave number (0-3)
 * @param enabled New word pair byte-swapping enabled value for specified slave
 * @see getSlaveWordByteSwap()
 * @see MPU6050_MOD_RA_I2C_SLV0_CTRL
 */
void MPU6050_MOD::setSlaveWordByteSwap(uint8_t num, bool enabled) {
    if (num > 3) return;
    I2Cdev_mod::writeBit(devAddr, MPU6050_MOD_RA_I2C_SLV0_CTRL + num*3, MPU6050_MOD_I2C_SLV_BYTE_SW_BIT, enabled);
}
/** Get write mode for the specified slave (0-3).
 * When set to 1, the transaction will read or write data only. When cleared to
 * 0, the transaction will write a register address prior to reading or writing
 * data. This should equal 0 when specifying the register address within the
 * Slave device to/from which the ensuing data transaction will take place.
 *
 * @param num Slave number (0-3)
 * @return Current write mode for specified slave (0 = register address + data, 1 = data only)
 * @see MPU6050_MOD_RA_I2C_SLV0_CTRL
 */
bool MPU6050_MOD::getSlaveWriteMode(uint8_t num) {
    if (num > 3) return 0;
    I2Cdev_mod::readBit(devAddr, MPU6050_MOD_RA_I2C_SLV0_CTRL + num*3, MPU6050_MOD_I2C_SLV_REG_DIS_BIT, buffer);
    return buffer[0];
}
/** Set write mode for the specified slave (0-3).
 * @param num Slave number (0-3)
 * @param mode New write mode for specified slave (0 = register address + data, 1 = data only)
 * @see getSlaveWriteMode()
 * @see MPU6050_MOD_RA_I2C_SLV0_CTRL
 */
void MPU6050_MOD::setSlaveWriteMode(uint8_t num, bool mode) {
    if (num > 3) return;
    I2Cdev_mod::writeBit(devAddr, MPU6050_MOD_RA_I2C_SLV0_CTRL + num*3, MPU6050_MOD_I2C_SLV_REG_DIS_BIT, mode);
}
/** Get word pair grouping order offset for the specified slave (0-3).
 * This sets specifies the grouping order of word pairs received from registers.
 * When cleared to 0, bytes from register addresses 0 and 1, 2 and 3, etc (even,
 * then odd register addresses) are paired to form a word. When set to 1, bytes
 * from register addresses are paired 1 and 2, 3 and 4, etc. (odd, then even
 * register addresses) are paired to form a word.
 *
 * @param num Slave number (0-3)
 * @return Current word pair grouping order offset for specified slave
 * @see MPU6050_MOD_RA_I2C_SLV0_CTRL
 */
bool MPU6050_MOD::getSlaveWordGroupOffset(uint8_t num) {
    if (num > 3) return 0;
    I2Cdev_mod::readBit(devAddr, MPU6050_MOD_RA_I2C_SLV0_CTRL + num*3, MPU6050_MOD_I2C_SLV_GRP_BIT, buffer);
    return buffer[0];
}
/** Set word pair grouping order offset for the specified slave (0-3).
 * @param num Slave number (0-3)
 * @param enabled New word pair grouping order offset for specified slave
 * @see getSlaveWordGroupOffset()
 * @see MPU6050_MOD_RA_I2C_SLV0_CTRL
 */
void MPU6050_MOD::setSlaveWordGroupOffset(uint8_t num, bool enabled) {
    if (num > 3) return;
    I2Cdev_mod::writeBit(devAddr, MPU6050_MOD_RA_I2C_SLV0_CTRL + num*3, MPU6050_MOD_I2C_SLV_GRP_BIT, enabled);
}
/** Get number of bytes to read for the specified slave (0-3).
 * Specifies the number of bytes transferred to and from Slave 0. Clearing this
 * bit to 0 is equivalent to disabling the register by writing 0 to I2C_SLV0_EN.
 * @param num Slave number (0-3)
 * @return Number of bytes to read for specified slave
 * @see MPU6050_MOD_RA_I2C_SLV0_CTRL
 */
uint8_t MPU6050_MOD::getSlaveDataLength(uint8_t num) {
    if (num > 3) return 0;
    I2Cdev_mod::readBits(devAddr, MPU6050_MOD_RA_I2C_SLV0_CTRL + num*3, MPU6050_MOD_I2C_SLV_LEN_BIT, MPU6050_MOD_I2C_SLV_LEN_LENGTH, buffer);
    return buffer[0];
}
/** Set number of bytes to read for the specified slave (0-3).
 * @param num Slave number (0-3)
 * @param length Number of bytes to read for specified slave
 * @see getSlaveDataLength()
 * @see MPU6050_MOD_RA_I2C_SLV0_CTRL
 */
void MPU6050_MOD::setSlaveDataLength(uint8_t num, uint8_t length) {
    if (num > 3) return;
    I2Cdev_mod::writeBits(devAddr, MPU6050_MOD_RA_I2C_SLV0_CTRL + num*3, MPU6050_MOD_I2C_SLV_LEN_BIT, MPU6050_MOD_I2C_SLV_LEN_LENGTH, length);
}

// I2C_SLV* registers (Slave 4)

/** Get the I2C address of Slave 4.
 * Note that Bit 7 (MSB) controls read/write mode. If Bit 7 is set, it's a read
 * operation, and if it is cleared, then it's a write operation. The remaining
 * bits (6-0) are the 7-bit device address of the slave device.
 *
 * @return Current address for Slave 4
 * @see getSlaveAddress()
 * @see MPU6050_MOD_RA_I2C_SLV4_ADDR
 */
uint8_t MPU6050_MOD::getSlave4Address() {
    I2Cdev_mod::readByte(devAddr, MPU6050_MOD_RA_I2C_SLV4_ADDR, buffer);
    return buffer[0];
}
/** Set the I2C address of Slave 4.
 * @param address New address for Slave 4
 * @see getSlave4Address()
 * @see MPU6050_MOD_RA_I2C_SLV4_ADDR
 */
void MPU6050_MOD::setSlave4Address(uint8_t address) {
    I2Cdev_mod::writeByte(devAddr, MPU6050_MOD_RA_I2C_SLV4_ADDR, address);
}
/** Get the active internal register for the Slave 4.
 * Read/write operations for this slave will be done to whatever internal
 * register address is stored in this MPU register.
 *
 * @return Current active register for Slave 4
 * @see MPU6050_MOD_RA_I2C_SLV4_REG
 */
uint8_t MPU6050_MOD::getSlave4Register() {
    I2Cdev_mod::readByte(devAddr, MPU6050_MOD_RA_I2C_SLV4_REG, buffer);
    return buffer[0];
}
/** Set the active internal register for Slave 4.
 * @param reg New active register for Slave 4
 * @see getSlave4Register()
 * @see MPU6050_MOD_RA_I2C_SLV4_REG
 */
void MPU6050_MOD::setSlave4Register(uint8_t reg) {
    I2Cdev_mod::writeByte(devAddr, MPU6050_MOD_RA_I2C_SLV4_REG, reg);
}
/** Set new byte to write to Slave 4.
 * This register stores the data to be written into the Slave 4. If I2C_SLV4_RW
 * is set 1 (set to read), this register has no effect.
 * @param data New byte to write to Slave 4
 * @see MPU6050_MOD_RA_I2C_SLV4_DO
 */
void MPU6050_MOD::setSlave4OutputByte(uint8_t data) {
    I2Cdev_mod::writeByte(devAddr, MPU6050_MOD_RA_I2C_SLV4_DO, data);
}
/** Get the enabled value for the Slave 4.
 * When set to 1, this bit enables Slave 4 for data transfer operations. When
 * cleared to 0, this bit disables Slave 4 from data transfer operations.
 * @return Current enabled value for Slave 4
 * @see MPU6050_MOD_RA_I2C_SLV4_CTRL
 */
bool MPU6050_MOD::getSlave4Enabled() {
    I2Cdev_mod::readBit(devAddr, MPU6050_MOD_RA_I2C_SLV4_CTRL, MPU6050_MOD_I2C_SLV4_EN_BIT, buffer);
    return buffer[0];
}
/** Set the enabled value for Slave 4.
 * @param enabled New enabled value for Slave 4
 * @see getSlave4Enabled()
 * @see MPU6050_MOD_RA_I2C_SLV4_CTRL
 */
void MPU6050_MOD::setSlave4Enabled(bool enabled) {
    I2Cdev_mod::writeBit(devAddr, MPU6050_MOD_RA_I2C_SLV4_CTRL, MPU6050_MOD_I2C_SLV4_EN_BIT, enabled);
}
/** Get the enabled value for Slave 4 transaction interrupts.
 * When set to 1, this bit enables the generation of an interrupt signal upon
 * completion of a Slave 4 transaction. When cleared to 0, this bit disables the
 * generation of an interrupt signal upon completion of a Slave 4 transaction.
 * The interrupt status can be observed in Register 54.
 *
 * @return Current enabled value for Slave 4 transaction interrupts.
 * @see MPU6050_MOD_RA_I2C_SLV4_CTRL
 */
bool MPU6050_MOD::getSlave4InterruptEnabled() {
    I2Cdev_mod::readBit(devAddr, MPU6050_MOD_RA_I2C_SLV4_CTRL, MPU6050_MOD_I2C_SLV4_INT_EN_BIT, buffer);
    return buffer[0];
}
/** Set the enabled value for Slave 4 transaction interrupts.
 * @param enabled New enabled value for Slave 4 transaction interrupts.
 * @see getSlave4InterruptEnabled()
 * @see MPU6050_MOD_RA_I2C_SLV4_CTRL
 */
void MPU6050_MOD::setSlave4InterruptEnabled(bool enabled) {
    I2Cdev_mod::writeBit(devAddr, MPU6050_MOD_RA_I2C_SLV4_CTRL, MPU6050_MOD_I2C_SLV4_INT_EN_BIT, enabled);
}
/** Get write mode for Slave 4.
 * When set to 1, the transaction will read or write data only. When cleared to
 * 0, the transaction will write a register address prior to reading or writing
 * data. This should equal 0 when specifying the register address within the
 * Slave device to/from which the ensuing data transaction will take place.
 *
 * @return Current write mode for Slave 4 (0 = register address + data, 1 = data only)
 * @see MPU6050_MOD_RA_I2C_SLV4_CTRL
 */
bool MPU6050_MOD::getSlave4WriteMode() {
    I2Cdev_mod::readBit(devAddr, MPU6050_MOD_RA_I2C_SLV4_CTRL, MPU6050_MOD_I2C_SLV4_REG_DIS_BIT, buffer);
    return buffer[0];
}
/** Set write mode for the Slave 4.
 * @param mode New write mode for Slave 4 (0 = register address + data, 1 = data only)
 * @see getSlave4WriteMode()
 * @see MPU6050_MOD_RA_I2C_SLV4_CTRL
 */
void MPU6050_MOD::setSlave4WriteMode(bool mode) {
    I2Cdev_mod::writeBit(devAddr, MPU6050_MOD_RA_I2C_SLV4_CTRL, MPU6050_MOD_I2C_SLV4_REG_DIS_BIT, mode);
}
/** Get Slave 4 master delay value.
 * This configures the reduced access rate of I2C slaves relative to the Sample
 * Rate. When a slave's access rate is decreased relative to the Sample Rate,
 * the slave is accessed every:
 *
 *     1 / (1 + I2C_MST_DLY) samples
 *
 * This base Sample Rate in turn is determined by SMPLRT_DIV (register 25) and
 * DLPF_CFG (register 26). Whether a slave's access rate is reduced relative to
 * the Sample Rate is determined by I2C_MST_DELAY_CTRL (register 103). For
 * further information regarding the Sample Rate, please refer to register 25.
 *
 * @return Current Slave 4 master delay value
 * @see MPU6050_MOD_RA_I2C_SLV4_CTRL
 */
uint8_t MPU6050_MOD::getSlave4MasterDelay() {
    I2Cdev_mod::readBits(devAddr, MPU6050_MOD_RA_I2C_SLV4_CTRL, MPU6050_MOD_I2C_SLV4_MST_DLY_BIT, MPU6050_MOD_I2C_SLV4_MST_DLY_LENGTH, buffer);
    return buffer[0];
}
/** Set Slave 4 master delay value.
 * @param delay New Slave 4 master delay value
 * @see getSlave4MasterDelay()
 * @see MPU6050_MOD_RA_I2C_SLV4_CTRL
 */
void MPU6050_MOD::setSlave4MasterDelay(uint8_t delay) {
    I2Cdev_mod::writeBits(devAddr, MPU6050_MOD_RA_I2C_SLV4_CTRL, MPU6050_MOD_I2C_SLV4_MST_DLY_BIT, MPU6050_MOD_I2C_SLV4_MST_DLY_LENGTH, delay);
}
/** Get last available byte read from Slave 4.
 * This register stores the data read from Slave 4. This field is populated
 * after a read transaction.
 * @return Last available byte read from to Slave 4
 * @see MPU6050_MOD_RA_I2C_SLV4_DI
 */
uint8_t MPU6050_MOD::getSlate4InputByte() {
    I2Cdev_mod::readByte(devAddr, MPU6050_MOD_RA_I2C_SLV4_DI, buffer);
    return buffer[0];
}

// I2C_MST_STATUS register

/** Get FSYNC interrupt status.
 * This bit reflects the status of the FSYNC interrupt from an external device
 * into the MPU-60X0. This is used as a way to pass an external interrupt
 * through the MPU-60X0 to the host application processor. When set to 1, this
 * bit will cause an interrupt if FSYNC_INT_EN is asserted in INT_PIN_CFG
 * (Register 55).
 * @return FSYNC interrupt status
 * @see MPU6050_MOD_RA_I2C_MST_STATUS
 */
bool MPU6050_MOD::getPassthroughStatus() {
    I2Cdev_mod::readBit(devAddr, MPU6050_MOD_RA_I2C_MST_STATUS, MPU6050_MOD_MST_PASS_THROUGH_BIT, buffer);
    return buffer[0];
}
/** Get Slave 4 transaction done status.
 * Automatically sets to 1 when a Slave 4 transaction has completed. This
 * triggers an interrupt if the I2C_MST_INT_EN bit in the INT_ENABLE register
 * (Register 56) is asserted and if the SLV_4_DONE_INT bit is asserted in the
 * I2C_SLV4_CTRL register (Register 52).
 * @return Slave 4 transaction done status
 * @see MPU6050_MOD_RA_I2C_MST_STATUS
 */
bool MPU6050_MOD::getSlave4IsDone() {
    I2Cdev_mod::readBit(devAddr, MPU6050_MOD_RA_I2C_MST_STATUS, MPU6050_MOD_MST_I2C_SLV4_DONE_BIT, buffer);
    return buffer[0];
}
/** Get master arbitration lost status.
 * This bit automatically sets to 1 when the I2C Master has lost arbitration of
 * the auxiliary I2C bus (an error condition). This triggers an interrupt if the
 * I2C_MST_INT_EN bit in the INT_ENABLE register (Register 56) is asserted.
 * @return Master arbitration lost status
 * @see MPU6050_MOD_RA_I2C_MST_STATUS
 */
bool MPU6050_MOD::getLostArbitration() {
    I2Cdev_mod::readBit(devAddr, MPU6050_MOD_RA_I2C_MST_STATUS, MPU6050_MOD_MST_I2C_LOST_ARB_BIT, buffer);
    return buffer[0];
}
/** Get Slave 4 NACK status.
 * This bit automatically sets to 1 when the I2C Master receives a NACK in a
 * transaction with Slave 4. This triggers an interrupt if the I2C_MST_INT_EN
 * bit in the INT_ENABLE register (Register 56) is asserted.
 * @return Slave 4 NACK interrupt status
 * @see MPU6050_MOD_RA_I2C_MST_STATUS
 */
bool MPU6050_MOD::getSlave4Nack() {
    I2Cdev_mod::readBit(devAddr, MPU6050_MOD_RA_I2C_MST_STATUS, MPU6050_MOD_MST_I2C_SLV4_NACK_BIT, buffer);
    return buffer[0];
}
/** Get Slave 3 NACK status.
 * This bit automatically sets to 1 when the I2C Master receives a NACK in a
 * transaction with Slave 3. This triggers an interrupt if the I2C_MST_INT_EN
 * bit in the INT_ENABLE register (Register 56) is asserted.
 * @return Slave 3 NACK interrupt status
 * @see MPU6050_MOD_RA_I2C_MST_STATUS
 */
bool MPU6050_MOD::getSlave3Nack() {
    I2Cdev_mod::readBit(devAddr, MPU6050_MOD_RA_I2C_MST_STATUS, MPU6050_MOD_MST_I2C_SLV3_NACK_BIT, buffer);
    return buffer[0];
}
/** Get Slave 2 NACK status.
 * This bit automatically sets to 1 when the I2C Master receives a NACK in a
 * transaction with Slave 2. This triggers an interrupt if the I2C_MST_INT_EN
 * bit in the INT_ENABLE register (Register 56) is asserted.
 * @return Slave 2 NACK interrupt status
 * @see MPU6050_MOD_RA_I2C_MST_STATUS
 */
bool MPU6050_MOD::getSlave2Nack() {
    I2Cdev_mod::readBit(devAddr, MPU6050_MOD_RA_I2C_MST_STATUS, MPU6050_MOD_MST_I2C_SLV2_NACK_BIT, buffer);
    return buffer[0];
}
/** Get Slave 1 NACK status.
 * This bit automatically sets to 1 when the I2C Master receives a NACK in a
 * transaction with Slave 1. This triggers an interrupt if the I2C_MST_INT_EN
 * bit in the INT_ENABLE register (Register 56) is asserted.
 * @return Slave 1 NACK interrupt status
 * @see MPU6050_MOD_RA_I2C_MST_STATUS
 */
bool MPU6050_MOD::getSlave1Nack() {
    I2Cdev_mod::readBit(devAddr, MPU6050_MOD_RA_I2C_MST_STATUS, MPU6050_MOD_MST_I2C_SLV1_NACK_BIT, buffer);
    return buffer[0];
}
/** Get Slave 0 NACK status.
 * This bit automatically sets to 1 when the I2C Master receives a NACK in a
 * transaction with Slave 0. This triggers an interrupt if the I2C_MST_INT_EN
 * bit in the INT_ENABLE register (Register 56) is asserted.
 * @return Slave 0 NACK interrupt status
 * @see MPU6050_MOD_RA_I2C_MST_STATUS
 */
bool MPU6050_MOD::getSlave0Nack() {
    I2Cdev_mod::readBit(devAddr, MPU6050_MOD_RA_I2C_MST_STATUS, MPU6050_MOD_MST_I2C_SLV0_NACK_BIT, buffer);
    return buffer[0];
}

// INT_PIN_CFG register

/** Get interrupt logic level mode.
 * Will be set 0 for active-high, 1 for active-low.
 * @return Current interrupt mode (0=active-high, 1=active-low)
 * @see MPU6050_MOD_RA_INT_PIN_CFG
 * @see MPU6050_MOD_INTCFG_INT_LEVEL_BIT
 */
bool MPU6050_MOD::getInterruptMode() {
    I2Cdev_mod::readBit(devAddr, MPU6050_MOD_RA_INT_PIN_CFG, MPU6050_MOD_INTCFG_INT_LEVEL_BIT, buffer);
    return buffer[0];
}
/** Set interrupt logic level mode.
 * @param mode New interrupt mode (0=active-high, 1=active-low)
 * @see getInterruptMode()
 * @see MPU6050_MOD_RA_INT_PIN_CFG
 * @see MPU6050_MOD_INTCFG_INT_LEVEL_BIT
 */
void MPU6050_MOD::setInterruptMode(bool mode) {
   I2Cdev_mod::writeBit(devAddr, MPU6050_MOD_RA_INT_PIN_CFG, MPU6050_MOD_INTCFG_INT_LEVEL_BIT, mode);
}
/** Get interrupt drive mode.
 * Will be set 0 for push-pull, 1 for open-drain.
 * @return Current interrupt drive mode (0=push-pull, 1=open-drain)
 * @see MPU6050_MOD_RA_INT_PIN_CFG
 * @see MPU6050_MOD_INTCFG_INT_OPEN_BIT
 */
bool MPU6050_MOD::getInterruptDrive() {
    I2Cdev_mod::readBit(devAddr, MPU6050_MOD_RA_INT_PIN_CFG, MPU6050_MOD_INTCFG_INT_OPEN_BIT, buffer);
    return buffer[0];
}
/** Set interrupt drive mode.
 * @param drive New interrupt drive mode (0=push-pull, 1=open-drain)
 * @see getInterruptDrive()
 * @see MPU6050_MOD_RA_INT_PIN_CFG
 * @see MPU6050_MOD_INTCFG_INT_OPEN_BIT
 */
void MPU6050_MOD::setInterruptDrive(bool drive) {
    I2Cdev_mod::writeBit(devAddr, MPU6050_MOD_RA_INT_PIN_CFG, MPU6050_MOD_INTCFG_INT_OPEN_BIT, drive);
}
/** Get interrupt latch mode.
 * Will be set 0 for 50us-pulse, 1 for latch-until-int-cleared.
 * @return Current latch mode (0=50us-pulse, 1=latch-until-int-cleared)
 * @see MPU6050_MOD_RA_INT_PIN_CFG
 * @see MPU6050_MOD_INTCFG_LATCH_INT_EN_BIT
 */
bool MPU6050_MOD::getInterruptLatch() {
    I2Cdev_mod::readBit(devAddr, MPU6050_MOD_RA_INT_PIN_CFG, MPU6050_MOD_INTCFG_LATCH_INT_EN_BIT, buffer);
    return buffer[0];
}
/** Set interrupt latch mode.
 * @param latch New latch mode (0=50us-pulse, 1=latch-until-int-cleared)
 * @see getInterruptLatch()
 * @see MPU6050_MOD_RA_INT_PIN_CFG
 * @see MPU6050_MOD_INTCFG_LATCH_INT_EN_BIT
 */
void MPU6050_MOD::setInterruptLatch(bool latch) {
    I2Cdev_mod::writeBit(devAddr, MPU6050_MOD_RA_INT_PIN_CFG, MPU6050_MOD_INTCFG_LATCH_INT_EN_BIT, latch);
}
/** Get interrupt latch clear mode.
 * Will be set 0 for status-read-only, 1 for any-register-read.
 * @return Current latch clear mode (0=status-read-only, 1=any-register-read)
 * @see MPU6050_MOD_RA_INT_PIN_CFG
 * @see MPU6050_MOD_INTCFG_INT_RD_CLEAR_BIT
 */
bool MPU6050_MOD::getInterruptLatchClear() {
    I2Cdev_mod::readBit(devAddr, MPU6050_MOD_RA_INT_PIN_CFG, MPU6050_MOD_INTCFG_INT_RD_CLEAR_BIT, buffer);
    return buffer[0];
}
/** Set interrupt latch clear mode.
 * @param clear New latch clear mode (0=status-read-only, 1=any-register-read)
 * @see getInterruptLatchClear()
 * @see MPU6050_MOD_RA_INT_PIN_CFG
 * @see MPU6050_MOD_INTCFG_INT_RD_CLEAR_BIT
 */
void MPU6050_MOD::setInterruptLatchClear(bool clear) {
    I2Cdev_mod::writeBit(devAddr, MPU6050_MOD_RA_INT_PIN_CFG, MPU6050_MOD_INTCFG_INT_RD_CLEAR_BIT, clear);
}
/** Get FSYNC interrupt logic level mode.
 * @return Current FSYNC interrupt mode (0=active-high, 1=active-low)
 * @see getFSyncInterruptMode()
 * @see MPU6050_MOD_RA_INT_PIN_CFG
 * @see MPU6050_MOD_INTCFG_FSYNC_INT_LEVEL_BIT
 */
bool MPU6050_MOD::getFSyncInterruptLevel() {
    I2Cdev_mod::readBit(devAddr, MPU6050_MOD_RA_INT_PIN_CFG, MPU6050_MOD_INTCFG_FSYNC_INT_LEVEL_BIT, buffer);
    return buffer[0];
}
/** Set FSYNC interrupt logic level mode.
 * @param mode New FSYNC interrupt mode (0=active-high, 1=active-low)
 * @see getFSyncInterruptMode()
 * @see MPU6050_MOD_RA_INT_PIN_CFG
 * @see MPU6050_MOD_INTCFG_FSYNC_INT_LEVEL_BIT
 */
void MPU6050_MOD::setFSyncInterruptLevel(bool level) {
    I2Cdev_mod::writeBit(devAddr, MPU6050_MOD_RA_INT_PIN_CFG, MPU6050_MOD_INTCFG_FSYNC_INT_LEVEL_BIT, level);
}
/** Get FSYNC pin interrupt enabled setting.
 * Will be set 0 for disabled, 1 for enabled.
 * @return Current interrupt enabled setting
 * @see MPU6050_MOD_RA_INT_PIN_CFG
 * @see MPU6050_MOD_INTCFG_FSYNC_INT_EN_BIT
 */
bool MPU6050_MOD::getFSyncInterruptEnabled() {
    I2Cdev_mod::readBit(devAddr, MPU6050_MOD_RA_INT_PIN_CFG, MPU6050_MOD_INTCFG_FSYNC_INT_EN_BIT, buffer);
    return buffer[0];
}
/** Set FSYNC pin interrupt enabled setting.
 * @param enabled New FSYNC pin interrupt enabled setting
 * @see getFSyncInterruptEnabled()
 * @see MPU6050_MOD_RA_INT_PIN_CFG
 * @see MPU6050_MOD_INTCFG_FSYNC_INT_EN_BIT
 */
void MPU6050_MOD::setFSyncInterruptEnabled(bool enabled) {
    I2Cdev_mod::writeBit(devAddr, MPU6050_MOD_RA_INT_PIN_CFG, MPU6050_MOD_INTCFG_FSYNC_INT_EN_BIT, enabled);
}
/** Get I2C bypass enabled status.
 * When this bit is equal to 1 and I2C_MST_EN (Register 106 bit[5]) is equal to
 * 0, the host application processor will be able to directly access the
 * auxiliary I2C bus of the MPU-60X0. When this bit is equal to 0, the host
 * application processor will not be able to directly access the auxiliary I2C
 * bus of the MPU-60X0 regardless of the state of I2C_MST_EN (Register 106
 * bit[5]).
 * @return Current I2C bypass enabled status
 * @see MPU6050_MOD_RA_INT_PIN_CFG
 * @see MPU6050_MOD_INTCFG_I2C_BYPASS_EN_BIT
 */
bool MPU6050_MOD::getI2CBypassEnabled() {
    I2Cdev_mod::readBit(devAddr, MPU6050_MOD_RA_INT_PIN_CFG, MPU6050_MOD_INTCFG_I2C_BYPASS_EN_BIT, buffer);
    return buffer[0];
}
/** Set I2C bypass enabled status.
 * When this bit is equal to 1 and I2C_MST_EN (Register 106 bit[5]) is equal to
 * 0, the host application processor will be able to directly access the
 * auxiliary I2C bus of the MPU-60X0. When this bit is equal to 0, the host
 * application processor will not be able to directly access the auxiliary I2C
 * bus of the MPU-60X0 regardless of the state of I2C_MST_EN (Register 106
 * bit[5]).
 * @param enabled New I2C bypass enabled status
 * @see MPU6050_MOD_RA_INT_PIN_CFG
 * @see MPU6050_MOD_INTCFG_I2C_BYPASS_EN_BIT
 */
void MPU6050_MOD::setI2CBypassEnabled(bool enabled) {
    I2Cdev_mod::writeBit(devAddr, MPU6050_MOD_RA_INT_PIN_CFG, MPU6050_MOD_INTCFG_I2C_BYPASS_EN_BIT, enabled);
}
/** Get reference clock output enabled status.
 * When this bit is equal to 1, a reference clock output is provided at the
 * CLKOUT pin. When this bit is equal to 0, the clock output is disabled. For
 * further information regarding CLKOUT, please refer to the MPU-60X0 Product
 * Specification document.
 * @return Current reference clock output enabled status
 * @see MPU6050_MOD_RA_INT_PIN_CFG
 * @see MPU6050_MOD_INTCFG_CLKOUT_EN_BIT
 */
bool MPU6050_MOD::getClockOutputEnabled() {
    I2Cdev_mod::readBit(devAddr, MPU6050_MOD_RA_INT_PIN_CFG, MPU6050_MOD_INTCFG_CLKOUT_EN_BIT, buffer);
    return buffer[0];
}
/** Set reference clock output enabled status.
 * When this bit is equal to 1, a reference clock output is provided at the
 * CLKOUT pin. When this bit is equal to 0, the clock output is disabled. For
 * further information regarding CLKOUT, please refer to the MPU-60X0 Product
 * Specification document.
 * @param enabled New reference clock output enabled status
 * @see MPU6050_MOD_RA_INT_PIN_CFG
 * @see MPU6050_MOD_INTCFG_CLKOUT_EN_BIT
 */
void MPU6050_MOD::setClockOutputEnabled(bool enabled) {
    I2Cdev_mod::writeBit(devAddr, MPU6050_MOD_RA_INT_PIN_CFG, MPU6050_MOD_INTCFG_CLKOUT_EN_BIT, enabled);
}

// INT_ENABLE register

/** Get full interrupt enabled status.
 * Full register byte for all interrupts, for quick reading. Each bit will be
 * set 0 for disabled, 1 for enabled.
 * @return Current interrupt enabled status
 * @see MPU6050_MOD_RA_INT_ENABLE
 * @see MPU6050_MOD_INTERRUPT_FF_BIT
 **/
uint8_t MPU6050_MOD::getIntEnabled() {
    I2Cdev_mod::readByte(devAddr, MPU6050_MOD_RA_INT_ENABLE, buffer);
    return buffer[0];
}
/** Set full interrupt enabled status.
 * Full register byte for all interrupts, for quick reading. Each bit should be
 * set 0 for disabled, 1 for enabled.
 * @param enabled New interrupt enabled status
 * @see getIntFreefallEnabled()
 * @see MPU6050_MOD_RA_INT_ENABLE
 * @see MPU6050_MOD_INTERRUPT_FF_BIT
 **/
void MPU6050_MOD::setIntEnabled(uint8_t enabled) {
    I2Cdev_mod::writeByte(devAddr, MPU6050_MOD_RA_INT_ENABLE, enabled);
}
/** Get Free Fall interrupt enabled status.
 * Will be set 0 for disabled, 1 for enabled.
 * @return Current interrupt enabled status
 * @see MPU6050_MOD_RA_INT_ENABLE
 * @see MPU6050_MOD_INTERRUPT_FF_BIT
 **/
bool MPU6050_MOD::getIntFreefallEnabled() {
    I2Cdev_mod::readBit(devAddr, MPU6050_MOD_RA_INT_ENABLE, MPU6050_MOD_INTERRUPT_FF_BIT, buffer);
    return buffer[0];
}
/** Set Free Fall interrupt enabled status.
 * @param enabled New interrupt enabled status
 * @see getIntFreefallEnabled()
 * @see MPU6050_MOD_RA_INT_ENABLE
 * @see MPU6050_MOD_INTERRUPT_FF_BIT
 **/
void MPU6050_MOD::setIntFreefallEnabled(bool enabled) {
    I2Cdev_mod::writeBit(devAddr, MPU6050_MOD_RA_INT_ENABLE, MPU6050_MOD_INTERRUPT_FF_BIT, enabled);
}
/** Get Motion Detection interrupt enabled status.
 * Will be set 0 for disabled, 1 for enabled.
 * @return Current interrupt enabled status
 * @see MPU6050_MOD_RA_INT_ENABLE
 * @see MPU6050_MOD_INTERRUPT_MOT_BIT
 **/
bool MPU6050_MOD::getIntMotionEnabled() {
    I2Cdev_mod::readBit(devAddr, MPU6050_MOD_RA_INT_ENABLE, MPU6050_MOD_INTERRUPT_MOT_BIT, buffer);
    return buffer[0];
}
/** Set Motion Detection interrupt enabled status.
 * @param enabled New interrupt enabled status
 * @see getIntMotionEnabled()
 * @see MPU6050_MOD_RA_INT_ENABLE
 * @see MPU6050_MOD_INTERRUPT_MOT_BIT
 **/
void MPU6050_MOD::setIntMotionEnabled(bool enabled) {
    I2Cdev_mod::writeBit(devAddr, MPU6050_MOD_RA_INT_ENABLE, MPU6050_MOD_INTERRUPT_MOT_BIT, enabled);
}
/** Get Zero Motion Detection interrupt enabled status.
 * Will be set 0 for disabled, 1 for enabled.
 * @return Current interrupt enabled status
 * @see MPU6050_MOD_RA_INT_ENABLE
 * @see MPU6050_MOD_INTERRUPT_ZMOT_BIT
 **/
bool MPU6050_MOD::getIntZeroMotionEnabled() {
    I2Cdev_mod::readBit(devAddr, MPU6050_MOD_RA_INT_ENABLE, MPU6050_MOD_INTERRUPT_ZMOT_BIT, buffer);
    return buffer[0];
}
/** Set Zero Motion Detection interrupt enabled status.
 * @param enabled New interrupt enabled status
 * @see getIntZeroMotionEnabled()
 * @see MPU6050_MOD_RA_INT_ENABLE
 * @see MPU6050_MOD_INTERRUPT_ZMOT_BIT
 **/
void MPU6050_MOD::setIntZeroMotionEnabled(bool enabled) {
    I2Cdev_mod::writeBit(devAddr, MPU6050_MOD_RA_INT_ENABLE, MPU6050_MOD_INTERRUPT_ZMOT_BIT, enabled);
}
/** Get FIFO Buffer Overflow interrupt enabled status.
 * Will be set 0 for disabled, 1 for enabled.
 * @return Current interrupt enabled status
 * @see MPU6050_MOD_RA_INT_ENABLE
 * @see MPU6050_MOD_INTERRUPT_FIFO_OFLOW_BIT
 **/
bool MPU6050_MOD::getIntFIFOBufferOverflowEnabled() {
    I2Cdev_mod::readBit(devAddr, MPU6050_MOD_RA_INT_ENABLE, MPU6050_MOD_INTERRUPT_FIFO_OFLOW_BIT, buffer);
    return buffer[0];
}
/** Set FIFO Buffer Overflow interrupt enabled status.
 * @param enabled New interrupt enabled status
 * @see getIntFIFOBufferOverflowEnabled()
 * @see MPU6050_MOD_RA_INT_ENABLE
 * @see MPU6050_MOD_INTERRUPT_FIFO_OFLOW_BIT
 **/
void MPU6050_MOD::setIntFIFOBufferOverflowEnabled(bool enabled) {
    I2Cdev_mod::writeBit(devAddr, MPU6050_MOD_RA_INT_ENABLE, MPU6050_MOD_INTERRUPT_FIFO_OFLOW_BIT, enabled);
}
/** Get I2C Master interrupt enabled status.
 * This enables any of the I2C Master interrupt sources to generate an
 * interrupt. Will be set 0 for disabled, 1 for enabled.
 * @return Current interrupt enabled status
 * @see MPU6050_MOD_RA_INT_ENABLE
 * @see MPU6050_MOD_INTERRUPT_I2C_MST_INT_BIT
 **/
bool MPU6050_MOD::getIntI2CMasterEnabled() {
    I2Cdev_mod::readBit(devAddr, MPU6050_MOD_RA_INT_ENABLE, MPU6050_MOD_INTERRUPT_I2C_MST_INT_BIT, buffer);
    return buffer[0];
}
/** Set I2C Master interrupt enabled status.
 * @param enabled New interrupt enabled status
 * @see getIntI2CMasterEnabled()
 * @see MPU6050_MOD_RA_INT_ENABLE
 * @see MPU6050_MOD_INTERRUPT_I2C_MST_INT_BIT
 **/
void MPU6050_MOD::setIntI2CMasterEnabled(bool enabled) {
    I2Cdev_mod::writeBit(devAddr, MPU6050_MOD_RA_INT_ENABLE, MPU6050_MOD_INTERRUPT_I2C_MST_INT_BIT, enabled);
}
/** Get Data Ready interrupt enabled setting.
 * This event occurs each time a write operation to all of the sensor registers
 * has been completed. Will be set 0 for disabled, 1 for enabled.
 * @return Current interrupt enabled status
 * @see MPU6050_MOD_RA_INT_ENABLE
 * @see MPU6050_MOD_INTERRUPT_DATA_RDY_BIT
 */
bool MPU6050_MOD::getIntDataReadyEnabled() {
    I2Cdev_mod::readBit(devAddr, MPU6050_MOD_RA_INT_ENABLE, MPU6050_MOD_INTERRUPT_DATA_RDY_BIT, buffer);
    return buffer[0];
}
/** Set Data Ready interrupt enabled status.
 * @param enabled New interrupt enabled status
 * @see getIntDataReadyEnabled()
 * @see MPU6050_MOD_RA_INT_CFG
 * @see MPU6050_MOD_INTERRUPT_DATA_RDY_BIT
 */
void MPU6050_MOD::setIntDataReadyEnabled(bool enabled) {
    I2Cdev_mod::writeBit(devAddr, MPU6050_MOD_RA_INT_ENABLE, MPU6050_MOD_INTERRUPT_DATA_RDY_BIT, enabled);
}

// INT_STATUS register

/** Get full set of interrupt status bits.
 * These bits clear to 0 after the register has been read. Very useful
 * for getting multiple INT statuses, since each single bit read clears
 * all of them because it has to read the whole byte.
 * @return Current interrupt status
 * @see MPU6050_MOD_RA_INT_STATUS
 */
uint8_t MPU6050_MOD::getIntStatus() {
    I2Cdev_mod::readByte(devAddr, MPU6050_MOD_RA_INT_STATUS, buffer);
    return buffer[0];
}
/** Get Free Fall interrupt status.
 * This bit automatically sets to 1 when a Free Fall interrupt has been
 * generated. The bit clears to 0 after the register has been read.
 * @return Current interrupt status
 * @see MPU6050_MOD_RA_INT_STATUS
 * @see MPU6050_MOD_INTERRUPT_FF_BIT
 */
bool MPU6050_MOD::getIntFreefallStatus() {
    I2Cdev_mod::readBit(devAddr, MPU6050_MOD_RA_INT_STATUS, MPU6050_MOD_INTERRUPT_FF_BIT, buffer);
    return buffer[0];
}
/** Get Motion Detection interrupt status.
 * This bit automatically sets to 1 when a Motion Detection interrupt has been
 * generated. The bit clears to 0 after the register has been read.
 * @return Current interrupt status
 * @see MPU6050_MOD_RA_INT_STATUS
 * @see MPU6050_MOD_INTERRUPT_MOT_BIT
 */
bool MPU6050_MOD::getIntMotionStatus() {
    I2Cdev_mod::readBit(devAddr, MPU6050_MOD_RA_INT_STATUS, MPU6050_MOD_INTERRUPT_MOT_BIT, buffer);
    return buffer[0];
}
/** Get Zero Motion Detection interrupt status.
 * This bit automatically sets to 1 when a Zero Motion Detection interrupt has
 * been generated. The bit clears to 0 after the register has been read.
 * @return Current interrupt status
 * @see MPU6050_MOD_RA_INT_STATUS
 * @see MPU6050_MOD_INTERRUPT_ZMOT_BIT
 */
bool MPU6050_MOD::getIntZeroMotionStatus() {
    I2Cdev_mod::readBit(devAddr, MPU6050_MOD_RA_INT_STATUS, MPU6050_MOD_INTERRUPT_ZMOT_BIT, buffer);
    return buffer[0];
}
/** Get FIFO Buffer Overflow interrupt status.
 * This bit automatically sets to 1 when a Free Fall interrupt has been
 * generated. The bit clears to 0 after the register has been read.
 * @return Current interrupt status
 * @see MPU6050_MOD_RA_INT_STATUS
 * @see MPU6050_MOD_INTERRUPT_FIFO_OFLOW_BIT
 */
bool MPU6050_MOD::getIntFIFOBufferOverflowStatus() {
    I2Cdev_mod::readBit(devAddr, MPU6050_MOD_RA_INT_STATUS, MPU6050_MOD_INTERRUPT_FIFO_OFLOW_BIT, buffer);
    return buffer[0];
}
/** Get I2C Master interrupt status.
 * This bit automatically sets to 1 when an I2C Master interrupt has been
 * generated. For a list of I2C Master interrupts, please refer to Register 54.
 * The bit clears to 0 after the register has been read.
 * @return Current interrupt status
 * @see MPU6050_MOD_RA_INT_STATUS
 * @see MPU6050_MOD_INTERRUPT_I2C_MST_INT_BIT
 */
bool MPU6050_MOD::getIntI2CMasterStatus() {
    I2Cdev_mod::readBit(devAddr, MPU6050_MOD_RA_INT_STATUS, MPU6050_MOD_INTERRUPT_I2C_MST_INT_BIT, buffer);
    return buffer[0];
}
/** Get Data Ready interrupt status.
 * This bit automatically sets to 1 when a Data Ready interrupt has been
 * generated. The bit clears to 0 after the register has been read.
 * @return Current interrupt status
 * @see MPU6050_MOD_RA_INT_STATUS
 * @see MPU6050_MOD_INTERRUPT_DATA_RDY_BIT
 */
bool MPU6050_MOD::getIntDataReadyStatus() {
    I2Cdev_mod::readBit(devAddr, MPU6050_MOD_RA_INT_STATUS, MPU6050_MOD_INTERRUPT_DATA_RDY_BIT, buffer);
    return buffer[0];
}

// ACCEL_*OUT_* registers

/** Get raw 9-axis motion sensor readings (accel/gyro/compass).
 * FUNCTION NOT FULLY IMPLEMENTED YET.
 * @param ax 16-bit signed integer container for accelerometer X-axis value
 * @param ay 16-bit signed integer container for accelerometer Y-axis value
 * @param az 16-bit signed integer container for accelerometer Z-axis value
 * @param gx 16-bit signed integer container for gyroscope X-axis value
 * @param gy 16-bit signed integer container for gyroscope Y-axis value
 * @param gz 16-bit signed integer container for gyroscope Z-axis value
 * @param mx 16-bit signed integer container for magnetometer X-axis value
 * @param my 16-bit signed integer container for magnetometer Y-axis value
 * @param mz 16-bit signed integer container for magnetometer Z-axis value
 * @see getMotion6()
 * @see getAcceleration()
 * @see getRotation()
 * @see MPU6050_MOD_RA_ACCEL_XOUT_H
 */
void MPU6050_MOD::getMotion9(int16_t* ax, int16_t* ay, int16_t* az, int16_t* gx, int16_t* gy, int16_t* gz, int16_t* mx, int16_t* my, int16_t* mz) {
    getMotion6(ax, ay, az, gx, gy, gz);
    // TODO: magnetometer integration
}
/** Get raw 6-axis motion sensor readings (accel/gyro).
 * Retrieves all currently available motion sensor values.
 * @param ax 16-bit signed integer container for accelerometer X-axis value
 * @param ay 16-bit signed integer container for accelerometer Y-axis value
 * @param az 16-bit signed integer container for accelerometer Z-axis value
 * @param gx 16-bit signed integer container for gyroscope X-axis value
 * @param gy 16-bit signed integer container for gyroscope Y-axis value
 * @param gz 16-bit signed integer container for gyroscope Z-axis value
 * @see getAcceleration()
 * @see getRotation()
 * @see MPU6050_MOD_RA_ACCEL_XOUT_H
 */
void MPU6050_MOD::getMotion6(int16_t* ax, int16_t* ay, int16_t* az, int16_t* gx, int16_t* gy, int16_t* gz) {
    I2Cdev_mod::readBytes(devAddr, MPU6050_MOD_RA_ACCEL_XOUT_H, 14, buffer);
    *ax = (((int16_t)buffer[0]) << 8) | buffer[1];
    *ay = (((int16_t)buffer[2]) << 8) | buffer[3];
    *az = (((int16_t)buffer[4]) << 8) | buffer[5];
    *gx = (((int16_t)buffer[8]) << 8) | buffer[9];
    *gy = (((int16_t)buffer[10]) << 8) | buffer[11];
    *gz = (((int16_t)buffer[12]) << 8) | buffer[13];
}
/** Get 3-axis accelerometer readings.
 * These registers store the most recent accelerometer measurements.
 * Accelerometer measurements are written to these registers at the Sample Rate
 * as defined in Register 25.
 *
 * The accelerometer measurement registers, along with the temperature
 * measurement registers, gyroscope measurement registers, and external sensor
 * data registers, are composed of two sets of registers: an internal register
 * set and a user-facing read register set.
 *
 * The data within the accelerometer sensors' internal register set is always
 * updated at the Sample Rate. Meanwhile, the user-facing read register set
 * duplicates the internal register set's data values whenever the serial
 * interface is idle. This guarantees that a burst read of sensor registers will
 * read measurements from the same sampling instant. Note that if burst reads
 * are not used, the user is responsible for ensuring a set of single byte reads
 * correspond to a single sampling instant by checking the Data Ready interrupt.
 *
 * Each 16-bit accelerometer measurement has a full scale defined in ACCEL_FS
 * (Register 28). For each full scale setting, the accelerometers' sensitivity
 * per LSB in ACCEL_xOUT is shown in the table below:
 *
 * <pre>
 * AFS_SEL | Full Scale Range | LSB Sensitivity
 * --------+------------------+----------------
 * 0       | +/- 2g           | 8192 LSB/mg
 * 1       | +/- 4g           | 4096 LSB/mg
 * 2       | +/- 8g           | 2048 LSB/mg
 * 3       | +/- 16g          | 1024 LSB/mg
 * </pre>
 *
 * @param x 16-bit signed integer container for X-axis acceleration
 * @param y 16-bit signed integer container for Y-axis acceleration
 * @param z 16-bit signed integer container for Z-axis acceleration
 * @see MPU6050_MOD_RA_GYRO_XOUT_H
 */
void MPU6050_MOD::getAcceleration(int16_t* x, int16_t* y, int16_t* z) {
    I2Cdev_mod::readBytes(devAddr, MPU6050_MOD_RA_ACCEL_XOUT_H, 6, buffer);
    *x = (((int16_t)buffer[0]) << 8) | buffer[1];
    *y = (((int16_t)buffer[2]) << 8) | buffer[3];
    *z = (((int16_t)buffer[4]) << 8) | buffer[5];
}
/** Get X-axis accelerometer reading.
 * @return X-axis acceleration measurement in 16-bit 2's complement format
 * @see getMotion6()
 * @see MPU6050_MOD_RA_ACCEL_XOUT_H
 */
int16_t MPU6050_MOD::getAccelerationX() {
    I2Cdev_mod::readBytes(devAddr, MPU6050_MOD_RA_ACCEL_XOUT_H, 2, buffer);
    return (((int16_t)buffer[0]) << 8) | buffer[1];
}
/** Get Y-axis accelerometer reading.
 * @return Y-axis acceleration measurement in 16-bit 2's complement format
 * @see getMotion6()
 * @see MPU6050_MOD_RA_ACCEL_YOUT_H
 */
int16_t MPU6050_MOD::getAccelerationY() {
    I2Cdev_mod::readBytes(devAddr, MPU6050_MOD_RA_ACCEL_YOUT_H, 2, buffer);
    return (((int16_t)buffer[0]) << 8) | buffer[1];
}
/** Get Z-axis accelerometer reading.
 * @return Z-axis acceleration measurement in 16-bit 2's complement format
 * @see getMotion6()
 * @see MPU6050_MOD_RA_ACCEL_ZOUT_H
 */
int16_t MPU6050_MOD::getAccelerationZ() {
    I2Cdev_mod::readBytes(devAddr, MPU6050_MOD_RA_ACCEL_ZOUT_H, 2, buffer);
    return (((int16_t)buffer[0]) << 8) | buffer[1];
}

// TEMP_OUT_* registers

/** Get current internal temperature.
 * @return Temperature reading in 16-bit 2's complement format
 * @see MPU6050_MOD_RA_TEMP_OUT_H
 */
int16_t MPU6050_MOD::getTemperature() {
    I2Cdev_mod::readBytes(devAddr, MPU6050_MOD_RA_TEMP_OUT_H, 2, buffer);
    return (((int16_t)buffer[0]) << 8) | buffer[1];
}

// GYRO_*OUT_* registers

/** Get 3-axis gyroscope readings.
 * These gyroscope measurement registers, along with the accelerometer
 * measurement registers, temperature measurement registers, and external sensor
 * data registers, are composed of two sets of registers: an internal register
 * set and a user-facing read register set.
 * The data within the gyroscope sensors' internal register set is always
 * updated at the Sample Rate. Meanwhile, the user-facing read register set
 * duplicates the internal register set's data values whenever the serial
 * interface is idle. This guarantees that a burst read of sensor registers will
 * read measurements from the same sampling instant. Note that if burst reads
 * are not used, the user is responsible for ensuring a set of single byte reads
 * correspond to a single sampling instant by checking the Data Ready interrupt.
 *
 * Each 16-bit gyroscope measurement has a full scale defined in FS_SEL
 * (Register 27). For each full scale setting, the gyroscopes' sensitivity per
 * LSB in GYRO_xOUT is shown in the table below:
 *
 * <pre>
 * FS_SEL | Full Scale Range   | LSB Sensitivity
 * -------+--------------------+----------------
 * 0      | +/- 250 degrees/s  | 131 LSB/deg/s
 * 1      | +/- 500 degrees/s  | 65.5 LSB/deg/s
 * 2      | +/- 1000 degrees/s | 32.8 LSB/deg/s
 * 3      | +/- 2000 degrees/s | 16.4 LSB/deg/s
 * </pre>
 *
 * @param x 16-bit signed integer container for X-axis rotation
 * @param y 16-bit signed integer container for Y-axis rotation
 * @param z 16-bit signed integer container for Z-axis rotation
 * @see getMotion6()
 * @see MPU6050_MOD_RA_GYRO_XOUT_H
 */
void MPU6050_MOD::getRotation(int16_t* x, int16_t* y, int16_t* z) {
    I2Cdev_mod::readBytes(devAddr, MPU6050_MOD_RA_GYRO_XOUT_H, 6, buffer);
    *x = (((int16_t)buffer[0]) << 8) | buffer[1];
    *y = (((int16_t)buffer[2]) << 8) | buffer[3];
    *z = (((int16_t)buffer[4]) << 8) | buffer[5];
}
/** Get X-axis gyroscope reading.
 * @return X-axis rotation measurement in 16-bit 2's complement format
 * @see getMotion6()
 * @see MPU6050_MOD_RA_GYRO_XOUT_H
 */
int16_t MPU6050_MOD::getRotationX() {
    I2Cdev_mod::readBytes(devAddr, MPU6050_MOD_RA_GYRO_XOUT_H, 2, buffer);
    return (((int16_t)buffer[0]) << 8) | buffer[1];
}
/** Get Y-axis gyroscope reading.
 * @return Y-axis rotation measurement in 16-bit 2's complement format
 * @see getMotion6()
 * @see MPU6050_MOD_RA_GYRO_YOUT_H
 */
int16_t MPU6050_MOD::getRotationY() {
    I2Cdev_mod::readBytes(devAddr, MPU6050_MOD_RA_GYRO_YOUT_H, 2, buffer);
    return (((int16_t)buffer[0]) << 8) | buffer[1];
}
/** Get Z-axis gyroscope reading.
 * @return Z-axis rotation measurement in 16-bit 2's complement format
 * @see getMotion6()
 * @see MPU6050_MOD_RA_GYRO_ZOUT_H
 */
int16_t MPU6050_MOD::getRotationZ() {
    I2Cdev_mod::readBytes(devAddr, MPU6050_MOD_RA_GYRO_ZOUT_H, 2, buffer);
    return (((int16_t)buffer[0]) << 8) | buffer[1];
}

// EXT_SENS_DATA_* registers

/** Read single byte from external sensor data register.
 * These registers store data read from external sensors by the Slave 0, 1, 2,
 * and 3 on the auxiliary I2C interface. Data read by Slave 4 is stored in
 * I2C_SLV4_DI (Register 53).
 *
 * External sensor data is written to these registers at the Sample Rate as
 * defined in Register 25. This access rate can be reduced by using the Slave
 * Delay Enable registers (Register 103).
 *
 * External sensor data registers, along with the gyroscope measurement
 * registers, accelerometer measurement registers, and temperature measurement
 * registers, are composed of two sets of registers: an internal register set
 * and a user-facing read register set.
 *
 * The data within the external sensors' internal register set is always updated
 * at the Sample Rate (or the reduced access rate) whenever the serial interface
 * is idle. This guarantees that a burst read of sensor registers will read
 * measurements from the same sampling instant. Note that if burst reads are not
 * used, the user is responsible for ensuring a set of single byte reads
 * correspond to a single sampling instant by checking the Data Ready interrupt.
 *
 * Data is placed in these external sensor data registers according to
 * I2C_SLV0_CTRL, I2C_SLV1_CTRL, I2C_SLV2_CTRL, and I2C_SLV3_CTRL (Registers 39,
 * 42, 45, and 48). When more than zero bytes are read (I2C_SLVx_LEN > 0) from
 * an enabled slave (I2C_SLVx_EN = 1), the slave is read at the Sample Rate (as
 * defined in Register 25) or delayed rate (if specified in Register 52 and
 * 103). During each Sample cycle, slave reads are performed in order of Slave
 * number. If all slaves are enabled with more than zero bytes to be read, the
 * order will be Slave 0, followed by Slave 1, Slave 2, and Slave 3.
 *
 * Each enabled slave will have EXT_SENS_DATA registers associated with it by
 * number of bytes read (I2C_SLVx_LEN) in order of slave number, starting from
 * EXT_SENS_DATA_00. Note that this means enabling or disabling a slave may
 * change the higher numbered slaves' associated registers. Furthermore, if
 * fewer total bytes are being read from the external sensors as a result of
 * such a change, then the data remaining in the registers which no longer have
 * an associated slave device (i.e. high numbered registers) will remain in
 * these previously allocated registers unless reset.
 *
 * If the sum of the read lengths of all SLVx transactions exceed the number of
 * available EXT_SENS_DATA registers, the excess bytes will be dropped. There
 * are 24 EXT_SENS_DATA registers and hence the total read lengths between all
 * the slaves cannot be greater than 24 or some bytes will be lost.
 *
 * Note: Slave 4's behavior is distinct from that of Slaves 0-3. For further
 * information regarding the characteristics of Slave 4, please refer to
 * Registers 49 to 53.
 *
 * EXAMPLE:
 * Suppose that Slave 0 is enabled with 4 bytes to be read (I2C_SLV0_EN = 1 and
 * I2C_SLV0_LEN = 4) while Slave 1 is enabled with 2 bytes to be read so that
 * I2C_SLV1_EN = 1 and I2C_SLV1_LEN = 2. In such a situation, EXT_SENS_DATA _00
 * through _03 will be associated with Slave 0, while EXT_SENS_DATA _04 and 05
 * will be associated with Slave 1. If Slave 2 is enabled as well, registers
 * starting from EXT_SENS_DATA_06 will be allocated to Slave 2.
 *
 * If Slave 2 is disabled while Slave 3 is enabled in this same situation, then
 * registers starting from EXT_SENS_DATA_06 will be allocated to Slave 3
 * instead.
 *
 * REGISTER ALLOCATION FOR DYNAMIC DISABLE VS. NORMAL DISABLE:
 * If a slave is disabled at any time, the space initially allocated to the
 * slave in the EXT_SENS_DATA register, will remain associated with that slave.
 * This is to avoid dynamic adjustment of the register allocation.
 *
 * The allocation of the EXT_SENS_DATA registers is recomputed only when (1) all
 * slaves are disabled, or (2) the I2C_MST_RST bit is set (Register 106).
 *
 * This above is also true if one of the slaves gets NACKed and stops
 * functioning.
 *
 * @param position Starting position (0-23)
 * @return Byte read from register
 */
uint8_t MPU6050_MOD::getExternalSensorByte(int position) {
    I2Cdev_mod::readByte(devAddr, MPU6050_MOD_RA_EXT_SENS_DATA_00 + position, buffer);
    return buffer[0];
}
/** Read word (2 bytes) from external sensor data registers.
 * @param position Starting position (0-21)
 * @return Word read from register
 * @see getExternalSensorByte()
 */
uint16_t MPU6050_MOD::getExternalSensorWord(int position) {
    I2Cdev_mod::readBytes(devAddr, MPU6050_MOD_RA_EXT_SENS_DATA_00 + position, 2, buffer);
    return (((uint16_t)buffer[0]) << 8) | buffer[1];
}
/** Read double word (4 bytes) from external sensor data registers.
 * @param position Starting position (0-20)
 * @return Double word read from registers
 * @see getExternalSensorByte()
 */
uint32_t MPU6050_MOD::getExternalSensorDWord(int position) {
    I2Cdev_mod::readBytes(devAddr, MPU6050_MOD_RA_EXT_SENS_DATA_00 + position, 4, buffer);
    return (((uint32_t)buffer[0]) << 24) | (((uint32_t)buffer[1]) << 16) | (((uint16_t)buffer[2]) << 8) | buffer[3];
}

// MOT_DETECT_STATUS register

/** Get full motion detection status register content (all bits).
 * @return Motion detection status byte
 * @see MPU6050_MOD_RA_MOT_DETECT_STATUS
 */
uint8_t MPU6050_MOD::getMotionStatus() {
    I2Cdev_mod::readByte(devAddr, MPU6050_MOD_RA_MOT_DETECT_STATUS, buffer);
    return buffer[0];
}
/** Get X-axis negative motion detection interrupt status.
 * @return Motion detection status
 * @see MPU6050_MOD_RA_MOT_DETECT_STATUS
 * @see MPU6050_MOD_MOTION_MOT_XNEG_BIT
 */
bool MPU6050_MOD::getXNegMotionDetected() {
    I2Cdev_mod::readBit(devAddr, MPU6050_MOD_RA_MOT_DETECT_STATUS, MPU6050_MOD_MOTION_MOT_XNEG_BIT, buffer);
    return buffer[0];
}
/** Get X-axis positive motion detection interrupt status.
 * @return Motion detection status
 * @see MPU6050_MOD_RA_MOT_DETECT_STATUS
 * @see MPU6050_MOD_MOTION_MOT_XPOS_BIT
 */
bool MPU6050_MOD::getXPosMotionDetected() {
    I2Cdev_mod::readBit(devAddr, MPU6050_MOD_RA_MOT_DETECT_STATUS, MPU6050_MOD_MOTION_MOT_XPOS_BIT, buffer);
    return buffer[0];
}
/** Get Y-axis negative motion detection interrupt status.
 * @return Motion detection status
 * @see MPU6050_MOD_RA_MOT_DETECT_STATUS
 * @see MPU6050_MOD_MOTION_MOT_YNEG_BIT
 */
bool MPU6050_MOD::getYNegMotionDetected() {
    I2Cdev_mod::readBit(devAddr, MPU6050_MOD_RA_MOT_DETECT_STATUS, MPU6050_MOD_MOTION_MOT_YNEG_BIT, buffer);
    return buffer[0];
}
/** Get Y-axis positive motion detection interrupt status.
 * @return Motion detection status
 * @see MPU6050_MOD_RA_MOT_DETECT_STATUS
 * @see MPU6050_MOD_MOTION_MOT_YPOS_BIT
 */
bool MPU6050_MOD::getYPosMotionDetected() {
    I2Cdev_mod::readBit(devAddr, MPU6050_MOD_RA_MOT_DETECT_STATUS, MPU6050_MOD_MOTION_MOT_YPOS_BIT, buffer);
    return buffer[0];
}
/** Get Z-axis negative motion detection interrupt status.
 * @return Motion detection status
 * @see MPU6050_MOD_RA_MOT_DETECT_STATUS
 * @see MPU6050_MOD_MOTION_MOT_ZNEG_BIT
 */
bool MPU6050_MOD::getZNegMotionDetected() {
    I2Cdev_mod::readBit(devAddr, MPU6050_MOD_RA_MOT_DETECT_STATUS, MPU6050_MOD_MOTION_MOT_ZNEG_BIT, buffer);
    return buffer[0];
}
/** Get Z-axis positive motion detection interrupt status.
 * @return Motion detection status
 * @see MPU6050_MOD_RA_MOT_DETECT_STATUS
 * @see MPU6050_MOD_MOTION_MOT_ZPOS_BIT
 */
bool MPU6050_MOD::getZPosMotionDetected() {
    I2Cdev_mod::readBit(devAddr, MPU6050_MOD_RA_MOT_DETECT_STATUS, MPU6050_MOD_MOTION_MOT_ZPOS_BIT, buffer);
    return buffer[0];
}
/** Get zero motion detection interrupt status.
 * @return Motion detection status
 * @see MPU6050_MOD_RA_MOT_DETECT_STATUS
 * @see MPU6050_MOD_MOTION_MOT_ZRMOT_BIT
 */
bool MPU6050_MOD::getZeroMotionDetected() {
    I2Cdev_mod::readBit(devAddr, MPU6050_MOD_RA_MOT_DETECT_STATUS, MPU6050_MOD_MOTION_MOT_ZRMOT_BIT, buffer);
    return buffer[0];
}

// I2C_SLV*_DO register

/** Write byte to Data Output container for specified slave.
 * This register holds the output data written into Slave when Slave is set to
 * write mode. For further information regarding Slave control, please
 * refer to Registers 37 to 39 and immediately following.
 * @param num Slave number (0-3)
 * @param data Byte to write
 * @see MPU6050_MOD_RA_I2C_SLV0_DO
 */
void MPU6050_MOD::setSlaveOutputByte(uint8_t num, uint8_t data) {
    if (num > 3) return;
    I2Cdev_mod::writeByte(devAddr, MPU6050_MOD_RA_I2C_SLV0_DO + num, data);
}

// I2C_MST_DELAY_CTRL register

/** Get external data shadow delay enabled status.
 * This register is used to specify the timing of external sensor data
 * shadowing. When DELAY_ES_SHADOW is set to 1, shadowing of external
 * sensor data is delayed until all data has been received.
 * @return Current external data shadow delay enabled status.
 * @see MPU6050_MOD_RA_I2C_MST_DELAY_CTRL
 * @see MPU6050_MOD_DELAYCTRL_DELAY_ES_SHADOW_BIT
 */
bool MPU6050_MOD::getExternalShadowDelayEnabled() {
    I2Cdev_mod::readBit(devAddr, MPU6050_MOD_RA_I2C_MST_DELAY_CTRL, MPU6050_MOD_DELAYCTRL_DELAY_ES_SHADOW_BIT, buffer);
    return buffer[0];
}
/** Set external data shadow delay enabled status.
 * @param enabled New external data shadow delay enabled status.
 * @see getExternalShadowDelayEnabled()
 * @see MPU6050_MOD_RA_I2C_MST_DELAY_CTRL
 * @see MPU6050_MOD_DELAYCTRL_DELAY_ES_SHADOW_BIT
 */
void MPU6050_MOD::setExternalShadowDelayEnabled(bool enabled) {
    I2Cdev_mod::writeBit(devAddr, MPU6050_MOD_RA_I2C_MST_DELAY_CTRL, MPU6050_MOD_DELAYCTRL_DELAY_ES_SHADOW_BIT, enabled);
}
/** Get slave delay enabled status.
 * When a particular slave delay is enabled, the rate of access for the that
 * slave device is reduced. When a slave's access rate is decreased relative to
 * the Sample Rate, the slave is accessed every:
 *
 *     1 / (1 + I2C_MST_DLY) Samples
 *
 * This base Sample Rate in turn is determined by SMPLRT_DIV (register  * 25)
 * and DLPF_CFG (register 26).
 *
 * For further information regarding I2C_MST_DLY, please refer to register 52.
 * For further information regarding the Sample Rate, please refer to register 25.
 *
 * @param num Slave number (0-4)
 * @return Current slave delay enabled status.
 * @see MPU6050_MOD_RA_I2C_MST_DELAY_CTRL
 * @see MPU6050_MOD_DELAYCTRL_I2C_SLV0_DLY_EN_BIT
 */
bool MPU6050_MOD::getSlaveDelayEnabled(uint8_t num) {
    // MPU6050_MOD_DELAYCTRL_I2C_SLV4_DLY_EN_BIT is 4, SLV3 is 3, etc.
    if (num > 4) return 0;
    I2Cdev_mod::readBit(devAddr, MPU6050_MOD_RA_I2C_MST_DELAY_CTRL, num, buffer);
    return buffer[0];
}
/** Set slave delay enabled status.
 * @param num Slave number (0-4)
 * @param enabled New slave delay enabled status.
 * @see MPU6050_MOD_RA_I2C_MST_DELAY_CTRL
 * @see MPU6050_MOD_DELAYCTRL_I2C_SLV0_DLY_EN_BIT
 */
void MPU6050_MOD::setSlaveDelayEnabled(uint8_t num, bool enabled) {
    I2Cdev_mod::writeBit(devAddr, MPU6050_MOD_RA_I2C_MST_DELAY_CTRL, num, enabled);
}

// SIGNAL_PATH_RESET register

/** Reset gyroscope signal path.
 * The reset will revert the signal path analog to digital converters and
 * filters to their power up configurations.
 * @see MPU6050_MOD_RA_SIGNAL_PATH_RESET
 * @see MPU6050_MOD_PATHRESET_GYRO_RESET_BIT
 */
void MPU6050_MOD::resetGyroscopePath() {
    I2Cdev_mod::writeBit(devAddr, MPU6050_MOD_RA_SIGNAL_PATH_RESET, MPU6050_MOD_PATHRESET_GYRO_RESET_BIT, true);
}
/** Reset accelerometer signal path.
 * The reset will revert the signal path analog to digital converters and
 * filters to their power up configurations.
 * @see MPU6050_MOD_RA_SIGNAL_PATH_RESET
 * @see MPU6050_MOD_PATHRESET_ACCEL_RESET_BIT
 */
void MPU6050_MOD::resetAccelerometerPath() {
    I2Cdev_mod::writeBit(devAddr, MPU6050_MOD_RA_SIGNAL_PATH_RESET, MPU6050_MOD_PATHRESET_ACCEL_RESET_BIT, true);
}
/** Reset temperature sensor signal path.
 * The reset will revert the signal path analog to digital converters and
 * filters to their power up configurations.
 * @see MPU6050_MOD_RA_SIGNAL_PATH_RESET
 * @see MPU6050_MOD_PATHRESET_TEMP_RESET_BIT
 */
void MPU6050_MOD::resetTemperaturePath() {
    I2Cdev_mod::writeBit(devAddr, MPU6050_MOD_RA_SIGNAL_PATH_RESET, MPU6050_MOD_PATHRESET_TEMP_RESET_BIT, true);
}

// MOT_DETECT_CTRL register

/** Get accelerometer power-on delay.
 * The accelerometer data path provides samples to the sensor registers, Motion
 * detection, Zero Motion detection, and Free Fall detection modules. The
 * signal path contains filters which must be flushed on wake-up with new
 * samples before the detection modules begin operations. The default wake-up
 * delay, of 4ms can be lengthened by up to 3ms. This additional delay is
 * specified in ACCEL_ON_DELAY in units of 1 LSB = 1 ms. The user may select
 * any value above zero unless instructed otherwise by InvenSense. Please refer
 * to Section 8 of the MPU-6000/MPU-6050 Product Specification document for
 * further information regarding the detection modules.
 * @return Current accelerometer power-on delay
 * @see MPU6050_MOD_RA_MOT_DETECT_CTRL
 * @see MPU6050_MOD_DETECT_ACCEL_ON_DELAY_BIT
 */
uint8_t MPU6050_MOD::getAccelerometerPowerOnDelay() {
    I2Cdev_mod::readBits(devAddr, MPU6050_MOD_RA_MOT_DETECT_CTRL, MPU6050_MOD_DETECT_ACCEL_ON_DELAY_BIT, MPU6050_MOD_DETECT_ACCEL_ON_DELAY_LENGTH, buffer);
    return buffer[0];
}
/** Set accelerometer power-on delay.
 * @param delay New accelerometer power-on delay (0-3)
 * @see getAccelerometerPowerOnDelay()
 * @see MPU6050_MOD_RA_MOT_DETECT_CTRL
 * @see MPU6050_MOD_DETECT_ACCEL_ON_DELAY_BIT
 */
void MPU6050_MOD::setAccelerometerPowerOnDelay(uint8_t delay) {
    I2Cdev_mod::writeBits(devAddr, MPU6050_MOD_RA_MOT_DETECT_CTRL, MPU6050_MOD_DETECT_ACCEL_ON_DELAY_BIT, MPU6050_MOD_DETECT_ACCEL_ON_DELAY_LENGTH, delay);
}
/** Get Free Fall detection counter decrement configuration.
 * Detection is registered by the Free Fall detection module after accelerometer
 * measurements meet their respective threshold conditions over a specified
 * number of samples. When the threshold conditions are met, the corresponding
 * detection counter increments by 1. The user may control the rate at which the
 * detection counter decrements when the threshold condition is not met by
 * configuring FF_COUNT. The decrement rate can be set according to the
 * following table:
 *
 * <pre>
 * FF_COUNT | Counter Decrement
 * ---------+------------------
 * 0        | Reset
 * 1        | 1
 * 2        | 2
 * 3        | 4
 * </pre>
 *
 * When FF_COUNT is configured to 0 (reset), any non-qualifying sample will
 * reset the counter to 0. For further information on Free Fall detection,
 * please refer to Registers 29 to 32.
 *
 * @return Current decrement configuration
 * @see MPU6050_MOD_RA_MOT_DETECT_CTRL
 * @see MPU6050_MOD_DETECT_FF_COUNT_BIT
 */
uint8_t MPU6050_MOD::getFreefallDetectionCounterDecrement() {
    I2Cdev_mod::readBits(devAddr, MPU6050_MOD_RA_MOT_DETECT_CTRL, MPU6050_MOD_DETECT_FF_COUNT_BIT, MPU6050_MOD_DETECT_FF_COUNT_LENGTH, buffer);
    return buffer[0];
}
/** Set Free Fall detection counter decrement configuration.
 * @param decrement New decrement configuration value
 * @see getFreefallDetectionCounterDecrement()
 * @see MPU6050_MOD_RA_MOT_DETECT_CTRL
 * @see MPU6050_MOD_DETECT_FF_COUNT_BIT
 */
void MPU6050_MOD::setFreefallDetectionCounterDecrement(uint8_t decrement) {
    I2Cdev_mod::writeBits(devAddr, MPU6050_MOD_RA_MOT_DETECT_CTRL, MPU6050_MOD_DETECT_FF_COUNT_BIT, MPU6050_MOD_DETECT_FF_COUNT_LENGTH, decrement);
}
/** Get Motion detection counter decrement configuration.
 * Detection is registered by the Motion detection module after accelerometer
 * measurements meet their respective threshold conditions over a specified
 * number of samples. When the threshold conditions are met, the corresponding
 * detection counter increments by 1. The user may control the rate at which the
 * detection counter decrements when the threshold condition is not met by
 * configuring MOT_COUNT. The decrement rate can be set according to the
 * following table:
 *
 * <pre>
 * MOT_COUNT | Counter Decrement
 * ----------+------------------
 * 0         | Reset
 * 1         | 1
 * 2         | 2
 * 3         | 4
 * </pre>
 *
 * When MOT_COUNT is configured to 0 (reset), any non-qualifying sample will
 * reset the counter to 0. For further information on Motion detection,
 * please refer to Registers 29 to 32.
 *
 */
uint8_t MPU6050_MOD::getMotionDetectionCounterDecrement() {
    I2Cdev_mod::readBits(devAddr, MPU6050_MOD_RA_MOT_DETECT_CTRL, MPU6050_MOD_DETECT_MOT_COUNT_BIT, MPU6050_MOD_DETECT_MOT_COUNT_LENGTH, buffer);
    return buffer[0];
}
/** Set Motion detection counter decrement configuration.
 * @param decrement New decrement configuration value
 * @see getMotionDetectionCounterDecrement()
 * @see MPU6050_MOD_RA_MOT_DETECT_CTRL
 * @see MPU6050_MOD_DETECT_MOT_COUNT_BIT
 */
void MPU6050_MOD::setMotionDetectionCounterDecrement(uint8_t decrement) {
    I2Cdev_mod::writeBits(devAddr, MPU6050_MOD_RA_MOT_DETECT_CTRL, MPU6050_MOD_DETECT_MOT_COUNT_BIT, MPU6050_MOD_DETECT_MOT_COUNT_LENGTH, decrement);
}

// USER_CTRL register

/** Get FIFO enabled status.
 * When this bit is set to 0, the FIFO buffer is disabled. The FIFO buffer
 * cannot be written to or read from while disabled. The FIFO buffer's state
 * does not change unless the MPU-60X0 is power cycled.
 * @return Current FIFO enabled status
 * @see MPU6050_MOD_RA_USER_CTRL
 * @see MPU6050_MOD_USERCTRL_FIFO_EN_BIT
 */
bool MPU6050_MOD::getFIFOEnabled() {
    I2Cdev_mod::readBit(devAddr, MPU6050_MOD_RA_USER_CTRL, MPU6050_MOD_USERCTRL_FIFO_EN_BIT, buffer);
    return buffer[0];
}
/** Set FIFO enabled status.
 * @param enabled New FIFO enabled status
 * @see getFIFOEnabled()
 * @see MPU6050_MOD_RA_USER_CTRL
 * @see MPU6050_MOD_USERCTRL_FIFO_EN_BIT
 */
void MPU6050_MOD::setFIFOEnabled(bool enabled) {
    I2Cdev_mod::writeBit(devAddr, MPU6050_MOD_RA_USER_CTRL, MPU6050_MOD_USERCTRL_FIFO_EN_BIT, enabled);
}
/** Get I2C Master Mode enabled status.
 * When this mode is enabled, the MPU-60X0 acts as the I2C Master to the
 * external sensor slave devices on the auxiliary I2C bus. When this bit is
 * cleared to 0, the auxiliary I2C bus lines (AUX_DA and AUX_CL) are logically
 * driven by the primary I2C bus (SDA and SCL). This is a precondition to
 * enabling Bypass Mode. For further information regarding Bypass Mode, please
 * refer to Register 55.
 * @return Current I2C Master Mode enabled status
 * @see MPU6050_MOD_RA_USER_CTRL
 * @see MPU6050_MOD_USERCTRL_I2C_MST_EN_BIT
 */
bool MPU6050_MOD::getI2CMasterModeEnabled() {
    I2Cdev_mod::readBit(devAddr, MPU6050_MOD_RA_USER_CTRL, MPU6050_MOD_USERCTRL_I2C_MST_EN_BIT, buffer);
    return buffer[0];
}
/** Set I2C Master Mode enabled status.
 * @param enabled New I2C Master Mode enabled status
 * @see getI2CMasterModeEnabled()
 * @see MPU6050_MOD_RA_USER_CTRL
 * @see MPU6050_MOD_USERCTRL_I2C_MST_EN_BIT
 */
void MPU6050_MOD::setI2CMasterModeEnabled(bool enabled) {
    I2Cdev_mod::writeBit(devAddr, MPU6050_MOD_RA_USER_CTRL, MPU6050_MOD_USERCTRL_I2C_MST_EN_BIT, enabled);
}
/** Switch from I2C to SPI mode (MPU-6000 only)
 * If this is set, the primary SPI interface will be enabled in place of the
 * disabled primary I2C interface.
 */
void MPU6050_MOD::switchSPIEnabled(bool enabled) {
    I2Cdev_mod::writeBit(devAddr, MPU6050_MOD_RA_USER_CTRL, MPU6050_MOD_USERCTRL_I2C_IF_DIS_BIT, enabled);
}
/** Reset the FIFO.
 * This bit resets the FIFO buffer when set to 1 while FIFO_EN equals 0. This
 * bit automatically clears to 0 after the reset has been triggered.
 * @see MPU6050_MOD_RA_USER_CTRL
 * @see MPU6050_MOD_USERCTRL_FIFO_RESET_BIT
 */
void MPU6050_MOD::resetFIFO() {
    I2Cdev_mod::writeBit(devAddr, MPU6050_MOD_RA_USER_CTRL, MPU6050_MOD_USERCTRL_FIFO_RESET_BIT, true);
}
/** Reset the I2C Master.
 * This bit resets the I2C Master when set to 1 while I2C_MST_EN equals 0.
 * This bit automatically clears to 0 after the reset has been triggered.
 * @see MPU6050_MOD_RA_USER_CTRL
 * @see MPU6050_MOD_USERCTRL_I2C_MST_RESET_BIT
 */
void MPU6050_MOD::resetI2CMaster() {
    I2Cdev_mod::writeBit(devAddr, MPU6050_MOD_RA_USER_CTRL, MPU6050_MOD_USERCTRL_I2C_MST_RESET_BIT, true);
}
/** Reset all sensor registers and signal paths.
 * When set to 1, this bit resets the signal paths for all sensors (gyroscopes,
 * accelerometers, and temperature sensor). This operation will also clear the
 * sensor registers. This bit automatically clears to 0 after the reset has been
 * triggered.
 *
 * When resetting only the signal path (and not the sensor registers), please
 * use Register 104, SIGNAL_PATH_RESET.
 *
 * @see MPU6050_MOD_RA_USER_CTRL
 * @see MPU6050_MOD_USERCTRL_SIG_COND_RESET_BIT
 */
void MPU6050_MOD::resetSensors() {
    I2Cdev_mod::writeBit(devAddr, MPU6050_MOD_RA_USER_CTRL, MPU6050_MOD_USERCTRL_SIG_COND_RESET_BIT, true);
}

// PWR_MGMT_1 register

/** Trigger a full device reset.
 * A small delay of ~50ms may be desirable after triggering a reset.
 * @see MPU6050_MOD_RA_PWR_MGMT_1
 * @see MPU6050_MOD_PWR1_DEVICE_RESET_BIT
 */
void MPU6050_MOD::reset() {
    I2Cdev_mod::writeBit(devAddr, MPU6050_MOD_RA_PWR_MGMT_1, MPU6050_MOD_PWR1_DEVICE_RESET_BIT, true);
}
/** Get sleep mode status.
 * Setting the SLEEP bit in the register puts the device into very low power
 * sleep mode. In this mode, only the serial interface and internal registers
 * remain active, allowing for a very low standby current. Clearing this bit
 * puts the device back into normal mode. To save power, the individual standby
 * selections for each of the gyros should be used if any gyro axis is not used
 * by the application.
 * @return Current sleep mode enabled status
 * @see MPU6050_MOD_RA_PWR_MGMT_1
 * @see MPU6050_MOD_PWR1_SLEEP_BIT
 */
bool MPU6050_MOD::getSleepEnabled() {
    I2Cdev_mod::readBit(devAddr, MPU6050_MOD_RA_PWR_MGMT_1, MPU6050_MOD_PWR1_SLEEP_BIT, buffer);
    return buffer[0];
}
/** Set sleep mode status.
 * @param enabled New sleep mode enabled status
 * @see getSleepEnabled()
 * @see MPU6050_MOD_RA_PWR_MGMT_1
 * @see MPU6050_MOD_PWR1_SLEEP_BIT
 */
void MPU6050_MOD::setSleepEnabled(bool enabled) {
    I2Cdev_mod::writeBit(devAddr, MPU6050_MOD_RA_PWR_MGMT_1, MPU6050_MOD_PWR1_SLEEP_BIT, enabled);
}
/** Get wake cycle enabled status.
 * When this bit is set to 1 and SLEEP is disabled, the MPU-60X0 will cycle
 * between sleep mode and waking up to take a single sample of data from active
 * sensors at a rate determined by LP_WAKE_CTRL (register 108).
 * @return Current sleep mode enabled status
 * @see MPU6050_MOD_RA_PWR_MGMT_1
 * @see MPU6050_MOD_PWR1_CYCLE_BIT
 */
bool MPU6050_MOD::getWakeCycleEnabled() {
    I2Cdev_mod::readBit(devAddr, MPU6050_MOD_RA_PWR_MGMT_1, MPU6050_MOD_PWR1_CYCLE_BIT, buffer);
    return buffer[0];
}
/** Set wake cycle enabled status.
 * @param enabled New sleep mode enabled status
 * @see getWakeCycleEnabled()
 * @see MPU6050_MOD_RA_PWR_MGMT_1
 * @see MPU6050_MOD_PWR1_CYCLE_BIT
 */
void MPU6050_MOD::setWakeCycleEnabled(bool enabled) {
    I2Cdev_mod::writeBit(devAddr, MPU6050_MOD_RA_PWR_MGMT_1, MPU6050_MOD_PWR1_CYCLE_BIT, enabled);
}
/** Get temperature sensor enabled status.
 * Control the usage of the internal temperature sensor.
 *
 * Note: this register stores the *disabled* value, but for consistency with the
 * rest of the code, the function is named and used with standard true/false
 * values to indicate whether the sensor is enabled or disabled, respectively.
 *
 * @return Current temperature sensor enabled status
 * @see MPU6050_MOD_RA_PWR_MGMT_1
 * @see MPU6050_MOD_PWR1_TEMP_DIS_BIT
 */
bool MPU6050_MOD::getTempSensorEnabled() {
    I2Cdev_mod::readBit(devAddr, MPU6050_MOD_RA_PWR_MGMT_1, MPU6050_MOD_PWR1_TEMP_DIS_BIT, buffer);
    return buffer[0] == 0; // 1 is actually disabled here
}
/** Set temperature sensor enabled status.
 * Note: this register stores the *disabled* value, but for consistency with the
 * rest of the code, the function is named and used with standard true/false
 * values to indicate whether the sensor is enabled or disabled, respectively.
 *
 * @param enabled New temperature sensor enabled status
 * @see getTempSensorEnabled()
 * @see MPU6050_MOD_RA_PWR_MGMT_1
 * @see MPU6050_MOD_PWR1_TEMP_DIS_BIT
 */
void MPU6050_MOD::setTempSensorEnabled(bool enabled) {
    // 1 is actually disabled here
    I2Cdev_mod::writeBit(devAddr, MPU6050_MOD_RA_PWR_MGMT_1, MPU6050_MOD_PWR1_TEMP_DIS_BIT, !enabled);
}
/** Get clock source setting.
 * @return Current clock source setting
 * @see MPU6050_MOD_RA_PWR_MGMT_1
 * @see MPU6050_MOD_PWR1_CLKSEL_BIT
 * @see MPU6050_MOD_PWR1_CLKSEL_LENGTH
 */
uint8_t MPU6050_MOD::getClockSource() {
    I2Cdev_mod::readBits(devAddr, MPU6050_MOD_RA_PWR_MGMT_1, MPU6050_MOD_PWR1_CLKSEL_BIT, MPU6050_MOD_PWR1_CLKSEL_LENGTH, buffer);
    return buffer[0];
}
/** Set clock source setting.
 * An internal 8MHz oscillator, gyroscope based clock, or external sources can
 * be selected as the MPU-60X0 clock source. When the internal 8 MHz oscillator
 * or an external source is chosen as the clock source, the MPU-60X0 can operate
 * in low power modes with the gyroscopes disabled.
 *
 * Upon power up, the MPU-60X0 clock source defaults to the internal oscillator.
 * However, it is highly recommended that the device be configured to use one of
 * the gyroscopes (or an external clock source) as the clock reference for
 * improved stability. The clock source can be selected according to the following table:
 *
 * <pre>
 * CLK_SEL | Clock Source
 * --------+--------------------------------------
 * 0       | Internal oscillator
 * 1       | PLL with X Gyro reference
 * 2       | PLL with Y Gyro reference
 * 3       | PLL with Z Gyro reference
 * 4       | PLL with external 32.768kHz reference
 * 5       | PLL with external 19.2MHz reference
 * 6       | Reserved
 * 7       | Stops the clock and keeps the timing generator in reset
 * </pre>
 *
 * @param source New clock source setting
 * @see getClockSource()
 * @see MPU6050_MOD_RA_PWR_MGMT_1
 * @see MPU6050_MOD_PWR1_CLKSEL_BIT
 * @see MPU6050_MOD_PWR1_CLKSEL_LENGTH
 */
void MPU6050_MOD::setClockSource(uint8_t source) {
    I2Cdev_mod::writeBits(devAddr, MPU6050_MOD_RA_PWR_MGMT_1, MPU6050_MOD_PWR1_CLKSEL_BIT, MPU6050_MOD_PWR1_CLKSEL_LENGTH, source);
}

// PWR_MGMT_2 register

/** Get wake frequency in Accel-Only Low Power Mode.
 * The MPU-60X0 can be put into Accerlerometer Only Low Power Mode by setting
 * PWRSEL to 1 in the Power Management 1 register (Register 107). In this mode,
 * the device will power off all devices except for the primary I2C interface,
 * waking only the accelerometer at fixed intervals to take a single
 * measurement. The frequency of wake-ups can be configured with LP_WAKE_CTRL
 * as shown below:
 *
 * <pre>
 * LP_WAKE_CTRL | Wake-up Frequency
 * -------------+------------------
 * 0            | 1.25 Hz
 * 1            | 2.5 Hz
 * 2            | 5 Hz
 * 3            | 10 Hz
 * </pre>
 *
 * For further information regarding the MPU-60X0's power modes, please refer to
 * Register 107.
 *
 * @return Current wake frequency
 * @see MPU6050_MOD_RA_PWR_MGMT_2
 */
uint8_t MPU6050_MOD::getWakeFrequency() {
    I2Cdev_mod::readBits(devAddr, MPU6050_MOD_RA_PWR_MGMT_2, MPU6050_MOD_PWR2_LP_WAKE_CTRL_BIT, MPU6050_MOD_PWR2_LP_WAKE_CTRL_LENGTH, buffer);
    return buffer[0];
}
/** Set wake frequency in Accel-Only Low Power Mode.
 * @param frequency New wake frequency
 * @see MPU6050_MOD_RA_PWR_MGMT_2
 */
void MPU6050_MOD::setWakeFrequency(uint8_t frequency) {
    I2Cdev_mod::writeBits(devAddr, MPU6050_MOD_RA_PWR_MGMT_2, MPU6050_MOD_PWR2_LP_WAKE_CTRL_BIT, MPU6050_MOD_PWR2_LP_WAKE_CTRL_LENGTH, frequency);
}

/** Get X-axis accelerometer standby enabled status.
 * If enabled, the X-axis will not gather or report data (or use power).
 * @return Current X-axis standby enabled status
 * @see MPU6050_MOD_RA_PWR_MGMT_2
 * @see MPU6050_MOD_PWR2_STBY_XA_BIT
 */
bool MPU6050_MOD::getStandbyXAccelEnabled() {
    I2Cdev_mod::readBit(devAddr, MPU6050_MOD_RA_PWR_MGMT_2, MPU6050_MOD_PWR2_STBY_XA_BIT, buffer);
    return buffer[0];
}
/** Set X-axis accelerometer standby enabled status.
 * @param New X-axis standby enabled status
 * @see getStandbyXAccelEnabled()
 * @see MPU6050_MOD_RA_PWR_MGMT_2
 * @see MPU6050_MOD_PWR2_STBY_XA_BIT
 */
void MPU6050_MOD::setStandbyXAccelEnabled(bool enabled) {
    I2Cdev_mod::writeBit(devAddr, MPU6050_MOD_RA_PWR_MGMT_2, MPU6050_MOD_PWR2_STBY_XA_BIT, enabled);
}
/** Get Y-axis accelerometer standby enabled status.
 * If enabled, the Y-axis will not gather or report data (or use power).
 * @return Current Y-axis standby enabled status
 * @see MPU6050_MOD_RA_PWR_MGMT_2
 * @see MPU6050_MOD_PWR2_STBY_YA_BIT
 */
bool MPU6050_MOD::getStandbyYAccelEnabled() {
    I2Cdev_mod::readBit(devAddr, MPU6050_MOD_RA_PWR_MGMT_2, MPU6050_MOD_PWR2_STBY_YA_BIT, buffer);
    return buffer[0];
}
/** Set Y-axis accelerometer standby enabled status.
 * @param New Y-axis standby enabled status
 * @see getStandbyYAccelEnabled()
 * @see MPU6050_MOD_RA_PWR_MGMT_2
 * @see MPU6050_MOD_PWR2_STBY_YA_BIT
 */
void MPU6050_MOD::setStandbyYAccelEnabled(bool enabled) {
    I2Cdev_mod::writeBit(devAddr, MPU6050_MOD_RA_PWR_MGMT_2, MPU6050_MOD_PWR2_STBY_YA_BIT, enabled);
}
/** Get Z-axis accelerometer standby enabled status.
 * If enabled, the Z-axis will not gather or report data (or use power).
 * @return Current Z-axis standby enabled status
 * @see MPU6050_MOD_RA_PWR_MGMT_2
 * @see MPU6050_MOD_PWR2_STBY_ZA_BIT
 */
bool MPU6050_MOD::getStandbyZAccelEnabled() {
    I2Cdev_mod::readBit(devAddr, MPU6050_MOD_RA_PWR_MGMT_2, MPU6050_MOD_PWR2_STBY_ZA_BIT, buffer);
    return buffer[0];
}
/** Set Z-axis accelerometer standby enabled status.
 * @param New Z-axis standby enabled status
 * @see getStandbyZAccelEnabled()
 * @see MPU6050_MOD_RA_PWR_MGMT_2
 * @see MPU6050_MOD_PWR2_STBY_ZA_BIT
 */
void MPU6050_MOD::setStandbyZAccelEnabled(bool enabled) {
    I2Cdev_mod::writeBit(devAddr, MPU6050_MOD_RA_PWR_MGMT_2, MPU6050_MOD_PWR2_STBY_ZA_BIT, enabled);
}
/** Get X-axis gyroscope standby enabled status.
 * If enabled, the X-axis will not gather or report data (or use power).
 * @return Current X-axis standby enabled status
 * @see MPU6050_MOD_RA_PWR_MGMT_2
 * @see MPU6050_MOD_PWR2_STBY_XG_BIT
 */
bool MPU6050_MOD::getStandbyXGyroEnabled() {
    I2Cdev_mod::readBit(devAddr, MPU6050_MOD_RA_PWR_MGMT_2, MPU6050_MOD_PWR2_STBY_XG_BIT, buffer);
    return buffer[0];
}
/** Set X-axis gyroscope standby enabled status.
 * @param New X-axis standby enabled status
 * @see getStandbyXGyroEnabled()
 * @see MPU6050_MOD_RA_PWR_MGMT_2
 * @see MPU6050_MOD_PWR2_STBY_XG_BIT
 */
void MPU6050_MOD::setStandbyXGyroEnabled(bool enabled) {
    I2Cdev_mod::writeBit(devAddr, MPU6050_MOD_RA_PWR_MGMT_2, MPU6050_MOD_PWR2_STBY_XG_BIT, enabled);
}
/** Get Y-axis gyroscope standby enabled status.
 * If enabled, the Y-axis will not gather or report data (or use power).
 * @return Current Y-axis standby enabled status
 * @see MPU6050_MOD_RA_PWR_MGMT_2
 * @see MPU6050_MOD_PWR2_STBY_YG_BIT
 */
bool MPU6050_MOD::getStandbyYGyroEnabled() {
    I2Cdev_mod::readBit(devAddr, MPU6050_MOD_RA_PWR_MGMT_2, MPU6050_MOD_PWR2_STBY_YG_BIT, buffer);
    return buffer[0];
}
/** Set Y-axis gyroscope standby enabled status.
 * @param New Y-axis standby enabled status
 * @see getStandbyYGyroEnabled()
 * @see MPU6050_MOD_RA_PWR_MGMT_2
 * @see MPU6050_MOD_PWR2_STBY_YG_BIT
 */
void MPU6050_MOD::setStandbyYGyroEnabled(bool enabled) {
    I2Cdev_mod::writeBit(devAddr, MPU6050_MOD_RA_PWR_MGMT_2, MPU6050_MOD_PWR2_STBY_YG_BIT, enabled);
}
/** Get Z-axis gyroscope standby enabled status.
 * If enabled, the Z-axis will not gather or report data (or use power).
 * @return Current Z-axis standby enabled status
 * @see MPU6050_MOD_RA_PWR_MGMT_2
 * @see MPU6050_MOD_PWR2_STBY_ZG_BIT
 */
bool MPU6050_MOD::getStandbyZGyroEnabled() {
    I2Cdev_mod::readBit(devAddr, MPU6050_MOD_RA_PWR_MGMT_2, MPU6050_MOD_PWR2_STBY_ZG_BIT, buffer);
    return buffer[0];
}
/** Set Z-axis gyroscope standby enabled status.
 * @param New Z-axis standby enabled status
 * @see getStandbyZGyroEnabled()
 * @see MPU6050_MOD_RA_PWR_MGMT_2
 * @see MPU6050_MOD_PWR2_STBY_ZG_BIT
 */
void MPU6050_MOD::setStandbyZGyroEnabled(bool enabled) {
    I2Cdev_mod::writeBit(devAddr, MPU6050_MOD_RA_PWR_MGMT_2, MPU6050_MOD_PWR2_STBY_ZG_BIT, enabled);
}

// FIFO_COUNT* registers

/** Get current FIFO buffer size.
 * This value indicates the number of bytes stored in the FIFO buffer. This
 * number is in turn the number of bytes that can be read from the FIFO buffer
 * and it is directly proportional to the number of samples available given the
 * set of sensor data bound to be stored in the FIFO (register 35 and 36).
 * @return Current FIFO buffer size
 */
uint16_t MPU6050_MOD::getFIFOCount() {
    I2Cdev_mod::readBytes(devAddr, MPU6050_MOD_RA_FIFO_COUNTH, 2, buffer);
    return (((uint16_t)buffer[0]) << 8) | buffer[1];
}

// FIFO_R_W register

/** Get byte from FIFO buffer.
 * This register is used to read and write data from the FIFO buffer. Data is
 * written to the FIFO in order of register number (from lowest to highest). If
 * all the FIFO enable flags (see below) are enabled and all External Sensor
 * Data registers (Registers 73 to 96) are associated with a Slave device, the
 * contents of registers 59 through 96 will be written in order at the Sample
 * Rate.
 *
 * The contents of the sensor data registers (Registers 59 to 96) are written
 * into the FIFO buffer when their corresponding FIFO enable flags are set to 1
 * in FIFO_EN (Register 35). An additional flag for the sensor data registers
 * associated with I2C Slave 3 can be found in I2C_MST_CTRL (Register 36).
 *
 * If the FIFO buffer has overflowed, the status bit FIFO_OFLOW_INT is
 * automatically set to 1. This bit is located in INT_STATUS (Register 58).
 * When the FIFO buffer has overflowed, the oldest data will be lost and new
 * data will be written to the FIFO.
 *
 * If the FIFO buffer is empty, reading this register will return the last byte
 * that was previously read from the FIFO until new data is available. The user
 * should check FIFO_COUNT to ensure that the FIFO buffer is not read when
 * empty.
 *
 * @return Byte from FIFO buffer
 */
uint8_t MPU6050_MOD::getFIFOByte() {
    I2Cdev_mod::readByte(devAddr, MPU6050_MOD_RA_FIFO_R_W, buffer);
    return buffer[0];
}
void MPU6050_MOD::getFIFOBytes(uint8_t *data, uint8_t length) {
    if(length > 0){
        I2Cdev_mod::readBytes(devAddr, MPU6050_MOD_RA_FIFO_R_W, length, data);
    } else {
    	*data = 0;
    }
}
/** Write byte to FIFO buffer.
 * @see getFIFOByte()
 * @see MPU6050_MOD_RA_FIFO_R_W
 */
void MPU6050_MOD::setFIFOByte(uint8_t data) {
    I2Cdev_mod::writeByte(devAddr, MPU6050_MOD_RA_FIFO_R_W, data);
}

// WHO_AM_I register

/** Get Device ID.
 * This register is used to verify the identity of the device (0b110100, 0x34).
 * @return Device ID (6 bits only! should be 0x34)
 * @see MPU6050_MOD_RA_WHO_AM_I
 * @see MPU6050_MOD_WHO_AM_I_BIT
 * @see MPU6050_MOD_WHO_AM_I_LENGTH
 */
uint8_t MPU6050_MOD::getDeviceID() {
    I2Cdev_mod::readBits(devAddr, MPU6050_MOD_RA_WHO_AM_I, MPU6050_MOD_WHO_AM_I_BIT, MPU6050_MOD_WHO_AM_I_LENGTH, buffer);
    return buffer[0];
}
/** Set Device ID.
 * Write a new ID into the WHO_AM_I register (no idea why this should ever be
 * necessary though).
 * @param id New device ID to set.
 * @see getDeviceID()
 * @see MPU6050_MOD_RA_WHO_AM_I
 * @see MPU6050_MOD_WHO_AM_I_BIT
 * @see MPU6050_MOD_WHO_AM_I_LENGTH
 */
void MPU6050_MOD::setDeviceID(uint8_t id) {
    I2Cdev_mod::writeBits(devAddr, MPU6050_MOD_RA_WHO_AM_I, MPU6050_MOD_WHO_AM_I_BIT, MPU6050_MOD_WHO_AM_I_LENGTH, id);
}

// ======== UNDOCUMENTED/DMP REGISTERS/METHODS ========

// XG_OFFS_TC register

uint8_t MPU6050_MOD::getOTPBankValid() {
    I2Cdev_mod::readBit(devAddr, MPU6050_MOD_RA_XG_OFFS_TC, MPU6050_MOD_TC_OTP_BNK_VLD_BIT, buffer);
    return buffer[0];
}
void MPU6050_MOD::setOTPBankValid(bool enabled) {
    I2Cdev_mod::writeBit(devAddr, MPU6050_MOD_RA_XG_OFFS_TC, MPU6050_MOD_TC_OTP_BNK_VLD_BIT, enabled);
}
int8_t MPU6050_MOD::getXGyroOffsetTC() {
    I2Cdev_mod::readBits(devAddr, MPU6050_MOD_RA_XG_OFFS_TC, MPU6050_MOD_TC_OFFSET_BIT, MPU6050_MOD_TC_OFFSET_LENGTH, buffer);
    return buffer[0];
}
void MPU6050_MOD::setXGyroOffsetTC(int8_t offset) {
    I2Cdev_mod::writeBits(devAddr, MPU6050_MOD_RA_XG_OFFS_TC, MPU6050_MOD_TC_OFFSET_BIT, MPU6050_MOD_TC_OFFSET_LENGTH, offset);
}

// YG_OFFS_TC register

int8_t MPU6050_MOD::getYGyroOffsetTC() {
    I2Cdev_mod::readBits(devAddr, MPU6050_MOD_RA_YG_OFFS_TC, MPU6050_MOD_TC_OFFSET_BIT, MPU6050_MOD_TC_OFFSET_LENGTH, buffer);
    return buffer[0];
}
void MPU6050_MOD::setYGyroOffsetTC(int8_t offset) {
    I2Cdev_mod::writeBits(devAddr, MPU6050_MOD_RA_YG_OFFS_TC, MPU6050_MOD_TC_OFFSET_BIT, MPU6050_MOD_TC_OFFSET_LENGTH, offset);
}

// ZG_OFFS_TC register

int8_t MPU6050_MOD::getZGyroOffsetTC() {
    I2Cdev_mod::readBits(devAddr, MPU6050_MOD_RA_ZG_OFFS_TC, MPU6050_MOD_TC_OFFSET_BIT, MPU6050_MOD_TC_OFFSET_LENGTH, buffer);
    return buffer[0];
}
void MPU6050_MOD::setZGyroOffsetTC(int8_t offset) {
    I2Cdev_mod::writeBits(devAddr, MPU6050_MOD_RA_ZG_OFFS_TC, MPU6050_MOD_TC_OFFSET_BIT, MPU6050_MOD_TC_OFFSET_LENGTH, offset);
}

// X_FINE_GAIN register

int8_t MPU6050_MOD::getXFineGain() {
    I2Cdev_mod::readByte(devAddr, MPU6050_MOD_RA_X_FINE_GAIN, buffer);
    return buffer[0];
}
void MPU6050_MOD::setXFineGain(int8_t gain) {
    I2Cdev_mod::writeByte(devAddr, MPU6050_MOD_RA_X_FINE_GAIN, gain);
}

// Y_FINE_GAIN register

int8_t MPU6050_MOD::getYFineGain() {
    I2Cdev_mod::readByte(devAddr, MPU6050_MOD_RA_Y_FINE_GAIN, buffer);
    return buffer[0];
}
void MPU6050_MOD::setYFineGain(int8_t gain) {
    I2Cdev_mod::writeByte(devAddr, MPU6050_MOD_RA_Y_FINE_GAIN, gain);
}

// Z_FINE_GAIN register

int8_t MPU6050_MOD::getZFineGain() {
    I2Cdev_mod::readByte(devAddr, MPU6050_MOD_RA_Z_FINE_GAIN, buffer);
    return buffer[0];
}
void MPU6050_MOD::setZFineGain(int8_t gain) {
    I2Cdev_mod::writeByte(devAddr, MPU6050_MOD_RA_Z_FINE_GAIN, gain);
}

// XA_OFFS_* registers

int16_t MPU6050_MOD::getXAccelOffset() {
	uint8_t SaveAddress = ((getDeviceID() < 0x38 )? MPU6050_MOD_RA_XA_OFFS_H:0x77); // MPU6050_MOD,MPU9150 Vs MPU6500,MPU9250
	I2Cdev_mod::readBytes(devAddr, SaveAddress, 2, buffer);
	return (((int16_t)buffer[0]) << 8) | buffer[1];
}
void MPU6050_MOD::setXAccelOffset(int16_t offset) {
	uint8_t SaveAddress = ((getDeviceID() < 0x38 )? MPU6050_MOD_RA_XA_OFFS_H:0x77); // MPU6050_MOD,MPU9150 Vs MPU6500,MPU9250
	I2Cdev_mod::writeWord(devAddr, SaveAddress, offset);
}

// YA_OFFS_* register

int16_t MPU6050_MOD::getYAccelOffset() {
	uint8_t SaveAddress = ((getDeviceID() < 0x38 )? MPU6050_MOD_RA_YA_OFFS_H:0x7A); // MPU6050_MOD,MPU9150 Vs MPU6500,MPU9250
	I2Cdev_mod::readBytes(devAddr, SaveAddress, 2, buffer);
	return (((int16_t)buffer[0]) << 8) | buffer[1];
}
void MPU6050_MOD::setYAccelOffset(int16_t offset) {
	uint8_t SaveAddress = ((getDeviceID() < 0x38 )? MPU6050_MOD_RA_YA_OFFS_H:0x7A); // MPU6050_MOD,MPU9150 Vs MPU6500,MPU9250
	I2Cdev_mod::writeWord(devAddr, SaveAddress, offset);
}

// ZA_OFFS_* register

int16_t MPU6050_MOD::getZAccelOffset() {
	uint8_t SaveAddress = ((getDeviceID() < 0x38 )? MPU6050_MOD_RA_ZA_OFFS_H:0x7D); // MPU6050_MOD,MPU9150 Vs MPU6500,MPU9250
	I2Cdev_mod::readBytes(devAddr, SaveAddress, 2, buffer);
	return (((int16_t)buffer[0]) << 8) | buffer[1];
}
void MPU6050_MOD::setZAccelOffset(int16_t offset) {
	uint8_t SaveAddress = ((getDeviceID() < 0x38 )? MPU6050_MOD_RA_ZA_OFFS_H:0x7D); // MPU6050_MOD,MPU9150 Vs MPU6500,MPU9250
	I2Cdev_mod::writeWord(devAddr, SaveAddress, offset);
}

// XG_OFFS_USR* registers

int16_t MPU6050_MOD::getXGyroOffset() {
    I2Cdev_mod::readBytes(devAddr, MPU6050_MOD_RA_XG_OFFS_USRH, 2, buffer);
    return (((int16_t)buffer[0]) << 8) | buffer[1];
}
void MPU6050_MOD::setXGyroOffset(int16_t offset) {
    I2Cdev_mod::writeWord(devAddr, MPU6050_MOD_RA_XG_OFFS_USRH, offset);
}

// YG_OFFS_USR* register

int16_t MPU6050_MOD::getYGyroOffset() {
    I2Cdev_mod::readBytes(devAddr, MPU6050_MOD_RA_YG_OFFS_USRH, 2, buffer);
    return (((int16_t)buffer[0]) << 8) | buffer[1];
}
void MPU6050_MOD::setYGyroOffset(int16_t offset) {
    I2Cdev_mod::writeWord(devAddr, MPU6050_MOD_RA_YG_OFFS_USRH, offset);
}

// ZG_OFFS_USR* register

int16_t MPU6050_MOD::getZGyroOffset() {
    I2Cdev_mod::readBytes(devAddr, MPU6050_MOD_RA_ZG_OFFS_USRH, 2, buffer);
    return (((int16_t)buffer[0]) << 8) | buffer[1];
}
void MPU6050_MOD::setZGyroOffset(int16_t offset) {
    I2Cdev_mod::writeWord(devAddr, MPU6050_MOD_RA_ZG_OFFS_USRH, offset);
}

// INT_ENABLE register (DMP functions)

bool MPU6050_MOD::getIntPLLReadyEnabled() {
    I2Cdev_mod::readBit(devAddr, MPU6050_MOD_RA_INT_ENABLE, MPU6050_MOD_INTERRUPT_PLL_RDY_INT_BIT, buffer);
    return buffer[0];
}
void MPU6050_MOD::setIntPLLReadyEnabled(bool enabled) {
    I2Cdev_mod::writeBit(devAddr, MPU6050_MOD_RA_INT_ENABLE, MPU6050_MOD_INTERRUPT_PLL_RDY_INT_BIT, enabled);
}
bool MPU6050_MOD::getIntDMPEnabled() {
    I2Cdev_mod::readBit(devAddr, MPU6050_MOD_RA_INT_ENABLE, MPU6050_MOD_INTERRUPT_DMP_INT_BIT, buffer);
    return buffer[0];
}
void MPU6050_MOD::setIntDMPEnabled(bool enabled) {
    I2Cdev_mod::writeBit(devAddr, MPU6050_MOD_RA_INT_ENABLE, MPU6050_MOD_INTERRUPT_DMP_INT_BIT, enabled);
}

// DMP_INT_STATUS

bool MPU6050_MOD::getDMPInt5Status() {
    I2Cdev_mod::readBit(devAddr, MPU6050_MOD_RA_DMP_INT_STATUS, MPU6050_MOD_DMPINT_5_BIT, buffer);
    return buffer[0];
}
bool MPU6050_MOD::getDMPInt4Status() {
    I2Cdev_mod::readBit(devAddr, MPU6050_MOD_RA_DMP_INT_STATUS, MPU6050_MOD_DMPINT_4_BIT, buffer);
    return buffer[0];
}
bool MPU6050_MOD::getDMPInt3Status() {
    I2Cdev_mod::readBit(devAddr, MPU6050_MOD_RA_DMP_INT_STATUS, MPU6050_MOD_DMPINT_3_BIT, buffer);
    return buffer[0];
}
bool MPU6050_MOD::getDMPInt2Status() {
    I2Cdev_mod::readBit(devAddr, MPU6050_MOD_RA_DMP_INT_STATUS, MPU6050_MOD_DMPINT_2_BIT, buffer);
    return buffer[0];
}
bool MPU6050_MOD::getDMPInt1Status() {
    I2Cdev_mod::readBit(devAddr, MPU6050_MOD_RA_DMP_INT_STATUS, MPU6050_MOD_DMPINT_1_BIT, buffer);
    return buffer[0];
}
bool MPU6050_MOD::getDMPInt0Status() {
    I2Cdev_mod::readBit(devAddr, MPU6050_MOD_RA_DMP_INT_STATUS, MPU6050_MOD_DMPINT_0_BIT, buffer);
    return buffer[0];
}

// INT_STATUS register (DMP functions)

bool MPU6050_MOD::getIntPLLReadyStatus() {
    I2Cdev_mod::readBit(devAddr, MPU6050_MOD_RA_INT_STATUS, MPU6050_MOD_INTERRUPT_PLL_RDY_INT_BIT, buffer);
    return buffer[0];
}
bool MPU6050_MOD::getIntDMPStatus() {
    I2Cdev_mod::readBit(devAddr, MPU6050_MOD_RA_INT_STATUS, MPU6050_MOD_INTERRUPT_DMP_INT_BIT, buffer);
    return buffer[0];
}

// USER_CTRL register (DMP functions)

bool MPU6050_MOD::getDMPEnabled() {
    I2Cdev_mod::readBit(devAddr, MPU6050_MOD_RA_USER_CTRL, MPU6050_MOD_USERCTRL_DMP_EN_BIT, buffer);
    return buffer[0];
}
void MPU6050_MOD::setDMPEnabled(bool enabled) {
    I2Cdev_mod::writeBit(devAddr, MPU6050_MOD_RA_USER_CTRL, MPU6050_MOD_USERCTRL_DMP_EN_BIT, enabled);
}
void MPU6050_MOD::resetDMP() {
    I2Cdev_mod::writeBit(devAddr, MPU6050_MOD_RA_USER_CTRL, MPU6050_MOD_USERCTRL_DMP_RESET_BIT, true);
}

// BANK_SEL register

void MPU6050_MOD::setMemoryBank(uint8_t bank, bool prefetchEnabled, bool userBank) {
    bank &= 0x1F;
    if (userBank) bank |= 0x20;
    if (prefetchEnabled) bank |= 0x40;
    I2Cdev_mod::writeByte(devAddr, MPU6050_MOD_RA_BANK_SEL, bank);
}

// MEM_START_ADDR register

void MPU6050_MOD::setMemoryStartAddress(uint8_t address) {
    I2Cdev_mod::writeByte(devAddr, MPU6050_MOD_RA_MEM_START_ADDR, address);
}

// MEM_R_W register

uint8_t MPU6050_MOD::readMemoryByte() {
    I2Cdev_mod::readByte(devAddr, MPU6050_MOD_RA_MEM_R_W, buffer);
    return buffer[0];
}
void MPU6050_MOD::writeMemoryByte(uint8_t data) {
    I2Cdev_mod::writeByte(devAddr, MPU6050_MOD_RA_MEM_R_W, data);
}
void MPU6050_MOD::readMemoryBlock(uint8_t *data, uint16_t dataSize, uint8_t bank, uint8_t address) {
    setMemoryBank(bank);
    setMemoryStartAddress(address);
    uint8_t chunkSize;
    for (uint16_t i = 0; i < dataSize;) {
        // determine correct chunk size according to bank position and data size
        chunkSize = MPU6050_MOD_DMP_MEMORY_CHUNK_SIZE;

        // make sure we don't go past the data size
        if (i + chunkSize > dataSize) chunkSize = dataSize - i;

        // make sure this chunk doesn't go past the bank boundary (256 bytes)
        if (chunkSize > 256 - address) chunkSize = 256 - address;

        // read the chunk of data as specified
        I2Cdev_mod::readBytes(devAddr, MPU6050_MOD_RA_MEM_R_W, chunkSize, data + i);
        
        // increase byte index by [chunkSize]
        i += chunkSize;

        // uint8_t automatically wraps to 0 at 256
        address += chunkSize;

        // if we aren't done, update bank (if necessary) and address
        if (i < dataSize) {
            if (address == 0) bank++;
            setMemoryBank(bank);
            setMemoryStartAddress(address);
        }
    }
}
bool MPU6050_MOD::writeMemoryBlock(const uint8_t *data, uint16_t dataSize, uint8_t bank, uint8_t address, bool verify, bool useProgMem) {
    setMemoryBank(bank);
    setMemoryStartAddress(address);
    uint8_t chunkSize;
    uint8_t *verifyBuffer=0;
    uint8_t *progBuffer=0;
    uint16_t i;
    uint8_t j;
    if (verify) verifyBuffer = (uint8_t *)malloc(MPU6050_MOD_DMP_MEMORY_CHUNK_SIZE);
    if (useProgMem) progBuffer = (uint8_t *)malloc(MPU6050_MOD_DMP_MEMORY_CHUNK_SIZE);
    for (i = 0; i < dataSize;) {
        // determine correct chunk size according to bank position and data size
        chunkSize = MPU6050_MOD_DMP_MEMORY_CHUNK_SIZE;

        // make sure we don't go past the data size
        if (i + chunkSize > dataSize) chunkSize = dataSize - i;

        // make sure this chunk doesn't go past the bank boundary (256 bytes)
        if (chunkSize > 256 - address) chunkSize = 256 - address;
        
        if (useProgMem) {
            // write the chunk of data as specified
            for (j = 0; j < chunkSize; j++) progBuffer[j] = pgm_read_byte(data + i + j);
        } else {
            // write the chunk of data as specified
            progBuffer = (uint8_t *)data + i;
        }

        I2Cdev_mod::writeBytes(devAddr, MPU6050_MOD_RA_MEM_R_W, chunkSize, progBuffer);

        // verify data if needed
        if (verify && verifyBuffer) {
            setMemoryBank(bank);
            setMemoryStartAddress(address);
            I2Cdev_mod::readBytes(devAddr, MPU6050_MOD_RA_MEM_R_W, chunkSize, verifyBuffer);
            if (memcmp(progBuffer, verifyBuffer, chunkSize) != 0) {
                /*Serial.print("Block write verification error, bank ");
                Serial.print(bank, DEC);
                Serial.print(", address ");
                Serial.print(address, DEC);
                Serial.print("!\nExpected:");
                for (j = 0; j < chunkSize; j++) {
                    Serial.print(" 0x");
                    if (progBuffer[j] < 16) Serial.print("0");
                    Serial.print(progBuffer[j], HEX);
                }
                Serial.print("\nReceived:");
                for (uint8_t j = 0; j < chunkSize; j++) {
                    Serial.print(" 0x");
                    if (verifyBuffer[i + j] < 16) Serial.print("0");
                    Serial.print(verifyBuffer[i + j], HEX);
                }
                Serial.print("\n");*/
                free(verifyBuffer);
                if (useProgMem) free(progBuffer);
                return false; // uh oh.
            }
        }

        // increase byte index by [chunkSize]
        i += chunkSize;

        // uint8_t automatically wraps to 0 at 256
        address += chunkSize;

        // if we aren't done, update bank (if necessary) and address
        if (i < dataSize) {
            if (address == 0) bank++;
            setMemoryBank(bank);
            setMemoryStartAddress(address);
        }
    }
    if (verify) free(verifyBuffer);
    if (useProgMem) free(progBuffer);
    return true;
}
bool MPU6050_MOD::writeProgMemoryBlock(const uint8_t *data, uint16_t dataSize, uint8_t bank, uint8_t address, bool verify) {
    return writeMemoryBlock(data, dataSize, bank, address, verify, true);
}
bool MPU6050_MOD::writeDMPConfigurationSet(const uint8_t *data, uint16_t dataSize, bool useProgMem) {
    uint8_t *progBuffer = 0;
	uint8_t success, special;
    uint16_t i, j;
    if (useProgMem) {
        progBuffer = (uint8_t *)malloc(8); // assume 8-byte blocks, realloc later if necessary
    }

    // config set data is a long string of blocks with the following structure:
    // [bank] [offset] [length] [byte[0], byte[1], ..., byte[length]]
    uint8_t bank, offset, length;
    for (i = 0; i < dataSize;) {
        if (useProgMem) {
            bank = pgm_read_byte(data + i++);
            offset = pgm_read_byte(data + i++);
            length = pgm_read_byte(data + i++);
        } else {
            bank = data[i++];
            offset = data[i++];
            length = data[i++];
        }

        // write data or perform special action
        if (length > 0) {
            // regular block of data to write
            /*Serial.print("Writing config block to bank ");
            Serial.print(bank);
            Serial.print(", offset ");
            Serial.print(offset);
            Serial.print(", length=");
            Serial.println(length);*/
            if (useProgMem) {
                if (sizeof(progBuffer) < length) progBuffer = (uint8_t *)realloc(progBuffer, length);
                for (j = 0; j < length; j++) progBuffer[j] = pgm_read_byte(data + i + j);
            } else {
                progBuffer = (uint8_t *)data + i;
            }
            success = writeMemoryBlock(progBuffer, length, bank, offset, true);
            i += length;
        } else {
            // special instruction
            // NOTE: this kind of behavior (what and when to do certain things)
            // is totally undocumented. This code is in here based on observed
            // behavior only, and exactly why (or even whether) it has to be here
            // is anybody's guess for now.
            if (useProgMem) {
                special = pgm_read_byte(data + i++);
            } else {
                special = data[i++];
            }
            /*Serial.print("Special command code ");
            Serial.print(special, HEX);
            Serial.println(" found...");*/
            if (special == 0x01) {
                // enable DMP-related interrupts
                
                //setIntZeroMotionEnabled(true);
                //setIntFIFOBufferOverflowEnabled(true);
                //setIntDMPEnabled(true);
                I2Cdev_mod::writeByte(devAddr, MPU6050_MOD_RA_INT_ENABLE, 0x32);  // single operation

                success = true;
            } else {
                // unknown special command
                success = false;
            }
        }
        
        if (!success) {
            if (useProgMem) free(progBuffer);
            return false; // uh oh
        }
    }
    if (useProgMem) free(progBuffer);
    return true;
}
bool MPU6050_MOD::writeProgDMPConfigurationSet(const uint8_t *data, uint16_t dataSize) {
    return writeDMPConfigurationSet(data, dataSize, true);
}

// DMP_CFG_1 register

uint8_t MPU6050_MOD::getDMPConfig1() {
    I2Cdev_mod::readByte(devAddr, MPU6050_MOD_RA_DMP_CFG_1, buffer);
    return buffer[0];
}
void MPU6050_MOD::setDMPConfig1(uint8_t config) {
    I2Cdev_mod::writeByte(devAddr, MPU6050_MOD_RA_DMP_CFG_1, config);
}

// DMP_CFG_2 register

uint8_t MPU6050_MOD::getDMPConfig2() {
    I2Cdev_mod::readByte(devAddr, MPU6050_MOD_RA_DMP_CFG_2, buffer);
    return buffer[0];
}
void MPU6050_MOD::setDMPConfig2(uint8_t config) {
    I2Cdev_mod::writeByte(devAddr, MPU6050_MOD_RA_DMP_CFG_2, config);
}


//***************************************************************************************
//**********************           Calibration Routines            **********************
//***************************************************************************************
/**
  @brief      Fully calibrate Gyro from ZERO in about 6-7 Loops 600-700 readings
*/
void MPU6050_MOD::CalibrateGyro(uint8_t Loops ) {
  double kP = 0.3;
  double kI = 90;
  float x;
  x = (100 - map(Loops, 1, 5, 20, 0)) * .01;
  kP *= x;
  kI *= x;
  
  PID( 0x43,  kP, kI,  Loops);
}

/**
  @brief      Fully calibrate Accel from ZERO in about 6-7 Loops 600-700 readings
*/
void MPU6050_MOD::CalibrateAccel(uint8_t Loops ) {

	float kP = 0.3;
	float kI = 20;
	float x;
	x = (100 - map(Loops, 1, 5, 20, 0)) * .01;
	kP *= x;
	kI *= x;
	PID( 0x3B, kP, kI,  Loops);
}

void MPU6050_MOD::PID(uint8_t ReadAddress, float kP,float kI, uint8_t Loops){
	uint8_t SaveAddress = (ReadAddress == 0x3B)?((getDeviceID() < 0x38 )? 0x06:0x77):0x13;

	int16_t  Data;
	float Reading;
	int16_t BitZero[3];
	uint8_t shift =(SaveAddress == 0x77)?3:2;
	float Error, PTerm, ITerm[3];
	int16_t eSample;
	uint32_t eSum ;
	////Serial.write('>');
	for (int i = 0; i < 3; i++) {
		I2Cdev_mod::readWords(devAddr, SaveAddress + (i * shift), 1, (uint16_t *)&Data); // reads 1 or more 16 bit integers (Word)
		Reading = Data;
		if(SaveAddress != 0x13){
			BitZero[i] = Data & 1;										 // Capture Bit Zero to properly handle Accelerometer calibration
			ITerm[i] = ((float)Reading) * 8;
			} else {
			ITerm[i] = Reading * 4;
		}
	}
	for (int L = 0; L < Loops; L++) {
		eSample = 0;
		for (int c = 0; c < 100; c++) {// 100 PI Calculations
			eSum = 0;
			for (int i = 0; i < 3; i++) {
				I2Cdev_mod::readWords(devAddr, ReadAddress + (i * 2), 1, (uint16_t *)&Data); // reads 1 or more 16 bit integers (Word)
				Reading = Data;
				if ((ReadAddress == 0x3B)&&(i == 2)) Reading -= 16384;	//remove Gravity
				Error = -Reading;
				eSum += abs(Reading);
				PTerm = kP * Error;
				ITerm[i] += (Error * 0.001) * kI;				// Integral term 1000 Calculations a second = 0.001
				if(SaveAddress != 0x13){
					Data = round((PTerm + ITerm[i] ) / 8);		//Compute PID Output
					Data = ((Data)&0xFFFE) |BitZero[i];			// Insert Bit0 Saved at beginning
				} else Data = round((PTerm + ITerm[i] ) / 4);	//Compute PID Output
				I2Cdev_mod::writeWords(devAddr, SaveAddress + (i * shift), 1, (uint16_t *)&Data);
			}
			if((c == 99) && eSum > 1000){						// Error is still to great to continue 
				c = 0;
				////Serial.write('*');
			}
			if((eSum * ((ReadAddress == 0x3B)?.05: 1)) < 5) eSample++;	// Successfully found offsets prepare to  advance
			if((eSum < 100) && (c > 10) && (eSample >= 10)) break;		// Advance to next Loop
			delay(1);
		}
		////Serial.write('.');
		kP *= .75;
		kI *= .75;
		for (int i = 0; i < 3; i++){
			if(SaveAddress != 0x13) {
				Data = round((ITerm[i] ) / 8);		//Compute PID Output
				Data = ((Data)&0xFFFE) |BitZero[i];	// Insert Bit0 Saved at beginning
			} else Data = round((ITerm[i]) / 4);
			I2Cdev_mod::writeWords(devAddr, SaveAddress + (i * shift), 1, (uint16_t *)&Data);
		}
	}
	resetFIFO();
	resetDMP();
}

#define printfloatx(Name,Variable,Spaces,Precision,EndTxt) { Serial.print(F(Name)); {char S[(Spaces + Precision + 3)];Serial.print(F(" ")); Serial.print(dtostrf((float)Variable,Spaces,Precision ,S));}Serial.print(F(EndTxt)); }//Name,Variable,Spaces,Precision,EndTxt
void MPU6050_MOD::PrintActiveOffsets() {
	uint8_t AOffsetRegister = (getDeviceID() < 0x38 )? MPU6050_MOD_RA_XA_OFFS_H:0x77;
	int16_t Data[3];
	SerialUSB.print(F("Offset Register 0x"));
	SerialUSB.print(AOffsetRegister>>4,HEX);
    SerialUSB.print(AOffsetRegister&0x0F,HEX);
	SerialUSB.print(F("\n//           X Accel  Y Accel  Z Accel   X Gyro   Y Gyro   Z Gyro\n//OFFSETS   "));
	if(AOffsetRegister == 0x06)	I2Cdev_mod::readWords(devAddr, AOffsetRegister, 3, (uint16_t *)Data);
	else {
		I2Cdev_mod::readWords(devAddr, AOffsetRegister, 1, (uint16_t *)Data);
		I2Cdev_mod::readWords(devAddr, AOffsetRegister+3, 1, (uint16_t *)Data+1);
		I2Cdev_mod::readWords(devAddr, AOffsetRegister+6, 1, (uint16_t *)Data+2);
	}
	//	A_OFFSET_H_READ_A_OFFS(Data);
	printfloatx("", Data[0], 5, 0, ",  ");
	printfloatx("", Data[1], 5, 0, ",  ");
	printfloatx("", Data[2], 5, 0, ",  ");
	I2Cdev_mod::readWords(devAddr, 0x13, 3, (uint16_t *)Data);
	//	XG_OFFSET_H_READ_OFFS_USR(Data);
	printfloatx("", Data[0], 5, 0, ",  ");
	printfloatx("", Data[1], 5, 0, ",  ");
	printfloatx("", Data[2], 5, 0, "\n");
}

/*****************************************************DMP CODE*******************************************************************************************************************/

#include "I2Cdev_mod.h"


// MotionApps 2.0 DMP implementation, built using the MPU-6050EVB evaluation board
#define MPU6050_MOD_INCLUDE_DMP_MOTIONAPPS20

//#include "MPU6050_MOD.h"

// Tom Carpenter's conditional PROGMEM code
// http://forum.arduino.cc/index.php?topic=129407.0
#ifdef __AVR__
#include <avr/pgmspace.h>
#else
	// Teensy 3.0 library conditional PROGMEM code from Paul Stoffregen
#ifndef __PGMSPACE_H_
#define __PGMSPACE_H_ 1
#include <inttypes.h>

#define PROGMEM
#define PGM_P  const char *
#define PSTR(str) (str)
#define F(x) x

typedef void prog_void;
typedef char prog_char;
typedef unsigned char prog_uchar;
typedef int8_t prog_int8_t;
typedef uint8_t prog_uint8_t;
typedef int16_t prog_int16_t;
typedef uint16_t prog_uint16_t;
typedef int32_t prog_int32_t;
typedef uint32_t prog_uint32_t;

#define strcpy_P(dest, src) strcpy((dest), (src))
#define strcat_P(dest, src) strcat((dest), (src))
#define strcmp_P(a, b) strcmp((a), (b))

#define pgm_read_byte(addr) (*(const unsigned char *)(addr))
#define pgm_read_word(addr) (*(const unsigned short *)(addr))
#define pgm_read_dword(addr) (*(const unsigned long *)(addr))
#define pgm_read_float(addr) (*(const float *)(addr))

#define pgm_read_byte_near(addr) pgm_read_byte(addr)
#define pgm_read_word_near(addr) pgm_read_word(addr)
#define pgm_read_dword_near(addr) pgm_read_dword(addr)
#define pgm_read_float_near(addr) pgm_read_float(addr)
#define pgm_read_byte_far(addr) pgm_read_byte(addr)
#define pgm_read_word_far(addr) pgm_read_word(addr)
#define pgm_read_dword_far(addr) pgm_read_dword(addr)
#define pgm_read_float_far(addr) pgm_read_float(addr)
#endif
#endif

/* Source is from the InvenSense MotionApps v2 demo code. Original source is
 * unavailable, unless you happen to be amazing as decompiling binary by
 * hand (in which case, please contact me, and I'm totally serious).
 *
 * Also, I'd like to offer many, many thanks to Noah Zerkin for all of the
 * DMP reverse-engineering he did to help make this bit of wizardry
 * possible.
 */

 // NOTE! Enabling DEBUG adds about 3.3kB to the flash program size.
 // Debug output is now working even on ATMega328P MCUs (e.g. Arduino Uno)
 // after moving string constants to flash memory storage using the F()
 // compiler macro (Arduino IDE 1.0+ required).

 //#define DEBUG
#ifdef DEBUG
#define DEBUG_PRINT(x) Serial.print(x)
#define DEBUG_PRINTF(x, y) Serial.print(x, y)
#define DEBUG_PRINTLN(x) Serial.println(x)
#define DEBUG_PRINTLNF(x, y) Serial.println(x, y)
#else
#define DEBUG_PRINT(x)
#define DEBUG_PRINTF(x, y)
#define DEBUG_PRINTLN(x)
#define DEBUG_PRINTLNF(x, y)
#endif

#define MPU6050_MOD_DMP_CODE_SIZE       1929    // dmpMemory[]
#define MPU6050_MOD_DMP_CONFIG_SIZE     192     // dmpConfig[]
#define MPU6050_MOD_DMP_UPDATES_SIZE    47      // dmpUpdates[]

/* ================================================================================================ *
 | Default MotionApps v2.0 42-byte FIFO packet structure:                                           |
 |                                                                                                  |
 | [QUAT W][      ][QUAT X][      ][QUAT Y][      ][QUAT Z][      ][GYRO X][      ][GYRO Y][      ] |
 |   0   1   2   3   4   5   6   7   8   9  10  11  12  13  14  15  16  17  18  19  20  21  22  23  |
 |                                                                                                  |
 | [GYRO Z][      ][ACC X ][      ][ACC Y ][      ][ACC Z ][      ][      ]                         |
 |  24  25  26  27  28  29  30  31  32  33  34  35  36  37  38  39  40  41                          |
 * ================================================================================================ */

 // this block of memory gets written to the MPU on start-up, and it seems
 // to be volatile memory, so it has to be done each time (it only takes ~1
 // second though)

 // I Only Changed this by applying all the configuration data and capturing it before startup:
 // *** this is a capture of the DMP Firmware after all the messy changes were made so we can just load it
const unsigned char dmpMemory[MPU6050_MOD_DMP_CODE_SIZE] PROGMEM = {
	/* bank # 0 */
	0xFB, 0x00, 0x00, 0x3E, 0x00, 0x0B, 0x00, 0x36, 0x00, 0x01, 0x00, 0x02, 0x00, 0x03, 0x00, 0x00,
	0x00, 0x65, 0x00, 0x54, 0xFF, 0xEF, 0x00, 0x00, 0xFA, 0x80, 0x00, 0x0B, 0x12, 0x82, 0x00, 0x01,
	0x00, 0x02, 0x00, 0x00, 0x00, 0x00, 0x00, 0x00, 0x00, 0x00, 0x00, 0x00, 0x00, 0x00, 0x00, 0x00,
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	0xFF, 0xE6, 0x80, 0x79, 0x02, 0x00, 0x00, 0x00, 0x00, 0x00, 0xD0, 0xD6, 0x00, 0x00, 0x27, 0x10,
	/* bank # 1 */
	0xFB, 0x00, 0x00, 0x00, 0x40, 0x00, 0x00, 0x00, 0x00, 0x00, 0x00, 0x00, 0x00, 0x00, 0x00, 0x00,
	0x00, 0x00, 0x00, 0x01, 0x00, 0x00, 0x00, 0x00, 0x00, 0x00, 0x01, 0x00, 0x01, 0x00, 0x00, 0x00,
	0x00, 0x00, 0xFA, 0x36, 0xFF, 0xBC, 0x30, 0x8E, 0x00, 0x05, 0xFB, 0xF0, 0xFF, 0xD9, 0x5B, 0xC8,
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	0x00, 0x00, 0x25, 0x4D, 0x00, 0x2F, 0x70, 0x6D, 0x00, 0x00, 0x05, 0xAE, 0x00, 0x0C, 0x02, 0xD0,
	/* bank # 2 */
	0x00, 0x00, 0x00, 0x00, 0x00, 0x65, 0x00, 0x54, 0xFF, 0xEF, 0x00, 0x00, 0x00, 0x00, 0x00, 0x00,
	0x00, 0x00, 0x01, 0x00, 0x00, 0x44, 0x00, 0x01, 0x00, 0x05, 0x8B, 0xC1, 0x00, 0x00, 0x01, 0x00,
	0x00, 0x00, 0x00, 0x00, 0x00, 0x65, 0x00, 0x00, 0x00, 0x54, 0x00, 0x00, 0xFF, 0xEF, 0x00, 0x00,
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	0x00, 0x00, 0x00, 0x00, 0x00, 0x00, 0x00, 0x00, 0x00, 0x00, 0x00, 0x00, 0x00, 0x00, 0x00, 0x00,
	/* bank # 3 */
	0xD8, 0xDC, 0xBA, 0xA2, 0xF1, 0xDE, 0xB2, 0xB8, 0xB4, 0xA8, 0x81, 0x91, 0xF7, 0x4A, 0x90, 0x7F,
	0x91, 0x6A, 0xF3, 0xF9, 0xDB, 0xA8, 0xF9, 0xB0, 0xBA, 0xA0, 0x80, 0xF2, 0xCE, 0x81, 0xF3, 0xC2,
	0xF1, 0xC1, 0xF2, 0xC3, 0xF3, 0xCC, 0xA2, 0xB2, 0x80, 0xF1, 0xC6, 0xD8, 0x80, 0xBA, 0xA7, 0xDF,
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	0xB8, 0xA2, 0xDF, 0xDF, 0xDF, 0xA3, 0xDF, 0xDF, 0xDF, 0xD8, 0xD8, 0xF1, 0xB8, 0xA8, 0xB2, 0x86,
	/* bank # 4 */
	0xB4, 0x98, 0x0D, 0x35, 0x5D, 0xB8, 0xAA, 0x98, 0xB0, 0x87, 0x2D, 0x35, 0x3D, 0xB2, 0xB6, 0xBA,
	0xAF, 0x8C, 0x96, 0x19, 0x8F, 0x9F, 0xA7, 0x0E, 0x16, 0x1E, 0xB4, 0x9A, 0xB8, 0xAA, 0x87, 0x2C,
	0x54, 0x7C, 0xB9, 0xA3, 0xDE, 0xDF, 0xDF, 0xA3, 0xB1, 0x80, 0xF2, 0xC4, 0xCD, 0xC9, 0xF1, 0xB8,
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	0xC8, 0x9F, 0x12, 0x9E, 0xF3, 0x15, 0xA8, 0xDA, 0x12, 0x10, 0xD8, 0xF1, 0xAF, 0xC8, 0x97, 0x87,
	/* bank # 5 */
	0x34, 0xB5, 0xB9, 0x94, 0xA4, 0x21, 0xF3, 0xD9, 0x22, 0xD8, 0xF2, 0x2D, 0xF3, 0xD9, 0x2A, 0xD8,
	0xF2, 0x35, 0xF3, 0xD9, 0x32, 0xD8, 0x81, 0xA4, 0x60, 0x60, 0x61, 0xD9, 0x61, 0xD8, 0x6C, 0x68,
	0x69, 0xD9, 0x69, 0xD8, 0x74, 0x70, 0x71, 0xD9, 0x71, 0xD8, 0xB1, 0xA3, 0x84, 0x19, 0x3D, 0x5D,
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	0x8A, 0x64, 0x48, 0x31, 0x8B, 0x30, 0x49, 0x60, 0xA5, 0x88, 0x20, 0x09, 0x71, 0x58, 0x44, 0x68,
	/* bank # 6 */
	0x11, 0x39, 0x64, 0x49, 0x30, 0x19, 0xF1, 0xAC, 0x00, 0x2C, 0x54, 0x7C, 0xF0, 0x8C, 0xA8, 0x04,
	0x28, 0x50, 0x78, 0xF1, 0x88, 0x97, 0x26, 0xA8, 0x59, 0x98, 0xAC, 0x8C, 0x02, 0x26, 0x46, 0x66,
	0xF0, 0x89, 0x9C, 0xA8, 0x29, 0x51, 0x79, 0x24, 0x70, 0x59, 0x44, 0x69, 0x38, 0x64, 0x48, 0x31,
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	0xAC, 0x91, 0x2C, 0x4C, 0x6C, 0x8A, 0x9B, 0x2D, 0xD9, 0xD8, 0xD8, 0x51, 0xD9, 0xD8, 0xD8, 0x79,
	/* bank # 7 */
	0xD9, 0xD8, 0xD8, 0xF1, 0x9E, 0x88, 0xA3, 0x31, 0xDA, 0xD8, 0xD8, 0x91, 0x2D, 0xD9, 0x28, 0xD8,
	0x4D, 0xD9, 0x48, 0xD8, 0x6D, 0xD9, 0x68, 0xD8, 0xB1, 0x83, 0x93, 0x35, 0x3D, 0x80, 0x25, 0xDA,
	0xD8, 0xD8, 0x85, 0x69, 0xDA, 0xD8, 0xD8, 0xB4, 0x93, 0x81, 0xA3, 0x28, 0x34, 0x3C, 0xF3, 0xAB,
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	0xB9, 0xA7, 0xF1, 0x26, 0x26, 0x26, 0xFE, 0xD8, 0xFF,

};

#ifndef MPU6050_MOD_DMP_FIFO_RATE_DIVISOR 
#define MPU6050_MOD_DMP_FIFO_RATE_DIVISOR 0x01 // The New instance of the Firmware has this as the default
#endif

// I Simplified this:
uint8_t MPU6050_MOD::dmpInitialize() {
	// reset device
	DEBUG_PRINTLN(F("\n\nResetting MPU6050_MOD..."));
	reset();
	delay(30); // wait after reset

	// enable sleep mode and wake cycle
	/*Serial.println(F("Enabling sleep mode..."));
	setSleepEnabled(true);
	Serial.println(F("Enabling wake cycle..."));
	setWakeCycleEnabled(true);*/

	// disable sleep mode
	setSleepEnabled(false);

	// get MPU hardware revision
	setMemoryBank(0x10, true, true);
	setMemoryStartAddress(0x06);
	////Serial.println(F("Checking hardware revision..."));
	////Serial.print(F("Revision @ user[16][6] = "));
	////Serial.println(readMemoryByte(), HEX);
	////Serial.println(F("Resetting memory bank selection to 0..."));
	setMemoryBank(0, false, false);

	// check OTP bank valid
	DEBUG_PRINTLN(F("Reading OTP bank valid flag..."));
	DEBUG_PRINT(F("OTP bank is "));
	DEBUG_PRINTLN(getOTPBankValid() ? F("valid!") : F("invalid!"));

	// setup weird slave stuff (?)
	DEBUG_PRINTLN(F("Setting slave 0 address to 0x7F..."));
	setSlaveAddress(0, 0x7F);
	DEBUG_PRINTLN(F("Disabling I2C Master mode..."));
	setI2CMasterModeEnabled(false);
	DEBUG_PRINTLN(F("Setting slave 0 address to 0x68 (self)..."));
	setSlaveAddress(0, 0x68);
	DEBUG_PRINTLN(F("Resetting I2C Master control..."));
	resetI2CMaster();
	delay(20);
	DEBUG_PRINTLN(F("Setting clock source to Z Gyro..."));
	setClockSource(MPU6050_MOD_CLOCK_PLL_ZGYRO);

	DEBUG_PRINTLN(F("Setting DMP and FIFO_OFLOW interrupts enabled..."));
	setIntEnabled(1 << MPU6050_MOD_INTERRUPT_FIFO_OFLOW_BIT | 1 << MPU6050_MOD_INTERRUPT_DMP_INT_BIT);

	DEBUG_PRINTLN(F("Setting sample rate to 200Hz..."));
	setRate(4); // 1khz / (1 + 4) = 200 Hz

	DEBUG_PRINTLN(F("Setting external frame sync to TEMP_OUT_L[0]..."));
	setExternalFrameSync(MPU6050_MOD_EXT_SYNC_TEMP_OUT_L);

	DEBUG_PRINTLN(F("Setting DLPF bandwidth to 42Hz..."));
	setDLPFMode(MPU6050_MOD_DLPF_BW_42);

	DEBUG_PRINTLN(F("Setting gyro sensitivity to +/- 2000 deg/sec..."));
	setFullScaleGyroRange(MPU6050_MOD_GYRO_FS_2000);

	// load DMP code into memory banks
	DEBUG_PRINT(F("Writing DMP code to MPU memory banks ("));
	DEBUG_PRINT(MPU6050_MOD_DMP_CODE_SIZE);
	DEBUG_PRINTLN(F(" bytes)"));
	if (!writeProgMemoryBlock(dmpMemory, MPU6050_MOD_DMP_CODE_SIZE)) return 1; // Failed
	DEBUG_PRINTLN(F("Success! DMP code written and verified."));

	// Set the FIFO Rate Divisor int the DMP Firmware Memory
	unsigned char dmpUpdate[] = { 0x00, MPU6050_MOD_DMP_FIFO_RATE_DIVISOR };
	writeMemoryBlock(dmpUpdate, 0x02, 0x02, 0x16); // Lets write the dmpUpdate data to the Firmware image, we have 2 bytes to write in bank 0x02 with the Offset 0x16

	//write start address MSB into register
	setDMPConfig1(0x03);
	//write start address LSB into register
	setDMPConfig2(0x00);

	DEBUG_PRINTLN(F("Clearing OTP Bank flag..."));
	setOTPBankValid(false);

	DEBUG_PRINTLN(F("Setting motion detection threshold to 2..."));
	setMotionDetectionThreshold(2);

	DEBUG_PRINTLN(F("Setting zero-motion detection threshold to 156..."));
	setZeroMotionDetectionThreshold(156);

	DEBUG_PRINTLN(F("Setting motion detection duration to 80..."));
	setMotionDetectionDuration(80);

	DEBUG_PRINTLN(F("Setting zero-motion detection duration to 0..."));
	setZeroMotionDetectionDuration(0);
	DEBUG_PRINTLN(F("Enabling FIFO..."));
	setFIFOEnabled(true);

	DEBUG_PRINTLN(F("Resetting DMP..."));
	resetDMP();

	DEBUG_PRINTLN(F("DMP is good to go! Finally."));

	DEBUG_PRINTLN(F("Disabling DMP (you turn it on later)..."));
	setDMPEnabled(false);

	DEBUG_PRINTLN(F("Setting up internal 42-byte (default) DMP packet buffer..."));
	dmpPacketSize = 42;

	DEBUG_PRINTLN(F("Resetting FIFO and clearing INT status one last time..."));
	resetFIFO();
	getIntStatus();

	return 0; // success
}
// Nothing else changed

bool MPU6050_MOD::dmpPacketAvailable() {
	return getFIFOCount() >= dmpGetFIFOPacketSize();
}

// uint8_t MPU6050_MOD::dmpSetFIFORate(uint8_t fifoRate);
// uint8_t MPU6050_MOD::dmpGetFIFORate();
// uint8_t MPU6050_MOD::dmpGetSampleStepSizeMS();
// uint8_t MPU6050_MOD::dmpGetSampleFrequency();
// int32_t MPU6050_MOD::dmpDecodeTemperature(int8_t tempReg);

//uint8_t MPU6050_MOD::dmpRegisterFIFORateProcess(inv_obj_func func, int16_t priority);
//uint8_t MPU6050_MOD::dmpUnregisterFIFORateProcess(inv_obj_func func);
//uint8_t MPU6050_MOD::dmpRunFIFORateProcesses();

// uint8_t MPU6050_MOD::dmpSendQuaternion(uint_fast16_t accuracy);
// uint8_t MPU6050_MOD::dmpSendGyro(uint_fast16_t elements, uint_fast16_t accuracy);
// uint8_t MPU6050_MOD::dmpSendAccel(uint_fast16_t elements, uint_fast16_t accuracy);
// uint8_t MPU6050_MOD::dmpSendLinearAccel(uint_fast16_t elements, uint_fast16_t accuracy);
// uint8_t MPU6050_MOD::dmpSendLinearAccelInWorld(uint_fast16_t elements, uint_fast16_t accuracy);
// uint8_t MPU6050_MOD::dmpSendControlData(uint_fast16_t elements, uint_fast16_t accuracy);
// uint8_t MPU6050_MOD::dmpSendSensorData(uint_fast16_t elements, uint_fast16_t accuracy);
// uint8_t MPU6050_MOD::dmpSendExternalSensorData(uint_fast16_t elements, uint_fast16_t accuracy);
// uint8_t MPU6050_MOD::dmpSendGravity(uint_fast16_t elements, uint_fast16_t accuracy);
// uint8_t MPU6050_MOD::dmpSendPacketNumber(uint_fast16_t accuracy);
// uint8_t MPU6050_MOD::dmpSendQuantizedAccel(uint_fast16_t elements, uint_fast16_t accuracy);
// uint8_t MPU6050_MOD::dmpSendEIS(uint_fast16_t elements, uint_fast16_t accuracy);

uint8_t MPU6050_MOD::dmpGetAccel(int32_t* data, const uint8_t* packet) {
	// TODO: accommodate different arrangements of sent data (ONLY default supported now)
	if (packet == 0) packet = dmpPacketBuffer;
	data[0] = (((uint32_t)packet[28] << 24) | ((uint32_t)packet[29] << 16) | ((uint32_t)packet[30] << 8) | packet[31]);
	data[1] = (((uint32_t)packet[32] << 24) | ((uint32_t)packet[33] << 16) | ((uint32_t)packet[34] << 8) | packet[35]);
	data[2] = (((uint32_t)packet[36] << 24) | ((uint32_t)packet[37] << 16) | ((uint32_t)packet[38] << 8) | packet[39]);
	return 0;
}
uint8_t MPU6050_MOD::dmpGetAccel(int16_t* data, const uint8_t* packet) {
	// TODO: accommodate different arrangements of sent data (ONLY default supported now)
	if (packet == 0) packet = dmpPacketBuffer;
	data[0] = (packet[28] << 8) | packet[29];
	data[1] = (packet[32] << 8) | packet[33];
	data[2] = (packet[36] << 8) | packet[37];
	return 0;
}
uint8_t MPU6050_MOD::dmpGetAccel(VectorInt16* v, const uint8_t* packet) {
	// TODO: accommodate different arrangements of sent data (ONLY default supported now)
	if (packet == 0) packet = dmpPacketBuffer;
	v->x = (packet[28] << 8) | packet[29];
	v->y = (packet[32] << 8) | packet[33];
	v->z = (packet[36] << 8) | packet[37];
	return 0;
}
uint8_t MPU6050_MOD::dmpGetQuaternion(int32_t* data, const uint8_t* packet) {
	// TODO: accommodate different arrangements of sent data (ONLY default supported now)
	if (packet == 0) packet = dmpPacketBuffer;
	data[0] = (((uint32_t)packet[0] << 24) | ((uint32_t)packet[1] << 16) | ((uint32_t)packet[2] << 8) | packet[3]);
	data[1] = (((uint32_t)packet[4] << 24) | ((uint32_t)packet[5] << 16) | ((uint32_t)packet[6] << 8) | packet[7]);
	data[2] = (((uint32_t)packet[8] << 24) | ((uint32_t)packet[9] << 16) | ((uint32_t)packet[10] << 8) | packet[11]);
	data[3] = (((uint32_t)packet[12] << 24) | ((uint32_t)packet[13] << 16) | ((uint32_t)packet[14] << 8) | packet[15]);
	return 0;
}
uint8_t MPU6050_MOD::dmpGetQuaternion(int16_t* data, const uint8_t* packet) {
	// TODO: accommodate different arrangements of sent data (ONLY default supported now)
	if (packet == 0) packet = dmpPacketBuffer;
	data[0] = ((packet[0] << 8) | packet[1]);
	data[1] = ((packet[4] << 8) | packet[5]);
	data[2] = ((packet[8] << 8) | packet[9]);
	data[3] = ((packet[12] << 8) | packet[13]);
	return 0;
}
uint8_t MPU6050_MOD::dmpGetQuaternion(Quaternion* q, const uint8_t* packet) {
	// TODO: accommodate different arrangements of sent data (ONLY default supported now)
	int16_t qI[4];
	uint8_t status = dmpGetQuaternion(qI, packet);
	if (status == 0) {
		q->w = (float)qI[0] / 16384.0f;
		q->x = (float)qI[1] / 16384.0f;
		q->y = (float)qI[2] / 16384.0f;
		q->z = (float)qI[3] / 16384.0f;
		return 0;
	}
	return status; // int16 return value, indicates error if this line is reached
}
// uint8_t MPU6050_MOD::dmpGet6AxisQuaternion(long *data, const uint8_t* packet);
// uint8_t MPU6050_MOD::dmpGetRelativeQuaternion(long *data, const uint8_t* packet);
uint8_t MPU6050_MOD::dmpGetGyro(int32_t* data, const uint8_t* packet) {
	// TODO: accommodate different arrangements of sent data (ONLY default supported now)
	if (packet == 0) packet = dmpPacketBuffer;
	data[0] = (((uint32_t)packet[16] << 24) | ((uint32_t)packet[17] << 16) | ((uint32_t)packet[18] << 8) | packet[19]);
	data[1] = (((uint32_t)packet[20] << 24) | ((uint32_t)packet[21] << 16) | ((uint32_t)packet[22] << 8) | packet[23]);
	data[2] = (((uint32_t)packet[24] << 24) | ((uint32_t)packet[25] << 16) | ((uint32_t)packet[26] << 8) | packet[27]);
	return 0;
}
uint8_t MPU6050_MOD::dmpGetGyro(int16_t* data, const uint8_t* packet) {
	// TODO: accommodate different arrangements of sent data (ONLY default supported now)
	if (packet == 0) packet = dmpPacketBuffer;
	data[0] = (packet[16] << 8) | packet[17];
	data[1] = (packet[20] << 8) | packet[21];
	data[2] = (packet[24] << 8) | packet[25];
	return 0;
}
uint8_t MPU6050_MOD::dmpGetGyro(VectorInt16* v, const uint8_t* packet) {
	// TODO: accommodate different arrangements of sent data (ONLY default supported now)
	if (packet == 0) packet = dmpPacketBuffer;
	v->x = (packet[16] << 8) | packet[17];
	v->y = (packet[20] << 8) | packet[21];
	v->z = (packet[24] << 8) | packet[25];
	return 0;
}
// uint8_t MPU6050_MOD::dmpSetLinearAccelFilterCoefficient(float coef);
// uint8_t MPU6050_MOD::dmpGetLinearAccel(long *data, const uint8_t* packet);
uint8_t MPU6050_MOD::dmpGetLinearAccel(VectorInt16* v, VectorInt16* vRaw, VectorFloat* gravity) {
	// get rid of the gravity component (+1g = +8192 in standard DMP FIFO packet, sensitivity is 2g)
	v->x = vRaw->x - gravity->x * 8192;
	v->y = vRaw->y - gravity->y * 8192;
	v->z = vRaw->z - gravity->z * 8192;
	return 0;
}
// uint8_t MPU6050_MOD::dmpGetLinearAccelInWorld(long *data, const uint8_t* packet);
uint8_t MPU6050_MOD::dmpGetLinearAccelInWorld(VectorInt16* v, VectorInt16* vReal, Quaternion* q) {
	// rotate measured 3D acceleration vector into original state
	// frame of reference based on orientation quaternion
	memcpy(v, vReal, sizeof(VectorInt16));
	v->rotate(q);
	return 0;
}
// uint8_t MPU6050_MOD::dmpGetGyroAndAccelSensor(long *data, const uint8_t* packet);
// uint8_t MPU6050_MOD::dmpGetGyroSensor(long *data, const uint8_t* packet);
// uint8_t MPU6050_MOD::dmpGetControlData(long *data, const uint8_t* packet);
// uint8_t MPU6050_MOD::dmpGetTemperature(long *data, const uint8_t* packet);
// uint8_t MPU6050_MOD::dmpGetGravity(long *data, const uint8_t* packet);
uint8_t MPU6050_MOD::dmpGetGravity(int16_t* data, const uint8_t* packet) {
	/* +1g corresponds to +8192, sensitivity is 2g. */
	int16_t qI[4];
	uint8_t status = dmpGetQuaternion(qI, packet);
	data[0] = ((int32_t)qI[1] * qI[3] - (int32_t)qI[0] * qI[2]) / 16384;
	data[1] = ((int32_t)qI[0] * qI[1] + (int32_t)qI[2] * qI[3]) / 16384;
	data[2] = ((int32_t)qI[0] * qI[0] - (int32_t)qI[1] * qI[1]
		- (int32_t)qI[2] * qI[2] + (int32_t)qI[3] * qI[3]) / (2 * 16384);
	return status;
}

uint8_t MPU6050_MOD::dmpGetGravity(VectorFloat* v, Quaternion* q) {
	v->x = 2 * (q->x * q->z - q->w * q->y);
	v->y = 2 * (q->w * q->x + q->y * q->z);
	v->z = q->w * q->w - q->x * q->x - q->y * q->y + q->z * q->z;
	return 0;
}
// uint8_t MPU6050_MOD::dmpGetUnquantizedAccel(long *data, const uint8_t* packet);
// uint8_t MPU6050_MOD::dmpGetQuantizedAccel(long *data, const uint8_t* packet);
// uint8_t MPU6050_MOD::dmpGetExternalSensorData(long *data, int size, const uint8_t* packet);
// uint8_t MPU6050_MOD::dmpGetEIS(long *data, const uint8_t* packet);

uint8_t MPU6050_MOD::dmpGetEuler(float* data, Quaternion* q) {
	data[0] = atan2(2 * q->x * q->y - 2 * q->w * q->z, 2 * q->w * q->w + 2 * q->x * q->x - 1);   // psi
	data[1] = -asin(2 * q->x * q->z + 2 * q->w * q->y);                              // theta
	data[2] = atan2(2 * q->y * q->z - 2 * q->w * q->x, 2 * q->w * q->w + 2 * q->z * q->z - 1);   // phi
	return 0;
}

#ifdef USE_OLD_DMPGETYAWPITCHROLL
uint8_t MPU6050_MOD::dmpGetYawPitchRoll(float* data, Quaternion* q, VectorFloat* gravity) {
	// yaw: (about Z axis)
	data[0] = atan2(2 * q->x * q->y - 2 * q->w * q->z, 2 * q->w * q->w + 2 * q->x * q->x - 1);
	// pitch: (nose up/down, about Y axis)
	data[1] = atan(gravity->x / sqrt(gravity->y * gravity->y + gravity->z * gravity->z));
	// roll: (tilt left/right, about X axis)
	data[2] = atan(gravity->y / sqrt(gravity->x * gravity->x + gravity->z * gravity->z));
	return 0;
}
#else 
uint8_t MPU6050_MOD::dmpGetYawPitchRoll(float* data, Quaternion* q, VectorFloat* gravity) {
	// yaw: (about Z axis)
	data[0] = atan2(2 * q->x * q->y - 2 * q->w * q->z, 2 * q->w * q->w + 2 * q->x * q->x - 1);
	// pitch: (nose up/down, about Y axis)
	data[1] = atan2(gravity->x, sqrt(gravity->y * gravity->y + gravity->z * gravity->z));
	// roll: (tilt left/right, about X axis)
	data[2] = atan2(gravity->y, gravity->z);
	if (gravity->z < 0) {
		if (data[1] > 0) {
			data[1] = PI - data[1];
		}
		else {
			data[1] = -PI - data[1];
		}
	}
	return 0;
}
#endif

// uint8_t MPU6050_MOD::dmpGetAccelFloat(float *data, const uint8_t* packet);
// uint8_t MPU6050_MOD::dmpGetQuaternionFloat(float *data, const uint8_t* packet);

uint8_t MPU6050_MOD::dmpProcessFIFOPacket(const unsigned char* dmpData) {
	/*for (uint8_t k = 0; k < dmpPacketSize; k++) {
		if (dmpData[k] < 0x10) Serial.print("0");
		Serial.print(dmpData[k], HEX);
		Serial.print(" ");
	}
	Serial.print("\n");*/
	//Serial.println((uint16_t)dmpPacketBuffer);
	return 0;
}
uint8_t MPU6050_MOD::dmpReadAndProcessFIFOPacket(uint8_t numPackets, uint8_t* processed) {
	uint8_t status;
	uint8_t buf[dmpPacketSize];
	for (uint8_t i = 0; i < numPackets; i++) {
		// read packet from FIFO
		getFIFOBytes(buf, dmpPacketSize);

		// process packet
		if ((status = dmpProcessFIFOPacket(buf)) > 0) return status;

		// increment external process count variable, if supplied
		if (processed != 0) (*processed)++;
	}
	return 0;
}

// uint8_t MPU6050_MOD::dmpSetFIFOProcessedCallback(void (*func) (void));

// uint8_t MPU6050_MOD::dmpInitFIFOParam();
// uint8_t MPU6050_MOD::dmpCloseFIFO();
// uint8_t MPU6050_MOD::dmpSetGyroDataSource(uint_fast8_t source);
// uint8_t MPU6050_MOD::dmpDecodeQuantizedAccel();
// uint32_t MPU6050_MOD::dmpGetGyroSumOfSquare();
// uint32_t MPU6050_MOD::dmpGetAccelSumOfSquare();
// void MPU6050_MOD::dmpOverrideQuaternion(long *q);
uint16_t MPU6050_MOD::dmpGetFIFOPacketSize() {
	return dmpPacketSize;
}
